/*@!Encoding:936*/

includes
{

}

variables
{
   message VIS_ObjInfo_Extd Msg_VIS_ObjInfo_Extd;
   message ADAM_Metadata Msg_ADAM_Metadata;
   message ADAM_Intersection Msg_ADAM_Intersection;
   message ADAM_Segment Msg_ADAM_Segment;
   message ADAM_Position Msg_ADAM_Position;
   message VIS_ObjInfo_01 Msg_VIS_ObjInfo_01;
   message VIS_ObjInfo_02 Msg_VIS_ObjInfo_02;
   message VIS_ObjInfo_03 Msg_VIS_ObjInfo_03;
   message VIS_ObjInfo_04 Msg_VIS_ObjInfo_04;
   message VIS_ObjInfo_05 Msg_VIS_ObjInfo_05;
   message VIS_ObjInfo_06 Msg_VIS_ObjInfo_06;
   message VIS_ObjInfo_07 Msg_VIS_ObjInfo_07;
   message VIS_ObjInfo_08 Msg_VIS_ObjInfo_08;
   message VIS_ObjInfo_09 Msg_VIS_ObjInfo_09;
   message VIS_ObjInfo_10 Msg_VIS_ObjInfo_10;
   message VIS_ObjInfo_11 Msg_VIS_ObjInfo_11;
   message VIS_ObjInfo_12 Msg_VIS_ObjInfo_12;
   message VIS_ObjInfo_13 Msg_VIS_ObjInfo_13;
   message VIS_ObjInfo_14 Msg_VIS_ObjInfo_14;
   message VIS_ObjInfo_15 Msg_VIS_ObjInfo_15;
   message VIS_EYEQ_SDM Msg_VIS_EYEQ_SDM;
   message VIS_EYEQ_FAILSAFE Msg_VIS_EYEQ_FAILSAFE;
   message VIS_AEB Msg_VIS_AEB;
   message Aptiv_DOW_TargetSelection Msg_Aptiv_DOW_TargetSelection;
   message Aptiv_RCTA_TargetSelection Msg_Aptiv_RCTA_TargetSelection;
   message Aptiv_SBZA_TargetSelection Msg_Aptiv_SBZA_TargetSelection;
   message Aptiv_LCA_TargetSelection Msg_Aptiv_LCA_TargetSelection;
   message Pedastrain_Info Msg_Pedastrain_Info;
   message TestEventMarker Msg_TestEventMarker;
   message VIS_LANE_ROADBORDER Msg_VIS_LANE_ROADBORDER;
   message VIS_Hpp_CenterLine Msg_VIS_Hpp_CenterLine;
   message StreamCounter_ETSEL Msg_StreamCounter_ETSEL;
   message RTS2_DIS Msg_RTS2_DIS;
   message RT6_DIS Msg_RT6_DIS;
   message RT5_DIS Msg_RT5_DIS;
   message RT4_DIS Msg_RT4_DIS;
   message RT3_DIS Msg_RT3_DIS;
   message RT2_DIS Msg_RT2_DIS;
   message RT1_DIS Msg_RT1_DIS;
   message RTS4_DIS Msg_RTS4_DIS;
   message RTS3_DIS Msg_RTS3_DIS;
   message RTS1_DIS Msg_RTS1_DIS;
   message PCA_Stationary Msg_PCA_Stationary;
   message PCA_Moving Msg_PCA_Moving;
   message VIS_LANE_NEIGHBOR Msg_VIS_LANE_NEIGHBOR;
   message VIS_LANE_INFORMATION Msg_VIS_LANE_INFORMATION;
   message VIS_LANE_CHANGE_TA Msg_VIS_LANE_CHANGE_TA;
   message VIS_LANE_NEAR_INDIVIDUAL Msg_VIS_LANE_NEAR_INDIVIDUAL;
   message SPP_SP_Info Msg_SPP_SP_Info;
   message Compensated_YawRate Msg_Compensated_YawRate;
   message VIS_TSR_SIGN_01 Msg_VIS_TSR_SIGN_01;
   message VIS_TSR_SIGN_02 Msg_VIS_TSR_SIGN_02;
   message VIS_TSR_SIGN_03 Msg_VIS_TSR_SIGN_03;
   message VIS_TSR_SIGN_04 Msg_VIS_TSR_SIGN_04;
   message VIS_TSR_SIGN_05 Msg_VIS_TSR_SIGN_05;
   message VIS_TSR_SIGN_06 Msg_VIS_TSR_SIGN_06;
   message VIS_TSR_SIGN_07 Msg_VIS_TSR_SIGN_07;
   message VIS_TSR_SIGN_08 Msg_VIS_TSR_SIGN_08;
   message VIS_TSR_SIGN_09 Msg_VIS_TSR_SIGN_09;
   message VIS_TSR_SIGN_10 Msg_VIS_TSR_SIGN_10;
   message VIS_TSR_SIGN_11 Msg_VIS_TSR_SIGN_11;
   message VIS_TSR_SIGN_12 Msg_VIS_TSR_SIGN_12;
   message VIS_TSR_SIGN_13 Msg_VIS_TSR_SIGN_13;
   message VIS_TSR_SIGN_14 Msg_VIS_TSR_SIGN_14;
   message VIS_TSR_SIGN_15 Msg_VIS_TSR_SIGN_15;
   message VIS_TSR_SIGN_16 Msg_VIS_TSR_SIGN_16;
   message VIS_TSR_SIGN_17 Msg_VIS_TSR_SIGN_17;
   message VIS_TSR_SIGN_18 Msg_VIS_TSR_SIGN_18;
   message VIS_TSR_SIGN_19 Msg_VIS_TSR_SIGN_19;
   message VIS_TSR_SIGN_20 Msg_VIS_TSR_SIGN_20;
   message VIS_StopLine_01 Msg_VIS_StopLine_01;
   message VIS_StopLine_02 Msg_VIS_StopLine_02;
   message VIS_StopLine_03 Msg_VIS_StopLine_03;
   message VIS_StopLine_04 Msg_VIS_StopLine_04;
   message VIS_StopLine_05 Msg_VIS_StopLine_05;
   message VIS_StopLine_06 Msg_VIS_StopLine_06;
   message VIS_StopLine_07 Msg_VIS_StopLine_07;
   message VIS_StopLine_08 Msg_VIS_StopLine_08;
   message VIS_StopLine_09 Msg_VIS_StopLine_09;
   message VIS_StopLine_10 Msg_VIS_StopLine_10;
   message VIS_Arrow_01 Msg_VIS_Arrow_01;
   message VIS_Arrow_02 Msg_VIS_Arrow_02;
   message VIS_Arrow_03 Msg_VIS_Arrow_03;
   message VIS_Arrow_04 Msg_VIS_Arrow_04;
   message VIS_Arrow_05 Msg_VIS_Arrow_05;
   message VIS_Arrow_06 Msg_VIS_Arrow_06;
   message VIS_Arrow_07 Msg_VIS_Arrow_07;
   message VIS_Arrow_08 Msg_VIS_Arrow_08;
   message VIS_Arrow_09 Msg_VIS_Arrow_09;
   message VIS_Arrow_10 Msg_VIS_Arrow_10;
   message VIS_Transition_01 Msg_VIS_Transition_01;
   message VIS_Transition_02 Msg_VIS_Transition_02;
   message VIS_Transition_03 Msg_VIS_Transition_03;
   message VIS_Transition_04 Msg_VIS_Transition_04;
   message VIS_Transition_05 Msg_VIS_Transition_05;
   message VIS_Transition_06 Msg_VIS_Transition_06;
   message VIS_Transition_07 Msg_VIS_Transition_07;
   message VIS_Transition_08 Msg_VIS_Transition_08;
   message VIS_Transition_09 Msg_VIS_Transition_09;
   message VIS_Transition_10 Msg_VIS_Transition_10;
   message VIS_Transition_11 Msg_VIS_Transition_11;
   message VIS_Transition_12 Msg_VIS_Transition_12;
   message streamTxCntCheck Msg_streamTxCntCheck;
   message U3T_Obj_88_50ms Msg_U3T_Obj_88_50ms;
   message U3T_Obj_87_50ms Msg_U3T_Obj_87_50ms;
   message U3T_Obj_86_50ms Msg_U3T_Obj_86_50ms;
   message U3T_Obj_85_50ms Msg_U3T_Obj_85_50ms;
   message U3T_Obj_84_50ms Msg_U3T_Obj_84_50ms;
   message U3T_Obj_83_50ms Msg_U3T_Obj_83_50ms;
   message U3T_Obj_82_50ms Msg_U3T_Obj_82_50ms;
   message U3T_Obj_96_50ms Msg_U3T_Obj_96_50ms;
   message U3T_Obj_95_50ms Msg_U3T_Obj_95_50ms;
   message U3T_Obj_94_50ms Msg_U3T_Obj_94_50ms;
   message U3T_Obj_93_50ms Msg_U3T_Obj_93_50ms;
   message U3T_Obj_92_50ms Msg_U3T_Obj_92_50ms;
   message U3T_Obj_91_50ms Msg_U3T_Obj_91_50ms;
   message U3T_Obj_90_50ms Msg_U3T_Obj_90_50ms;
   message U3T_Obj_89_50ms Msg_U3T_Obj_89_50ms;
   message U3T_Obj_81_50ms Msg_U3T_Obj_81_50ms;
   message U3T_Obj_72_50ms Msg_U3T_Obj_72_50ms;
   message U3T_Obj_80_50ms Msg_U3T_Obj_80_50ms;
   message U3T_Obj_79_50ms Msg_U3T_Obj_79_50ms;
   message U3T_Obj_78_50ms Msg_U3T_Obj_78_50ms;
   message U3T_Obj_77_50ms Msg_U3T_Obj_77_50ms;
   message U3T_Obj_76_50ms Msg_U3T_Obj_76_50ms;
   message U3T_Obj_75_50ms Msg_U3T_Obj_75_50ms;
   message U3T_Obj_74_50ms Msg_U3T_Obj_74_50ms;
   message U3T_Obj_73_50ms Msg_U3T_Obj_73_50ms;
   message U3T_Obj_71_50ms Msg_U3T_Obj_71_50ms;
   message U3T_Obj_62_50ms Msg_U3T_Obj_62_50ms;
   message U3T_Obj_70_50ms Msg_U3T_Obj_70_50ms;
   message U3T_Obj_69_50ms Msg_U3T_Obj_69_50ms;
   message U3T_Obj_68_50ms Msg_U3T_Obj_68_50ms;
   message U3T_Obj_67_50ms Msg_U3T_Obj_67_50ms;
   message U3T_Obj_66_50ms Msg_U3T_Obj_66_50ms;
   message U3T_Obj_65_50ms Msg_U3T_Obj_65_50ms;
   message U3T_Obj_64_50ms Msg_U3T_Obj_64_50ms;
   message U3T_Obj_63_50ms Msg_U3T_Obj_63_50ms;
   message U3T_Obj_61_50ms Msg_U3T_Obj_61_50ms;
   message U3T_Obj_52_50ms Msg_U3T_Obj_52_50ms;
   message U3T_Obj_60_50ms Msg_U3T_Obj_60_50ms;
   message U3T_Obj_59_50ms Msg_U3T_Obj_59_50ms;
   message U3T_Obj_58_50ms Msg_U3T_Obj_58_50ms;
   message U3T_Obj_57_50ms Msg_U3T_Obj_57_50ms;
   message U3T_Obj_56_50ms Msg_U3T_Obj_56_50ms;
   message U3T_Obj_55_50ms Msg_U3T_Obj_55_50ms;
   message U3T_Obj_54_50ms Msg_U3T_Obj_54_50ms;
   message U3T_Obj_53_50ms Msg_U3T_Obj_53_50ms;
   message U3T_Obj_51_50ms Msg_U3T_Obj_51_50ms;
   message U3T_Obj_42_50ms Msg_U3T_Obj_42_50ms;
   message U3T_Obj_50_50ms Msg_U3T_Obj_50_50ms;
   message U3T_Obj_49_50ms Msg_U3T_Obj_49_50ms;
   message U3T_Obj_48_50ms Msg_U3T_Obj_48_50ms;
   message U3T_Obj_47_50ms Msg_U3T_Obj_47_50ms;
   message U3T_Obj_46_50ms Msg_U3T_Obj_46_50ms;
   message U3T_Obj_45_50ms Msg_U3T_Obj_45_50ms;
   message U3T_Obj_44_50ms Msg_U3T_Obj_44_50ms;
   message U3T_Obj_43_50ms Msg_U3T_Obj_43_50ms;
   message U3T_Obj_41_50ms Msg_U3T_Obj_41_50ms;
   message U3T_Obj_40_50ms Msg_U3T_Obj_40_50ms;
   message U3T_Obj_39_50ms Msg_U3T_Obj_39_50ms;
   message U3T_Obj_38_50ms Msg_U3T_Obj_38_50ms;
   message U3T_Obj_37_50ms Msg_U3T_Obj_37_50ms;
   message U3T_Obj_36_50ms Msg_U3T_Obj_36_50ms;
   message U3T_Obj_35_50ms Msg_U3T_Obj_35_50ms;
   message U3T_Obj_34_50ms Msg_U3T_Obj_34_50ms;
   message U3T_Obj_33_50ms Msg_U3T_Obj_33_50ms;
   message U3T_Obj_32_50ms Msg_U3T_Obj_32_50ms;
   message U3T_Obj_23_50ms Msg_U3T_Obj_23_50ms;
   message U3T_Obj_31_50ms Msg_U3T_Obj_31_50ms;
   message U3T_Obj_30_50ms Msg_U3T_Obj_30_50ms;
   message U3T_Obj_29_50ms Msg_U3T_Obj_29_50ms;
   message U3T_Obj_28_50ms Msg_U3T_Obj_28_50ms;
   message U3T_Obj_27_50ms Msg_U3T_Obj_27_50ms;
   message U3T_Obj_26_50ms Msg_U3T_Obj_26_50ms;
   message U3T_Obj_25_50ms Msg_U3T_Obj_25_50ms;
   message U3T_Obj_24_50ms Msg_U3T_Obj_24_50ms;
   message U3T_Obj_22_50ms Msg_U3T_Obj_22_50ms;
   message U3T_Obj_21_50ms Msg_U3T_Obj_21_50ms;
   message U3T_Obj_20_50ms Msg_U3T_Obj_20_50ms;
   message U3T_Obj_19_50ms Msg_U3T_Obj_19_50ms;
   message U3T_Obj_18_50ms Msg_U3T_Obj_18_50ms;
   message U3T_Obj_17_50ms Msg_U3T_Obj_17_50ms;
   message U3T_Obj_16_50ms Msg_U3T_Obj_16_50ms;
   message U3T_Obj_15_50ms Msg_U3T_Obj_15_50ms;
   message U3T_Obj_14_50ms Msg_U3T_Obj_14_50ms;
   message U3T_Obj_13_50ms Msg_U3T_Obj_13_50ms;
   message U3T_Obj_12_50ms Msg_U3T_Obj_12_50ms;
   message U3T_Obj_11_50ms Msg_U3T_Obj_11_50ms;
   message U3T_Obj_10_50ms Msg_U3T_Obj_10_50ms;
   message U3T_Obj_09_50ms Msg_U3T_Obj_09_50ms;
   message U3T_Obj_08_50ms Msg_U3T_Obj_08_50ms;
   message U3T_Obj_07_50ms Msg_U3T_Obj_07_50ms;
   message U3T_Obj_06_50ms Msg_U3T_Obj_06_50ms;
   message U3T_Obj_05_50ms Msg_U3T_Obj_05_50ms;
   message U3T_Obj_04_50ms Msg_U3T_Obj_04_50ms;
   message U3T_Obj_01_50ms Msg_U3T_Obj_01_50ms;
   message U3T_Obj_02_50ms Msg_U3T_Obj_02_50ms;
   message U3T_Obj_03_50ms Msg_U3T_Obj_03_50ms;
   msTimer Timer_200ms;
   msTimer Timer_50ms;
}

on start
{
   setTimerCyclic(Timer_200ms, 200);
   setTimerCyclic(Timer_50ms, 50);
}

on timer Timer_200ms
{
   Msg_VIS_ObjInfo_Extd.VIS_CIPO_ID.phys = @sysvar::MsgVIS_ObjInfo_Extd::SigVIS_CIPO_ID;
   output(Msg_VIS_ObjInfo_Extd);
   Msg_ADAM_Metadata.ADAMMtdtPrvdr.phys = @sysvar::MsgADAM_Metadata::SigADAMMtdtPrvdr;
   Msg_ADAM_Metadata.ADAMMtdtCntryCd.phys = @sysvar::MsgADAM_Metadata::SigADAMMtdtCntryCd;
   Msg_ADAM_Metadata.ADAMMtdtDrvSd.phys = @sysvar::MsgADAM_Metadata::SigADAMMtdtDrvSd;
   Msg_ADAM_Metadata.ADAMMtdtCycCnt.phys = @sysvar::MsgADAM_Metadata::SigADAMMtdtCycCnt;
   Msg_ADAM_Metadata.ADAMMtdtHwVer.phys = @sysvar::MsgADAM_Metadata::SigADAMMtdtHwVer;
   Msg_ADAM_Metadata.ADAMMtdtSpdUnt.phys = @sysvar::MsgADAM_Metadata::SigADAMMtdtSpdUnt;
   Msg_ADAM_Metadata.ADAMMtdtRgnCd.phys = @sysvar::MsgADAM_Metadata::SigADAMMtdtRgnCd;
   Msg_ADAM_Metadata.ADAMMtdtSwVer.phys = @sysvar::MsgADAM_Metadata::SigADAMMtdtSwVer;
   Msg_ADAM_Metadata.ADAMMtdtVerYr.phys = @sysvar::MsgADAM_Metadata::SigADAMMtdtVerYr;
   Msg_ADAM_Metadata.ADAMMtdtVerMth.phys = @sysvar::MsgADAM_Metadata::SigADAMMtdtVerMth;
   Msg_ADAM_Metadata.ADAMMtdtMsgTyp.phys = @sysvar::MsgADAM_Metadata::SigADAMMtdtMsgTyp;
   output(Msg_ADAM_Metadata);
   Msg_ADAM_Intersection.ADAMInsMsgTyp.phys = @sysvar::MsgADAM_Intersection::SigADAMInsMsgTyp;
   Msg_ADAM_Intersection.ADAMInsCycCnt.phys = @sysvar::MsgADAM_Intersection::SigADAMInsCycCnt;
   Msg_ADAM_Intersection.ADAMInsRetr.phys = @sysvar::MsgADAM_Intersection::SigADAMInsRetr;
   Msg_ADAM_Intersection.ADAMInsPthIdx.phys = @sysvar::MsgADAM_Intersection::SigADAMInsPthIdx;
   Msg_ADAM_Intersection.ADAMInsFormOfWay.phys = @sysvar::MsgADAM_Intersection::SigADAMInsFormOfWay;
   Msg_ADAM_Intersection.ADAMInsSubPthIdx.phys = @sysvar::MsgADAM_Intersection::SigADAMInsSubPthIdx;
   Msg_ADAM_Intersection.ADAMInsOffst.phys = @sysvar::MsgADAM_Intersection::SigADAMInsOffst;
   Msg_ADAM_Intersection.ADAMInsFuncRdClass.phys = @sysvar::MsgADAM_Intersection::SigADAMInsFuncRdClass;
   Msg_ADAM_Intersection.ADAMInsTrnAngl.phys = @sysvar::MsgADAM_Intersection::SigADAMInsTrnAngl;
   Msg_ADAM_Intersection.ADAMInsCmplxInsct.phys = @sysvar::MsgADAM_Intersection::SigADAMInsCmplxInsct;
   Msg_ADAM_Intersection.ADAMInsNmLnDrvDirAftIns.phys = @sysvar::MsgADAM_Intersection::SigADAMInsNmLnDrvDirAftIns;
   Msg_ADAM_Intersection.ADAMInsLnNmAftIns.phys = @sysvar::MsgADAM_Intersection::SigADAMInsLnNmAftIns;
   Msg_ADAM_Intersection.ADAMInsPrtCalcRte.phys = @sysvar::MsgADAM_Intersection::SigADAMInsPrtCalcRte;
   Msg_ADAM_Intersection.ADAMInsUpdt.phys = @sysvar::MsgADAM_Intersection::SigADAMInsUpdt;
   Msg_ADAM_Intersection.ADAMInsLstStb.phys = @sysvar::MsgADAM_Intersection::SigADAMInsLstStb;
   output(Msg_ADAM_Intersection);
   Msg_ADAM_Segment.ADAMSegPthIdx.phys = @sysvar::MsgADAM_Segment::SigADAMSegPthIdx;
   Msg_ADAM_Segment.ADAMSegRetr.phys = @sysvar::MsgADAM_Segment::SigADAMSegRetr;
   Msg_ADAM_Segment.ADAMSegUpdt.phys = @sysvar::MsgADAM_Segment::SigADAMSegUpdt;
   Msg_ADAM_Segment.ADAMSegEffSpdLmtTyp.phys = @sysvar::MsgADAM_Segment::SigADAMSegEffSpdLmtTyp;
   Msg_ADAM_Segment.ADAMSegRelProb.phys = @sysvar::MsgADAM_Segment::SigADAMSegRelProb;
   Msg_ADAM_Segment.ADAMSegFuncRdClass.phys = @sysvar::MsgADAM_Segment::SigADAMSegFuncRdClass;
   Msg_ADAM_Segment.ADAMSegSpdLmt.phys = @sysvar::MsgADAM_Segment::SigADAMSegSpdLmt;
   Msg_ADAM_Segment.ADAMSegDivdRd.phys = @sysvar::MsgADAM_Segment::SigADAMSegDivdRd;
   Msg_ADAM_Segment.ADAMSegNumLnOppDir.phys = @sysvar::MsgADAM_Segment::SigADAMSegNumLnOppDir;
   Msg_ADAM_Segment.ADAMSegPrtCalcRte.phys = @sysvar::MsgADAM_Segment::SigADAMSegPrtCalcRte;
   Msg_ADAM_Segment.ADAMSegTunnel.phys = @sysvar::MsgADAM_Segment::SigADAMSegTunnel;
   Msg_ADAM_Segment.ADAMSegCycCnt.phys = @sysvar::MsgADAM_Segment::SigADAMSegCycCnt;
   Msg_ADAM_Segment.ADAMSegCmplxInsct.phys = @sysvar::MsgADAM_Segment::SigADAMSegCmplxInsct;
   Msg_ADAM_Segment.ADAMSegFormOfWay.phys = @sysvar::MsgADAM_Segment::SigADAMSegFormOfWay;
   Msg_ADAM_Segment.ADAMSegMsgTyp.phys = @sysvar::MsgADAM_Segment::SigADAMSegMsgTyp;
   Msg_ADAM_Segment.ADAMSegBldUpAra.phys = @sysvar::MsgADAM_Segment::SigADAMSegBldUpAra;
   Msg_ADAM_Segment.ADAMSegBrdg.phys = @sysvar::MsgADAM_Segment::SigADAMSegBrdg;
   Msg_ADAM_Segment.ADAMSegNmLnDrvDir.phys = @sysvar::MsgADAM_Segment::SigADAMSegNmLnDrvDir;
   Msg_ADAM_Segment.ADAMSegOffst.phys = @sysvar::MsgADAM_Segment::SigADAMSegOffst;
   output(Msg_ADAM_Segment);
   Msg_ADAM_Position.ADAMPosMsgTyp.phys = @sysvar::MsgADAM_Position::SigADAMPosMsgTyp;
   Msg_ADAM_Position.ADAMPosOffst.phys = @sysvar::MsgADAM_Position::SigADAMPosOffst;
   Msg_ADAM_Position.ADAMPosRelHd.phys = @sysvar::MsgADAM_Position::SigADAMPosRelHd;
   Msg_ADAM_Position.ADAMPosProb.phys = @sysvar::MsgADAM_Position::SigADAMPosProb;
   Msg_ADAM_Position.ADAMPosCycCnt.phys = @sysvar::MsgADAM_Position::SigADAMPosCycCnt;
   Msg_ADAM_Position.ADAMPosAge.phys = @sysvar::MsgADAM_Position::SigADAMPosAge;
   Msg_ADAM_Position.ADAMPosPthIdx.phys = @sysvar::MsgADAM_Position::SigADAMPosPthIdx;
   Msg_ADAM_Position.ADAMPosPthLatOffstToRefLnMrk.phys = @sysvar::MsgADAM_Position::SigADAMPosPthLatOffstToRefLnMrk;
   Msg_ADAM_Position.ADAMPosIdxCrntLn.phys = @sysvar::MsgADAM_Position::SigADAMPosIdxCrntLn;
   output(Msg_ADAM_Position);
   Msg_VIS_ObjInfo_01.VIS_Obj01_accel_lat.phys = @sysvar::MsgVIS_ObjInfo_01::SigVIS_Obj01_accel_lat;
   Msg_VIS_ObjInfo_01.VIS_Obj01_class.phys = @sysvar::MsgVIS_ObjInfo_01::SigVIS_Obj01_class;
   Msg_VIS_ObjInfo_01.VIS_Obj01_isCipv.phys = @sysvar::MsgVIS_ObjInfo_01::SigVIS_Obj01_isCipv;
   Msg_VIS_ObjInfo_01.VIS_Obj01_accel_long.phys = @sysvar::MsgVIS_ObjInfo_01::SigVIS_Obj01_accel_long;
   Msg_VIS_ObjInfo_01.VIS_Obj01_conf.phys = @sysvar::MsgVIS_ObjInfo_01::SigVIS_Obj01_conf;
   Msg_VIS_ObjInfo_01.VIS_Obj01_id.phys = @sysvar::MsgVIS_ObjInfo_01::SigVIS_Obj01_id;
   Msg_VIS_ObjInfo_01.VIS_Obj01_posn_lat.phys = @sysvar::MsgVIS_ObjInfo_01::SigVIS_Obj01_posn_lat;
   Msg_VIS_ObjInfo_01.VIS_Obj01_posn_long.phys = @sysvar::MsgVIS_ObjInfo_01::SigVIS_Obj01_posn_long;
   Msg_VIS_ObjInfo_01.VIS_Obj01_vel_lat.phys = @sysvar::MsgVIS_ObjInfo_01::SigVIS_Obj01_vel_lat;
   Msg_VIS_ObjInfo_01.VIS_Obj01_vel_long.phys = @sysvar::MsgVIS_ObjInfo_01::SigVIS_Obj01_vel_long;
   Msg_VIS_ObjInfo_01.VIS_Obj01_ttc_const_vel.phys = @sysvar::MsgVIS_ObjInfo_01::SigVIS_Obj01_ttc_const_vel;
   output(Msg_VIS_ObjInfo_01);
   Msg_VIS_ObjInfo_02.VIS_Obj02_accel_lat.phys = @sysvar::MsgVIS_ObjInfo_02::SigVIS_Obj02_accel_lat;
   Msg_VIS_ObjInfo_02.VIS_Obj02_class.phys = @sysvar::MsgVIS_ObjInfo_02::SigVIS_Obj02_class;
   Msg_VIS_ObjInfo_02.VIS_Obj02_isCipv.phys = @sysvar::MsgVIS_ObjInfo_02::SigVIS_Obj02_isCipv;
   Msg_VIS_ObjInfo_02.VIS_Obj02_accel_long.phys = @sysvar::MsgVIS_ObjInfo_02::SigVIS_Obj02_accel_long;
   Msg_VIS_ObjInfo_02.VIS_Obj02_conf.phys = @sysvar::MsgVIS_ObjInfo_02::SigVIS_Obj02_conf;
   Msg_VIS_ObjInfo_02.VIS_Obj02_id.phys = @sysvar::MsgVIS_ObjInfo_02::SigVIS_Obj02_id;
   Msg_VIS_ObjInfo_02.VIS_Obj02_posn_lat.phys = @sysvar::MsgVIS_ObjInfo_02::SigVIS_Obj02_posn_lat;
   Msg_VIS_ObjInfo_02.VIS_Obj02_posn_long.phys = @sysvar::MsgVIS_ObjInfo_02::SigVIS_Obj02_posn_long;
   Msg_VIS_ObjInfo_02.VIS_Obj02_vel_lat.phys = @sysvar::MsgVIS_ObjInfo_02::SigVIS_Obj02_vel_lat;
   Msg_VIS_ObjInfo_02.VIS_Obj02_vel_long.phys = @sysvar::MsgVIS_ObjInfo_02::SigVIS_Obj02_vel_long;
   Msg_VIS_ObjInfo_02.VIS_Obj02_ttc_const_vel.phys = @sysvar::MsgVIS_ObjInfo_02::SigVIS_Obj02_ttc_const_vel;
   output(Msg_VIS_ObjInfo_02);
   Msg_VIS_ObjInfo_03.VIS_Obj03_accel_lat.phys = @sysvar::MsgVIS_ObjInfo_03::SigVIS_Obj03_accel_lat;
   Msg_VIS_ObjInfo_03.VIS_Obj03_class.phys = @sysvar::MsgVIS_ObjInfo_03::SigVIS_Obj03_class;
   Msg_VIS_ObjInfo_03.VIS_Obj03_isCipv.phys = @sysvar::MsgVIS_ObjInfo_03::SigVIS_Obj03_isCipv;
   Msg_VIS_ObjInfo_03.VIS_Obj03_accel_long.phys = @sysvar::MsgVIS_ObjInfo_03::SigVIS_Obj03_accel_long;
   Msg_VIS_ObjInfo_03.VIS_Obj03_conf.phys = @sysvar::MsgVIS_ObjInfo_03::SigVIS_Obj03_conf;
   Msg_VIS_ObjInfo_03.VIS_Obj03_id.phys = @sysvar::MsgVIS_ObjInfo_03::SigVIS_Obj03_id;
   Msg_VIS_ObjInfo_03.VIS_Obj03_posn_lat.phys = @sysvar::MsgVIS_ObjInfo_03::SigVIS_Obj03_posn_lat;
   Msg_VIS_ObjInfo_03.VIS_Obj03_posn_long.phys = @sysvar::MsgVIS_ObjInfo_03::SigVIS_Obj03_posn_long;
   Msg_VIS_ObjInfo_03.VIS_Obj03_vel_lat.phys = @sysvar::MsgVIS_ObjInfo_03::SigVIS_Obj03_vel_lat;
   Msg_VIS_ObjInfo_03.VIS_Obj03_vel_long.phys = @sysvar::MsgVIS_ObjInfo_03::SigVIS_Obj03_vel_long;
   Msg_VIS_ObjInfo_03.VIS_Obj03_ttc_const_vel.phys = @sysvar::MsgVIS_ObjInfo_03::SigVIS_Obj03_ttc_const_vel;
   output(Msg_VIS_ObjInfo_03);
   Msg_VIS_ObjInfo_04.VIS_Obj04_accel_lat.phys = @sysvar::MsgVIS_ObjInfo_04::SigVIS_Obj04_accel_lat;
   Msg_VIS_ObjInfo_04.VIS_Obj04_class.phys = @sysvar::MsgVIS_ObjInfo_04::SigVIS_Obj04_class;
   Msg_VIS_ObjInfo_04.VIS_Obj04_isCipv.phys = @sysvar::MsgVIS_ObjInfo_04::SigVIS_Obj04_isCipv;
   Msg_VIS_ObjInfo_04.VIS_Obj04_accel_long.phys = @sysvar::MsgVIS_ObjInfo_04::SigVIS_Obj04_accel_long;
   Msg_VIS_ObjInfo_04.VIS_Obj04_conf.phys = @sysvar::MsgVIS_ObjInfo_04::SigVIS_Obj04_conf;
   Msg_VIS_ObjInfo_04.VIS_Obj04_id.phys = @sysvar::MsgVIS_ObjInfo_04::SigVIS_Obj04_id;
   Msg_VIS_ObjInfo_04.VIS_Obj04_posn_lat.phys = @sysvar::MsgVIS_ObjInfo_04::SigVIS_Obj04_posn_lat;
   Msg_VIS_ObjInfo_04.VIS_Obj04_posn_long.phys = @sysvar::MsgVIS_ObjInfo_04::SigVIS_Obj04_posn_long;
   Msg_VIS_ObjInfo_04.VIS_Obj04_vel_lat.phys = @sysvar::MsgVIS_ObjInfo_04::SigVIS_Obj04_vel_lat;
   Msg_VIS_ObjInfo_04.VIS_Obj04_vel_long.phys = @sysvar::MsgVIS_ObjInfo_04::SigVIS_Obj04_vel_long;
   Msg_VIS_ObjInfo_04.VIS_Obj04_ttc_const_vel.phys = @sysvar::MsgVIS_ObjInfo_04::SigVIS_Obj04_ttc_const_vel;
   output(Msg_VIS_ObjInfo_04);
   Msg_VIS_ObjInfo_05.VIS_Obj05_accel_lat.phys = @sysvar::MsgVIS_ObjInfo_05::SigVIS_Obj05_accel_lat;
   Msg_VIS_ObjInfo_05.VIS_Obj05_class.phys = @sysvar::MsgVIS_ObjInfo_05::SigVIS_Obj05_class;
   Msg_VIS_ObjInfo_05.VIS_Obj05_isCipv.phys = @sysvar::MsgVIS_ObjInfo_05::SigVIS_Obj05_isCipv;
   Msg_VIS_ObjInfo_05.VIS_Obj05_accel_long.phys = @sysvar::MsgVIS_ObjInfo_05::SigVIS_Obj05_accel_long;
   Msg_VIS_ObjInfo_05.VIS_Obj05_conf.phys = @sysvar::MsgVIS_ObjInfo_05::SigVIS_Obj05_conf;
   Msg_VIS_ObjInfo_05.VIS_Obj05_id.phys = @sysvar::MsgVIS_ObjInfo_05::SigVIS_Obj05_id;
   Msg_VIS_ObjInfo_05.VIS_Obj05_posn_lat.phys = @sysvar::MsgVIS_ObjInfo_05::SigVIS_Obj05_posn_lat;
   Msg_VIS_ObjInfo_05.VIS_Obj05_posn_long.phys = @sysvar::MsgVIS_ObjInfo_05::SigVIS_Obj05_posn_long;
   Msg_VIS_ObjInfo_05.VIS_Obj05_vel_lat.phys = @sysvar::MsgVIS_ObjInfo_05::SigVIS_Obj05_vel_lat;
   Msg_VIS_ObjInfo_05.VIS_Obj05_vel_long.phys = @sysvar::MsgVIS_ObjInfo_05::SigVIS_Obj05_vel_long;
   Msg_VIS_ObjInfo_05.VIS_Obj05_ttc_const_vel.phys = @sysvar::MsgVIS_ObjInfo_05::SigVIS_Obj05_ttc_const_vel;
   output(Msg_VIS_ObjInfo_05);
   Msg_VIS_ObjInfo_06.VIS_Obj06_accel_lat.phys = @sysvar::MsgVIS_ObjInfo_06::SigVIS_Obj06_accel_lat;
   Msg_VIS_ObjInfo_06.VIS_Obj06_class.phys = @sysvar::MsgVIS_ObjInfo_06::SigVIS_Obj06_class;
   Msg_VIS_ObjInfo_06.VIS_Obj06_isCipv.phys = @sysvar::MsgVIS_ObjInfo_06::SigVIS_Obj06_isCipv;
   Msg_VIS_ObjInfo_06.VIS_Obj06_accel_long.phys = @sysvar::MsgVIS_ObjInfo_06::SigVIS_Obj06_accel_long;
   Msg_VIS_ObjInfo_06.VIS_Obj06_conf.phys = @sysvar::MsgVIS_ObjInfo_06::SigVIS_Obj06_conf;
   Msg_VIS_ObjInfo_06.VIS_Obj06_id.phys = @sysvar::MsgVIS_ObjInfo_06::SigVIS_Obj06_id;
   Msg_VIS_ObjInfo_06.VIS_Obj06_posn_lat.phys = @sysvar::MsgVIS_ObjInfo_06::SigVIS_Obj06_posn_lat;
   Msg_VIS_ObjInfo_06.VIS_Obj06_posn_long.phys = @sysvar::MsgVIS_ObjInfo_06::SigVIS_Obj06_posn_long;
   Msg_VIS_ObjInfo_06.VIS_Obj06_vel_lat.phys = @sysvar::MsgVIS_ObjInfo_06::SigVIS_Obj06_vel_lat;
   Msg_VIS_ObjInfo_06.VIS_Obj06_vel_long.phys = @sysvar::MsgVIS_ObjInfo_06::SigVIS_Obj06_vel_long;
   Msg_VIS_ObjInfo_06.VIS_Obj06_ttc_const_vel.phys = @sysvar::MsgVIS_ObjInfo_06::SigVIS_Obj06_ttc_const_vel;
   output(Msg_VIS_ObjInfo_06);
   Msg_VIS_ObjInfo_07.VIS_Obj07_accel_lat.phys = @sysvar::MsgVIS_ObjInfo_07::SigVIS_Obj07_accel_lat;
   Msg_VIS_ObjInfo_07.VIS_Obj07_class.phys = @sysvar::MsgVIS_ObjInfo_07::SigVIS_Obj07_class;
   Msg_VIS_ObjInfo_07.VIS_Obj07_isCipv.phys = @sysvar::MsgVIS_ObjInfo_07::SigVIS_Obj07_isCipv;
   Msg_VIS_ObjInfo_07.VIS_Obj07_accel_long.phys = @sysvar::MsgVIS_ObjInfo_07::SigVIS_Obj07_accel_long;
   Msg_VIS_ObjInfo_07.VIS_Obj07_conf.phys = @sysvar::MsgVIS_ObjInfo_07::SigVIS_Obj07_conf;
   Msg_VIS_ObjInfo_07.VIS_Obj07_id.phys = @sysvar::MsgVIS_ObjInfo_07::SigVIS_Obj07_id;
   Msg_VIS_ObjInfo_07.VIS_Obj07_posn_lat.phys = @sysvar::MsgVIS_ObjInfo_07::SigVIS_Obj07_posn_lat;
   Msg_VIS_ObjInfo_07.VIS_Obj07_posn_long.phys = @sysvar::MsgVIS_ObjInfo_07::SigVIS_Obj07_posn_long;
   Msg_VIS_ObjInfo_07.VIS_Obj07_vel_lat.phys = @sysvar::MsgVIS_ObjInfo_07::SigVIS_Obj07_vel_lat;
   Msg_VIS_ObjInfo_07.VIS_Obj07_vel_long.phys = @sysvar::MsgVIS_ObjInfo_07::SigVIS_Obj07_vel_long;
   Msg_VIS_ObjInfo_07.VIS_Obj07_ttc_const_vel.phys = @sysvar::MsgVIS_ObjInfo_07::SigVIS_Obj07_ttc_const_vel;
   output(Msg_VIS_ObjInfo_07);
   Msg_VIS_ObjInfo_08.VIS_Obj08_accel_lat.phys = @sysvar::MsgVIS_ObjInfo_08::SigVIS_Obj08_accel_lat;
   Msg_VIS_ObjInfo_08.VIS_Obj08_class.phys = @sysvar::MsgVIS_ObjInfo_08::SigVIS_Obj08_class;
   Msg_VIS_ObjInfo_08.VIS_Obj08_isCipv.phys = @sysvar::MsgVIS_ObjInfo_08::SigVIS_Obj08_isCipv;
   Msg_VIS_ObjInfo_08.VIS_Obj08_accel_long.phys = @sysvar::MsgVIS_ObjInfo_08::SigVIS_Obj08_accel_long;
   Msg_VIS_ObjInfo_08.VIS_Obj08_conf.phys = @sysvar::MsgVIS_ObjInfo_08::SigVIS_Obj08_conf;
   Msg_VIS_ObjInfo_08.VIS_Obj08_id.phys = @sysvar::MsgVIS_ObjInfo_08::SigVIS_Obj08_id;
   Msg_VIS_ObjInfo_08.VIS_Obj08_posn_lat.phys = @sysvar::MsgVIS_ObjInfo_08::SigVIS_Obj08_posn_lat;
   Msg_VIS_ObjInfo_08.VIS_Obj08_posn_long.phys = @sysvar::MsgVIS_ObjInfo_08::SigVIS_Obj08_posn_long;
   Msg_VIS_ObjInfo_08.VIS_Obj08_vel_lat.phys = @sysvar::MsgVIS_ObjInfo_08::SigVIS_Obj08_vel_lat;
   Msg_VIS_ObjInfo_08.VIS_Obj08_vel_long.phys = @sysvar::MsgVIS_ObjInfo_08::SigVIS_Obj08_vel_long;
   Msg_VIS_ObjInfo_08.VIS_Obj08_ttc_const_vel.phys = @sysvar::MsgVIS_ObjInfo_08::SigVIS_Obj08_ttc_const_vel;
   output(Msg_VIS_ObjInfo_08);
   Msg_VIS_ObjInfo_09.VIS_Obj09_accel_lat.phys = @sysvar::MsgVIS_ObjInfo_09::SigVIS_Obj09_accel_lat;
   Msg_VIS_ObjInfo_09.VIS_Obj09_class.phys = @sysvar::MsgVIS_ObjInfo_09::SigVIS_Obj09_class;
   Msg_VIS_ObjInfo_09.VIS_Obj09_isCipv.phys = @sysvar::MsgVIS_ObjInfo_09::SigVIS_Obj09_isCipv;
   Msg_VIS_ObjInfo_09.VIS_Obj09_accel_long.phys = @sysvar::MsgVIS_ObjInfo_09::SigVIS_Obj09_accel_long;
   Msg_VIS_ObjInfo_09.VIS_Obj09_conf.phys = @sysvar::MsgVIS_ObjInfo_09::SigVIS_Obj09_conf;
   Msg_VIS_ObjInfo_09.VIS_Obj09_id.phys = @sysvar::MsgVIS_ObjInfo_09::SigVIS_Obj09_id;
   Msg_VIS_ObjInfo_09.VIS_Obj09_posn_lat.phys = @sysvar::MsgVIS_ObjInfo_09::SigVIS_Obj09_posn_lat;
   Msg_VIS_ObjInfo_09.VIS_Obj09_posn_long.phys = @sysvar::MsgVIS_ObjInfo_09::SigVIS_Obj09_posn_long;
   Msg_VIS_ObjInfo_09.VIS_Obj09_vel_lat.phys = @sysvar::MsgVIS_ObjInfo_09::SigVIS_Obj09_vel_lat;
   Msg_VIS_ObjInfo_09.VIS_Obj09_vel_long.phys = @sysvar::MsgVIS_ObjInfo_09::SigVIS_Obj09_vel_long;
   Msg_VIS_ObjInfo_09.VIS_Obj09_ttc_const_vel.phys = @sysvar::MsgVIS_ObjInfo_09::SigVIS_Obj09_ttc_const_vel;
   output(Msg_VIS_ObjInfo_09);
   Msg_VIS_ObjInfo_10.VIS_Obj10_accel_lat.phys = @sysvar::MsgVIS_ObjInfo_10::SigVIS_Obj10_accel_lat;
   Msg_VIS_ObjInfo_10.VIS_Obj10_class.phys = @sysvar::MsgVIS_ObjInfo_10::SigVIS_Obj10_class;
   Msg_VIS_ObjInfo_10.VIS_Obj10_isCipv.phys = @sysvar::MsgVIS_ObjInfo_10::SigVIS_Obj10_isCipv;
   Msg_VIS_ObjInfo_10.VIS_Obj10_accel_long.phys = @sysvar::MsgVIS_ObjInfo_10::SigVIS_Obj10_accel_long;
   Msg_VIS_ObjInfo_10.VIS_Obj10_conf.phys = @sysvar::MsgVIS_ObjInfo_10::SigVIS_Obj10_conf;
   Msg_VIS_ObjInfo_10.VIS_Obj10_id.phys = @sysvar::MsgVIS_ObjInfo_10::SigVIS_Obj10_id;
   Msg_VIS_ObjInfo_10.VIS_Obj10_posn_lat.phys = @sysvar::MsgVIS_ObjInfo_10::SigVIS_Obj10_posn_lat;
   Msg_VIS_ObjInfo_10.VIS_Obj10_posn_long.phys = @sysvar::MsgVIS_ObjInfo_10::SigVIS_Obj10_posn_long;
   Msg_VIS_ObjInfo_10.VIS_Obj10_vel_lat.phys = @sysvar::MsgVIS_ObjInfo_10::SigVIS_Obj10_vel_lat;
   Msg_VIS_ObjInfo_10.VIS_Obj10_vel_long.phys = @sysvar::MsgVIS_ObjInfo_10::SigVIS_Obj10_vel_long;
   Msg_VIS_ObjInfo_10.VIS_Obj10_ttc_const_vel.phys = @sysvar::MsgVIS_ObjInfo_10::SigVIS_Obj10_ttc_const_vel;
   output(Msg_VIS_ObjInfo_10);
   Msg_VIS_ObjInfo_11.VIS_Obj11_accel_lat.phys = @sysvar::MsgVIS_ObjInfo_11::SigVIS_Obj11_accel_lat;
   Msg_VIS_ObjInfo_11.VIS_Obj11_class.phys = @sysvar::MsgVIS_ObjInfo_11::SigVIS_Obj11_class;
   Msg_VIS_ObjInfo_11.VIS_Obj11_isCipv.phys = @sysvar::MsgVIS_ObjInfo_11::SigVIS_Obj11_isCipv;
   Msg_VIS_ObjInfo_11.VIS_Obj11_accel_long.phys = @sysvar::MsgVIS_ObjInfo_11::SigVIS_Obj11_accel_long;
   Msg_VIS_ObjInfo_11.VIS_Obj11_conf.phys = @sysvar::MsgVIS_ObjInfo_11::SigVIS_Obj11_conf;
   Msg_VIS_ObjInfo_11.VIS_Obj11_id.phys = @sysvar::MsgVIS_ObjInfo_11::SigVIS_Obj11_id;
   Msg_VIS_ObjInfo_11.VIS_Obj11_posn_lat.phys = @sysvar::MsgVIS_ObjInfo_11::SigVIS_Obj11_posn_lat;
   Msg_VIS_ObjInfo_11.VIS_Obj11_posn_long.phys = @sysvar::MsgVIS_ObjInfo_11::SigVIS_Obj11_posn_long;
   Msg_VIS_ObjInfo_11.VIS_Obj11_vel_lat.phys = @sysvar::MsgVIS_ObjInfo_11::SigVIS_Obj11_vel_lat;
   Msg_VIS_ObjInfo_11.VIS_Obj11_vel_long.phys = @sysvar::MsgVIS_ObjInfo_11::SigVIS_Obj11_vel_long;
   Msg_VIS_ObjInfo_11.VIS_Obj11_ttc_const_vel.phys = @sysvar::MsgVIS_ObjInfo_11::SigVIS_Obj11_ttc_const_vel;
   output(Msg_VIS_ObjInfo_11);
   Msg_VIS_ObjInfo_12.VIS_Obj12_accel_lat.phys = @sysvar::MsgVIS_ObjInfo_12::SigVIS_Obj12_accel_lat;
   Msg_VIS_ObjInfo_12.VIS_Obj12_class.phys = @sysvar::MsgVIS_ObjInfo_12::SigVIS_Obj12_class;
   Msg_VIS_ObjInfo_12.VIS_Obj12_isCipv.phys = @sysvar::MsgVIS_ObjInfo_12::SigVIS_Obj12_isCipv;
   Msg_VIS_ObjInfo_12.VIS_Obj12_accel_long.phys = @sysvar::MsgVIS_ObjInfo_12::SigVIS_Obj12_accel_long;
   Msg_VIS_ObjInfo_12.VIS_Obj12_conf.phys = @sysvar::MsgVIS_ObjInfo_12::SigVIS_Obj12_conf;
   Msg_VIS_ObjInfo_12.VIS_Obj12_id.phys = @sysvar::MsgVIS_ObjInfo_12::SigVIS_Obj12_id;
   Msg_VIS_ObjInfo_12.VIS_Obj12_posn_lat.phys = @sysvar::MsgVIS_ObjInfo_12::SigVIS_Obj12_posn_lat;
   Msg_VIS_ObjInfo_12.VIS_Obj12_posn_long.phys = @sysvar::MsgVIS_ObjInfo_12::SigVIS_Obj12_posn_long;
   Msg_VIS_ObjInfo_12.VIS_Obj12_vel_lat.phys = @sysvar::MsgVIS_ObjInfo_12::SigVIS_Obj12_vel_lat;
   Msg_VIS_ObjInfo_12.VIS_Obj12_vel_long.phys = @sysvar::MsgVIS_ObjInfo_12::SigVIS_Obj12_vel_long;
   Msg_VIS_ObjInfo_12.VIS_Obj12_ttc_const_vel.phys = @sysvar::MsgVIS_ObjInfo_12::SigVIS_Obj12_ttc_const_vel;
   output(Msg_VIS_ObjInfo_12);
   Msg_VIS_ObjInfo_13.VIS_Obj13_accel_lat.phys = @sysvar::MsgVIS_ObjInfo_13::SigVIS_Obj13_accel_lat;
   Msg_VIS_ObjInfo_13.VIS_Obj13_class.phys = @sysvar::MsgVIS_ObjInfo_13::SigVIS_Obj13_class;
   Msg_VIS_ObjInfo_13.VIS_Obj13_isCipv.phys = @sysvar::MsgVIS_ObjInfo_13::SigVIS_Obj13_isCipv;
   Msg_VIS_ObjInfo_13.VIS_Obj13_accel_long.phys = @sysvar::MsgVIS_ObjInfo_13::SigVIS_Obj13_accel_long;
   Msg_VIS_ObjInfo_13.VIS_Obj13_conf.phys = @sysvar::MsgVIS_ObjInfo_13::SigVIS_Obj13_conf;
   Msg_VIS_ObjInfo_13.VIS_Obj13_id.phys = @sysvar::MsgVIS_ObjInfo_13::SigVIS_Obj13_id;
   Msg_VIS_ObjInfo_13.VIS_Obj13_posn_lat.phys = @sysvar::MsgVIS_ObjInfo_13::SigVIS_Obj13_posn_lat;
   Msg_VIS_ObjInfo_13.VIS_Obj13_posn_long.phys = @sysvar::MsgVIS_ObjInfo_13::SigVIS_Obj13_posn_long;
   Msg_VIS_ObjInfo_13.VIS_Obj13_vel_lat.phys = @sysvar::MsgVIS_ObjInfo_13::SigVIS_Obj13_vel_lat;
   Msg_VIS_ObjInfo_13.VIS_Obj13_vel_long.phys = @sysvar::MsgVIS_ObjInfo_13::SigVIS_Obj13_vel_long;
   Msg_VIS_ObjInfo_13.VIS_Obj13_ttc_const_vel.phys = @sysvar::MsgVIS_ObjInfo_13::SigVIS_Obj13_ttc_const_vel;
   output(Msg_VIS_ObjInfo_13);
   Msg_VIS_ObjInfo_14.VIS_Obj14_accel_lat.phys = @sysvar::MsgVIS_ObjInfo_14::SigVIS_Obj14_accel_lat;
   Msg_VIS_ObjInfo_14.VIS_Obj14_class.phys = @sysvar::MsgVIS_ObjInfo_14::SigVIS_Obj14_class;
   Msg_VIS_ObjInfo_14.VIS_Obj14_isCipv.phys = @sysvar::MsgVIS_ObjInfo_14::SigVIS_Obj14_isCipv;
   Msg_VIS_ObjInfo_14.VIS_Obj14_accel_long.phys = @sysvar::MsgVIS_ObjInfo_14::SigVIS_Obj14_accel_long;
   Msg_VIS_ObjInfo_14.VIS_Obj14_conf.phys = @sysvar::MsgVIS_ObjInfo_14::SigVIS_Obj14_conf;
   Msg_VIS_ObjInfo_14.VIS_Obj14_id.phys = @sysvar::MsgVIS_ObjInfo_14::SigVIS_Obj14_id;
   Msg_VIS_ObjInfo_14.VIS_Obj14_posn_lat.phys = @sysvar::MsgVIS_ObjInfo_14::SigVIS_Obj14_posn_lat;
   Msg_VIS_ObjInfo_14.VIS_Obj14_posn_long.phys = @sysvar::MsgVIS_ObjInfo_14::SigVIS_Obj14_posn_long;
   Msg_VIS_ObjInfo_14.VIS_Obj14_vel_lat.phys = @sysvar::MsgVIS_ObjInfo_14::SigVIS_Obj14_vel_lat;
   Msg_VIS_ObjInfo_14.VIS_Obj14_vel_long.phys = @sysvar::MsgVIS_ObjInfo_14::SigVIS_Obj14_vel_long;
   Msg_VIS_ObjInfo_14.VIS_Obj14_ttc_const_vel.phys = @sysvar::MsgVIS_ObjInfo_14::SigVIS_Obj14_ttc_const_vel;
   output(Msg_VIS_ObjInfo_14);
   Msg_VIS_ObjInfo_15.VIS_Obj15_accel_lat.phys = @sysvar::MsgVIS_ObjInfo_15::SigVIS_Obj15_accel_lat;
   Msg_VIS_ObjInfo_15.VIS_Obj15_class.phys = @sysvar::MsgVIS_ObjInfo_15::SigVIS_Obj15_class;
   Msg_VIS_ObjInfo_15.VIS_Obj15_isCipv.phys = @sysvar::MsgVIS_ObjInfo_15::SigVIS_Obj15_isCipv;
   Msg_VIS_ObjInfo_15.VIS_Obj15_accel_long.phys = @sysvar::MsgVIS_ObjInfo_15::SigVIS_Obj15_accel_long;
   Msg_VIS_ObjInfo_15.VIS_Obj15_conf.phys = @sysvar::MsgVIS_ObjInfo_15::SigVIS_Obj15_conf;
   Msg_VIS_ObjInfo_15.VIS_Obj15_id.phys = @sysvar::MsgVIS_ObjInfo_15::SigVIS_Obj15_id;
   Msg_VIS_ObjInfo_15.VIS_Obj15_posn_lat.phys = @sysvar::MsgVIS_ObjInfo_15::SigVIS_Obj15_posn_lat;
   Msg_VIS_ObjInfo_15.VIS_Obj15_posn_long.phys = @sysvar::MsgVIS_ObjInfo_15::SigVIS_Obj15_posn_long;
   Msg_VIS_ObjInfo_15.VIS_Obj15_vel_lat.phys = @sysvar::MsgVIS_ObjInfo_15::SigVIS_Obj15_vel_lat;
   Msg_VIS_ObjInfo_15.VIS_Obj15_vel_long.phys = @sysvar::MsgVIS_ObjInfo_15::SigVIS_Obj15_vel_long;
   Msg_VIS_ObjInfo_15.VIS_Obj15_ttc_const_vel.phys = @sysvar::MsgVIS_ObjInfo_15::SigVIS_Obj15_ttc_const_vel;
   output(Msg_VIS_ObjInfo_15);
   Msg_VIS_EYEQ_SDM.EyeQ_SDM_AlgoPtchMsmtch.phys = @sysvar::MsgVIS_EYEQ_SDM::SigEyeQ_SDM_AlgoPtchMsmtch;
   Msg_VIS_EYEQ_SDM.EyeQ_SDM_PedOvlpFlt.phys = @sysvar::MsgVIS_EYEQ_SDM::SigEyeQ_SDM_PedOvlpFlt;
   Msg_VIS_EYEQ_SDM.EyeQ_SDM_PedPrdctVldt.phys = @sysvar::MsgVIS_EYEQ_SDM::SigEyeQ_SDM_PedPrdctVldt;
   Msg_VIS_EYEQ_SDM.EyeQ_SDM_RdBndryCrrctVldt.phys = @sysvar::MsgVIS_EYEQ_SDM::SigEyeQ_SDM_RdBndryCrrctVldt;
   Msg_VIS_EYEQ_SDM.EyeQ_SDM_RdLnDisQlfctFld.phys = @sysvar::MsgVIS_EYEQ_SDM::SigEyeQ_SDM_RdLnDisQlfctFld;
   Msg_VIS_EYEQ_SDM.EyeQ_SDM_RdLnWdthVldt.phys = @sysvar::MsgVIS_EYEQ_SDM::SigEyeQ_SDM_RdLnWdthVldt;
   Msg_VIS_EYEQ_SDM.EyeQ_SDM_RdPpVldt.phys = @sysvar::MsgVIS_EYEQ_SDM::SigEyeQ_SDM_RdPpVldt;
   Msg_VIS_EYEQ_SDM.EyeQ_SDM_RdPrdctVldt.phys = @sysvar::MsgVIS_EYEQ_SDM::SigEyeQ_SDM_RdPrdctVldt;
   Msg_VIS_EYEQ_SDM.EyeQ_SDM_VdOvlpFlt.phys = @sysvar::MsgVIS_EYEQ_SDM::SigEyeQ_SDM_VdOvlpFlt;
   Msg_VIS_EYEQ_SDM.EyeQ_SDM_VdPrdctVldt.phys = @sysvar::MsgVIS_EYEQ_SDM::SigEyeQ_SDM_VdPrdctVldt;
   output(Msg_VIS_EYEQ_SDM);
   Msg_VIS_EYEQ_FAILSAFE.EyeQFailSafe_rainSeverityLevel.phys = @sysvar::MsgVIS_EYEQ_FAILSAFE::SigEyeQFailSafe_rainSeverityLevel;
   Msg_VIS_EYEQ_FAILSAFE.EyeQFailSafe_lowSunSeverityLevel.phys = @sysvar::MsgVIS_EYEQ_FAILSAFE::SigEyeQFailSafe_lowSunSeverityLevel;
   output(Msg_VIS_EYEQ_FAILSAFE);
   Msg_VIS_AEB.visOnlyVRUBrake.phys = @sysvar::MsgVIS_AEB::SigvisOnlyVRUBrake;
   Msg_VIS_AEB.visOnlyVRUPartialBrake.phys = @sysvar::MsgVIS_AEB::SigvisOnlyVRUPartialBrake;
   Msg_VIS_AEB.visOnlyVRUWarning.phys = @sysvar::MsgVIS_AEB::SigvisOnlyVRUWarning;
   output(Msg_VIS_AEB);
   Msg_Aptiv_DOW_TargetSelection.DOW_id_left.phys = @sysvar::MsgAptiv_DOW_TargetSelection::SigDOW_id_left;
   Msg_Aptiv_DOW_TargetSelection.DOW_id_right.phys = @sysvar::MsgAptiv_DOW_TargetSelection::SigDOW_id_right;
   Msg_Aptiv_DOW_TargetSelection.DOW_obj_len_left.phys = @sysvar::MsgAptiv_DOW_TargetSelection::SigDOW_obj_len_left;
   Msg_Aptiv_DOW_TargetSelection.DOW_obj_len_right.phys = @sysvar::MsgAptiv_DOW_TargetSelection::SigDOW_obj_len_right;
   Msg_Aptiv_DOW_TargetSelection.DOW_obj_ttc_left.phys = @sysvar::MsgAptiv_DOW_TargetSelection::SigDOW_obj_ttc_left;
   Msg_Aptiv_DOW_TargetSelection.DOW_obj_ttc_right.phys = @sysvar::MsgAptiv_DOW_TargetSelection::SigDOW_obj_ttc_right;
   Msg_Aptiv_DOW_TargetSelection.DOW_obj_wid_left.phys = @sysvar::MsgAptiv_DOW_TargetSelection::SigDOW_obj_wid_left;
   Msg_Aptiv_DOW_TargetSelection.DOW_obj_wid_right.phys = @sysvar::MsgAptiv_DOW_TargetSelection::SigDOW_obj_wid_right;
   Msg_Aptiv_DOW_TargetSelection.DOW_vcs_lat_pos_left.phys = @sysvar::MsgAptiv_DOW_TargetSelection::SigDOW_vcs_lat_pos_left;
   Msg_Aptiv_DOW_TargetSelection.DOW_vcs_lat_pos_right.phys = @sysvar::MsgAptiv_DOW_TargetSelection::SigDOW_vcs_lat_pos_right;
   Msg_Aptiv_DOW_TargetSelection.DOW_vcs_lat_vel_left.phys = @sysvar::MsgAptiv_DOW_TargetSelection::SigDOW_vcs_lat_vel_left;
   Msg_Aptiv_DOW_TargetSelection.DOW_vcs_lat_vel_right.phys = @sysvar::MsgAptiv_DOW_TargetSelection::SigDOW_vcs_lat_vel_right;
   Msg_Aptiv_DOW_TargetSelection.DOW_vcs_long_pos_left.phys = @sysvar::MsgAptiv_DOW_TargetSelection::SigDOW_vcs_long_pos_left;
   Msg_Aptiv_DOW_TargetSelection.DOW_vcs_long_pos_right.phys = @sysvar::MsgAptiv_DOW_TargetSelection::SigDOW_vcs_long_pos_right;
   Msg_Aptiv_DOW_TargetSelection.DOW_vcs_long_vel_left.phys = @sysvar::MsgAptiv_DOW_TargetSelection::SigDOW_vcs_long_vel_left;
   Msg_Aptiv_DOW_TargetSelection.DOW_vcs_long_vel_right.phys = @sysvar::MsgAptiv_DOW_TargetSelection::SigDOW_vcs_long_vel_right;
   output(Msg_Aptiv_DOW_TargetSelection);
   Msg_Aptiv_RCTA_TargetSelection.RCTA_id_left.phys = @sysvar::MsgAptiv_RCTA_TargetSelection::SigRCTA_id_left;
   Msg_Aptiv_RCTA_TargetSelection.RCTA_id_right.phys = @sysvar::MsgAptiv_RCTA_TargetSelection::SigRCTA_id_right;
   Msg_Aptiv_RCTA_TargetSelection.RCTA_obj_len_left.phys = @sysvar::MsgAptiv_RCTA_TargetSelection::SigRCTA_obj_len_left;
   Msg_Aptiv_RCTA_TargetSelection.RCTA_obj_len_right.phys = @sysvar::MsgAptiv_RCTA_TargetSelection::SigRCTA_obj_len_right;
   Msg_Aptiv_RCTA_TargetSelection.RCTA_obj_ttc_left.phys = @sysvar::MsgAptiv_RCTA_TargetSelection::SigRCTA_obj_ttc_left;
   Msg_Aptiv_RCTA_TargetSelection.RCTA_obj_ttc_right.phys = @sysvar::MsgAptiv_RCTA_TargetSelection::SigRCTA_obj_ttc_right;
   Msg_Aptiv_RCTA_TargetSelection.RCTA_obj_wid_left.phys = @sysvar::MsgAptiv_RCTA_TargetSelection::SigRCTA_obj_wid_left;
   Msg_Aptiv_RCTA_TargetSelection.RCTA_obj_wid_right.phys = @sysvar::MsgAptiv_RCTA_TargetSelection::SigRCTA_obj_wid_right;
   Msg_Aptiv_RCTA_TargetSelection.RCTA_vcs_lat_pos_left.phys = @sysvar::MsgAptiv_RCTA_TargetSelection::SigRCTA_vcs_lat_pos_left;
   Msg_Aptiv_RCTA_TargetSelection.RCTA_vcs_lat_pos_right.phys = @sysvar::MsgAptiv_RCTA_TargetSelection::SigRCTA_vcs_lat_pos_right;
   Msg_Aptiv_RCTA_TargetSelection.RCTA_vcs_lat_vel_left.phys = @sysvar::MsgAptiv_RCTA_TargetSelection::SigRCTA_vcs_lat_vel_left;
   Msg_Aptiv_RCTA_TargetSelection.RCTA_vcs_lat_vel_right.phys = @sysvar::MsgAptiv_RCTA_TargetSelection::SigRCTA_vcs_lat_vel_right;
   Msg_Aptiv_RCTA_TargetSelection.RCTA_vcs_long_pos_left.phys = @sysvar::MsgAptiv_RCTA_TargetSelection::SigRCTA_vcs_long_pos_left;
   Msg_Aptiv_RCTA_TargetSelection.RCTA_vcs_long_pos_right.phys = @sysvar::MsgAptiv_RCTA_TargetSelection::SigRCTA_vcs_long_pos_right;
   Msg_Aptiv_RCTA_TargetSelection.RCTA_vcs_long_vel_left.phys = @sysvar::MsgAptiv_RCTA_TargetSelection::SigRCTA_vcs_long_vel_left;
   Msg_Aptiv_RCTA_TargetSelection.RCTA_vcs_long_vel_right.phys = @sysvar::MsgAptiv_RCTA_TargetSelection::SigRCTA_vcs_long_vel_right;
   output(Msg_Aptiv_RCTA_TargetSelection);
   Msg_Aptiv_SBZA_TargetSelection.SBZA_id_left.phys = @sysvar::MsgAptiv_SBZA_TargetSelection::SigSBZA_id_left;
   Msg_Aptiv_SBZA_TargetSelection.SBZA_id_right.phys = @sysvar::MsgAptiv_SBZA_TargetSelection::SigSBZA_id_right;
   Msg_Aptiv_SBZA_TargetSelection.SBZA_obj_len_left.phys = @sysvar::MsgAptiv_SBZA_TargetSelection::SigSBZA_obj_len_left;
   Msg_Aptiv_SBZA_TargetSelection.SBZA_obj_len_right.phys = @sysvar::MsgAptiv_SBZA_TargetSelection::SigSBZA_obj_len_right;
   Msg_Aptiv_SBZA_TargetSelection.SBZA_obj_wid_left.phys = @sysvar::MsgAptiv_SBZA_TargetSelection::SigSBZA_obj_wid_left;
   Msg_Aptiv_SBZA_TargetSelection.SBZA_obj_wid_right.phys = @sysvar::MsgAptiv_SBZA_TargetSelection::SigSBZA_obj_wid_right;
   Msg_Aptiv_SBZA_TargetSelection.SBZA_vcs_lat_pos_left.phys = @sysvar::MsgAptiv_SBZA_TargetSelection::SigSBZA_vcs_lat_pos_left;
   Msg_Aptiv_SBZA_TargetSelection.SBZA_vcs_lat_pos_right.phys = @sysvar::MsgAptiv_SBZA_TargetSelection::SigSBZA_vcs_lat_pos_right;
   Msg_Aptiv_SBZA_TargetSelection.SBZA_vcs_lat_vel_left.phys = @sysvar::MsgAptiv_SBZA_TargetSelection::SigSBZA_vcs_lat_vel_left;
   Msg_Aptiv_SBZA_TargetSelection.SBZA_vcs_lat_vel_right.phys = @sysvar::MsgAptiv_SBZA_TargetSelection::SigSBZA_vcs_lat_vel_right;
   Msg_Aptiv_SBZA_TargetSelection.SBZA_vcs_long_pos_left.phys = @sysvar::MsgAptiv_SBZA_TargetSelection::SigSBZA_vcs_long_pos_left;
   Msg_Aptiv_SBZA_TargetSelection.SBZA_vcs_long_pos_right.phys = @sysvar::MsgAptiv_SBZA_TargetSelection::SigSBZA_vcs_long_pos_right;
   Msg_Aptiv_SBZA_TargetSelection.SBZA_vcs_long_vel_left.phys = @sysvar::MsgAptiv_SBZA_TargetSelection::SigSBZA_vcs_long_vel_left;
   Msg_Aptiv_SBZA_TargetSelection.SBZA_vcs_long_vel_right.phys = @sysvar::MsgAptiv_SBZA_TargetSelection::SigSBZA_vcs_long_vel_right;
   output(Msg_Aptiv_SBZA_TargetSelection);
   Msg_Aptiv_LCA_TargetSelection.LCA_id_left.phys = @sysvar::MsgAptiv_LCA_TargetSelection::SigLCA_id_left;
   Msg_Aptiv_LCA_TargetSelection.LCA_id_right.phys = @sysvar::MsgAptiv_LCA_TargetSelection::SigLCA_id_right;
   Msg_Aptiv_LCA_TargetSelection.LCA_obj_len_left.phys = @sysvar::MsgAptiv_LCA_TargetSelection::SigLCA_obj_len_left;
   Msg_Aptiv_LCA_TargetSelection.LCA_obj_len_right.phys = @sysvar::MsgAptiv_LCA_TargetSelection::SigLCA_obj_len_right;
   Msg_Aptiv_LCA_TargetSelection.LCA_obj_ttc_left.phys = @sysvar::MsgAptiv_LCA_TargetSelection::SigLCA_obj_ttc_left;
   Msg_Aptiv_LCA_TargetSelection.LCA_obj_ttc_right.phys = @sysvar::MsgAptiv_LCA_TargetSelection::SigLCA_obj_ttc_right;
   Msg_Aptiv_LCA_TargetSelection.LCA_obj_wid_left.phys = @sysvar::MsgAptiv_LCA_TargetSelection::SigLCA_obj_wid_left;
   Msg_Aptiv_LCA_TargetSelection.LCA_obj_wid_right.phys = @sysvar::MsgAptiv_LCA_TargetSelection::SigLCA_obj_wid_right;
   Msg_Aptiv_LCA_TargetSelection.LCA_curvi_lat_pos_left.phys = @sysvar::MsgAptiv_LCA_TargetSelection::SigLCA_curvi_lat_pos_left;
   Msg_Aptiv_LCA_TargetSelection.LCA_curvi_lat_pos_right.phys = @sysvar::MsgAptiv_LCA_TargetSelection::SigLCA_curvi_lat_pos_right;
   Msg_Aptiv_LCA_TargetSelection.LCA_curvi_lat_vel_left.phys = @sysvar::MsgAptiv_LCA_TargetSelection::SigLCA_curvi_lat_vel_left;
   Msg_Aptiv_LCA_TargetSelection.LCA_curvi_lat_vel_right.phys = @sysvar::MsgAptiv_LCA_TargetSelection::SigLCA_curvi_lat_vel_right;
   Msg_Aptiv_LCA_TargetSelection.LCA_curvi_long_pos_left.phys = @sysvar::MsgAptiv_LCA_TargetSelection::SigLCA_curvi_long_pos_left;
   Msg_Aptiv_LCA_TargetSelection.LCA_curvi_long_pos_right.phys = @sysvar::MsgAptiv_LCA_TargetSelection::SigLCA_curvi_long_pos_right;
   Msg_Aptiv_LCA_TargetSelection.LCA_curvi_long_vel_left.phys = @sysvar::MsgAptiv_LCA_TargetSelection::SigLCA_curvi_long_vel_left;
   Msg_Aptiv_LCA_TargetSelection.LCA_curvi_long_vel_right.phys = @sysvar::MsgAptiv_LCA_TargetSelection::SigLCA_curvi_long_vel_right;
   output(Msg_Aptiv_LCA_TargetSelection);
   Msg_Pedastrain_Info.Pedastrain_01_FusionID.phys = @sysvar::MsgPedastrain_Info::SigPedastrain_01_FusionID;
   Msg_Pedastrain_Info.Pedastrain_02_FusionID.phys = @sysvar::MsgPedastrain_Info::SigPedastrain_02_FusionID;
   Msg_Pedastrain_Info.Pedastrain_03_FusionID.phys = @sysvar::MsgPedastrain_Info::SigPedastrain_03_FusionID;
   Msg_Pedastrain_Info.Pedastrain_04_FusionID.phys = @sysvar::MsgPedastrain_Info::SigPedastrain_04_FusionID;
   Msg_Pedastrain_Info.Pedastrain_05_FusionID.phys = @sysvar::MsgPedastrain_Info::SigPedastrain_05_FusionID;
   Msg_Pedastrain_Info.Pedastrain_06_FusionID.phys = @sysvar::MsgPedastrain_Info::SigPedastrain_06_FusionID;
   Msg_Pedastrain_Info.Pedastrain_07_FusionID.phys = @sysvar::MsgPedastrain_Info::SigPedastrain_07_FusionID;
   Msg_Pedastrain_Info.Pedastrain_08_FusionID.phys = @sysvar::MsgPedastrain_Info::SigPedastrain_08_FusionID;
   Msg_Pedastrain_Info.Pedastrain_09_FusionID.phys = @sysvar::MsgPedastrain_Info::SigPedastrain_09_FusionID;
   Msg_Pedastrain_Info.Pedastrain_10_FusionID.phys = @sysvar::MsgPedastrain_Info::SigPedastrain_10_FusionID;
   output(Msg_Pedastrain_Info);
   Msg_TestEventMarker.EventMarker_FalseCount_AptivRef.phys = @sysvar::MsgTestEventMarker::SigEventMarker_FalseCount_AptivRef;
   Msg_TestEventMarker.EventMarker_MissCount_AptivRef.phys = @sysvar::MsgTestEventMarker::SigEventMarker_MissCount_AptivRef;
   Msg_TestEventMarker.EventMarker_TestProc.phys = @sysvar::MsgTestEventMarker::SigEventMarker_TestProc;
   Msg_TestEventMarker.EventMarker_TestResult.phys = @sysvar::MsgTestEventMarker::SigEventMarker_TestResult;
   Msg_TestEventMarker.EventMarker_hasFalseAlert.phys = @sysvar::MsgTestEventMarker::SigEventMarker_hasFalseAlert;
   Msg_TestEventMarker.EventMarker_hasMissAlert.phys = @sysvar::MsgTestEventMarker::SigEventMarker_hasMissAlert;
   output(Msg_TestEventMarker);
   Msg_VIS_LANE_ROADBORDER.VIS_ROADBORDER_LEFT_A0.phys = @sysvar::MsgVIS_LANE_ROADBORDER::SigVIS_ROADBORDER_LEFT_A0;
   Msg_VIS_LANE_ROADBORDER.VIS_ROADBORDER_LEFT_A1.phys = @sysvar::MsgVIS_LANE_ROADBORDER::SigVIS_ROADBORDER_LEFT_A1;
   Msg_VIS_LANE_ROADBORDER.VIS_ROADBORDER_LEFT_A2.phys = @sysvar::MsgVIS_LANE_ROADBORDER::SigVIS_ROADBORDER_LEFT_A2;
   Msg_VIS_LANE_ROADBORDER.VIS_ROADBORDER_LEFT_A3.phys = @sysvar::MsgVIS_LANE_ROADBORDER::SigVIS_ROADBORDER_LEFT_A3;
   Msg_VIS_LANE_ROADBORDER.VIS_ROADBORDER_LEFT_StaRange.phys = @sysvar::MsgVIS_LANE_ROADBORDER::SigVIS_ROADBORDER_LEFT_StaRange;
   Msg_VIS_LANE_ROADBORDER.VIS_ROADBORDER_LEFT_EndRange.phys = @sysvar::MsgVIS_LANE_ROADBORDER::SigVIS_ROADBORDER_LEFT_EndRange;
   Msg_VIS_LANE_ROADBORDER.VIS_ROADBORDER_LEFT_SFConf.phys = @sysvar::MsgVIS_LANE_ROADBORDER::SigVIS_ROADBORDER_LEFT_SFConf;
   Msg_VIS_LANE_ROADBORDER.VIS_ROADBORDER_LEFT_Conf.phys = @sysvar::MsgVIS_LANE_ROADBORDER::SigVIS_ROADBORDER_LEFT_Conf;
   Msg_VIS_LANE_ROADBORDER.VIS_ROADBORDER_LEFT_TYPE.phys = @sysvar::MsgVIS_LANE_ROADBORDER::SigVIS_ROADBORDER_LEFT_TYPE;
   Msg_VIS_LANE_ROADBORDER.VIS_ROADBORDER_RIGHT_A0.phys = @sysvar::MsgVIS_LANE_ROADBORDER::SigVIS_ROADBORDER_RIGHT_A0;
   Msg_VIS_LANE_ROADBORDER.VIS_ROADBORDER_RIGHT_A1.phys = @sysvar::MsgVIS_LANE_ROADBORDER::SigVIS_ROADBORDER_RIGHT_A1;
   Msg_VIS_LANE_ROADBORDER.VIS_ROADBORDER_RIGHT_A2.phys = @sysvar::MsgVIS_LANE_ROADBORDER::SigVIS_ROADBORDER_RIGHT_A2;
   Msg_VIS_LANE_ROADBORDER.VIS_ROADBORDER_RIGHT_A3.phys = @sysvar::MsgVIS_LANE_ROADBORDER::SigVIS_ROADBORDER_RIGHT_A3;
   Msg_VIS_LANE_ROADBORDER.VIS_ROADBORDER_RIGHT_StaRange.phys = @sysvar::MsgVIS_LANE_ROADBORDER::SigVIS_ROADBORDER_RIGHT_StaRange;
   Msg_VIS_LANE_ROADBORDER.VIS_ROADBORDER_RIGHT_EndRange.phys = @sysvar::MsgVIS_LANE_ROADBORDER::SigVIS_ROADBORDER_RIGHT_EndRange;
   Msg_VIS_LANE_ROADBORDER.VIS_ROADBORDER_RIGHT_SFConf.phys = @sysvar::MsgVIS_LANE_ROADBORDER::SigVIS_ROADBORDER_RIGHT_SFConf;
   Msg_VIS_LANE_ROADBORDER.VIS_ROADBORDER_RIGHT_Conf.phys = @sysvar::MsgVIS_LANE_ROADBORDER::SigVIS_ROADBORDER_RIGHT_Conf;
   Msg_VIS_LANE_ROADBORDER.VIS_ROADBORDER_RIGHT_TYPE.phys = @sysvar::MsgVIS_LANE_ROADBORDER::SigVIS_ROADBORDER_RIGHT_TYPE;
   output(Msg_VIS_LANE_ROADBORDER);
   Msg_VIS_Hpp_CenterLine.VIS_CenterLine_A0.phys = @sysvar::MsgVIS_Hpp_CenterLine::SigVIS_CenterLine_A0;
   Msg_VIS_Hpp_CenterLine.VIS_CenterLine_A1.phys = @sysvar::MsgVIS_Hpp_CenterLine::SigVIS_CenterLine_A1;
   Msg_VIS_Hpp_CenterLine.VIS_CenterLine_A2.phys = @sysvar::MsgVIS_Hpp_CenterLine::SigVIS_CenterLine_A2;
   Msg_VIS_Hpp_CenterLine.VIS_CenterLine_A3.phys = @sysvar::MsgVIS_Hpp_CenterLine::SigVIS_CenterLine_A3;
   Msg_VIS_Hpp_CenterLine.VIS_CenterLine_StaRange.phys = @sysvar::MsgVIS_Hpp_CenterLine::SigVIS_CenterLine_StaRange;
   Msg_VIS_Hpp_CenterLine.VIS_CenterLine_EndRange.phys = @sysvar::MsgVIS_Hpp_CenterLine::SigVIS_CenterLine_EndRange;
   Msg_VIS_Hpp_CenterLine.VIS_CenterLine_SFConf.phys = @sysvar::MsgVIS_Hpp_CenterLine::SigVIS_CenterLine_SFConf;
   Msg_VIS_Hpp_CenterLine.VIS_CenterLine_halfWidth.phys = @sysvar::MsgVIS_Hpp_CenterLine::SigVIS_CenterLine_halfWidth;
   output(Msg_VIS_Hpp_CenterLine);
   Msg_RTS2_DIS.RTS2_posn_long.phys = @sysvar::MsgRTS2_DIS::SigRTS2_posn_long;
   Msg_RTS2_DIS.RTS2_posn_lat.phys = @sysvar::MsgRTS2_DIS::SigRTS2_posn_lat;
   Msg_RTS2_DIS.RTS2_TrackID.phys = @sysvar::MsgRTS2_DIS::SigRTS2_TrackID;
   Msg_RTS2_DIS.RTS2_lane.phys = @sysvar::MsgRTS2_DIS::SigRTS2_lane;
   Msg_RTS2_DIS.RTS2_track_lane_confidence.phys = @sysvar::MsgRTS2_DIS::SigRTS2_track_lane_confidence;
   Msg_RTS2_DIS.RTS2_FARLeftRight.phys = @sysvar::MsgRTS2_DIS::SigRTS2_FARLeftRight;
   Msg_RTS2_DIS.RTS2_Status.phys = @sysvar::MsgRTS2_DIS::SigRTS2_Status;
   Msg_RTS2_DIS.RTS2_long_accel.phys = @sysvar::MsgRTS2_DIS::SigRTS2_long_accel;
   Msg_RTS2_DIS.RTS2_lat_accel.phys = @sysvar::MsgRTS2_DIS::SigRTS2_lat_accel;
   Msg_RTS2_DIS.RTS2_Movement.phys = @sysvar::MsgRTS2_DIS::SigRTS2_Movement;
   Msg_RTS2_DIS.RTS2_object_class.phys = @sysvar::MsgRTS2_DIS::SigRTS2_object_class;
   Msg_RTS2_DIS.RTS2_lat_vel.phys = @sysvar::MsgRTS2_DIS::SigRTS2_lat_vel;
   Msg_RTS2_DIS.RTS2_position_confidence.phys = @sysvar::MsgRTS2_DIS::SigRTS2_position_confidence;
   Msg_RTS2_DIS.RTS2_long_vel.phys = @sysvar::MsgRTS2_DIS::SigRTS2_long_vel;
   Msg_RTS2_DIS.RTS2_lane_HD.phys = @sysvar::MsgRTS2_DIS::SigRTS2_lane_HD;
   Msg_RTS2_DIS.RTS2_MessageCounter.phys = @sysvar::MsgRTS2_DIS::SigRTS2_MessageCounter;
   Msg_RTS2_DIS.RTS2_track_width.phys = @sysvar::MsgRTS2_DIS::SigRTS2_track_width;
   Msg_RTS2_DIS.RTS2_left_corner_long.phys = @sysvar::MsgRTS2_DIS::SigRTS2_left_corner_long;
   Msg_RTS2_DIS.RTS2_track_length.phys = @sysvar::MsgRTS2_DIS::SigRTS2_track_length;
   Msg_RTS2_DIS.RTS2_age.phys = @sysvar::MsgRTS2_DIS::SigRTS2_age;
   Msg_RTS2_DIS.RTS2_prob_det.phys = @sysvar::MsgRTS2_DIS::SigRTS2_prob_det;
   Msg_RTS2_DIS.RTS2_FARcorner_lat.phys = @sysvar::MsgRTS2_DIS::SigRTS2_FARcorner_lat;
   Msg_RTS2_DIS.RTS2_FARcorner_long.phys = @sysvar::MsgRTS2_DIS::SigRTS2_FARcorner_long;
   Msg_RTS2_DIS.RTS2_left_corner_lat.phys = @sysvar::MsgRTS2_DIS::SigRTS2_left_corner_lat;
   Msg_RTS2_DIS.RTS2_right_corner_lat.phys = @sysvar::MsgRTS2_DIS::SigRTS2_right_corner_lat;
   Msg_RTS2_DIS.RTS2_right_corner_long.phys = @sysvar::MsgRTS2_DIS::SigRTS2_right_corner_long;
   Msg_RTS2_DIS.RTS2_detectionSensor.phys = @sysvar::MsgRTS2_DIS::SigRTS2_detectionSensor;
   output(Msg_RTS2_DIS);
   Msg_RT6_DIS.RT6_posn_long.phys = @sysvar::MsgRT6_DIS::SigRT6_posn_long;
   Msg_RT6_DIS.RT6_long_vel.phys = @sysvar::MsgRT6_DIS::SigRT6_long_vel;
   Msg_RT6_DIS.RT6_posn_lat.phys = @sysvar::MsgRT6_DIS::SigRT6_posn_lat;
   Msg_RT6_DIS.RT6_lat_vel.phys = @sysvar::MsgRT6_DIS::SigRT6_lat_vel;
   Msg_RT6_DIS.RT6_long_accel.phys = @sysvar::MsgRT6_DIS::SigRT6_long_accel;
   Msg_RT6_DIS.RT6_FARLeftRight.phys = @sysvar::MsgRT6_DIS::SigRT6_FARLeftRight;
   Msg_RT6_DIS.RT6_lat_accel.phys = @sysvar::MsgRT6_DIS::SigRT6_lat_accel;
   Msg_RT6_DIS.RT6_lane.phys = @sysvar::MsgRT6_DIS::SigRT6_lane;
   Msg_RT6_DIS.RT6_Movement.phys = @sysvar::MsgRT6_DIS::SigRT6_Movement;
   Msg_RT6_DIS.RT6_status.phys = @sysvar::MsgRT6_DIS::SigRT6_status;
   Msg_RT6_DIS.RT6_track_lane_confidence.phys = @sysvar::MsgRT6_DIS::SigRT6_track_lane_confidence;
   Msg_RT6_DIS.RT6_object_class.phys = @sysvar::MsgRT6_DIS::SigRT6_object_class;
   Msg_RT6_DIS.RT6_TrackID.phys = @sysvar::MsgRT6_DIS::SigRT6_TrackID;
   Msg_RT6_DIS.RT6_position_confidence.phys = @sysvar::MsgRT6_DIS::SigRT6_position_confidence;
   Msg_RT6_DIS.RT6_lane_HD.phys = @sysvar::MsgRT6_DIS::SigRT6_lane_HD;
   Msg_RT6_DIS.RT6_left_corner_long.phys = @sysvar::MsgRT6_DIS::SigRT6_left_corner_long;
   Msg_RT6_DIS.RT6_MessageCounter.phys = @sysvar::MsgRT6_DIS::SigRT6_MessageCounter;
   Msg_RT6_DIS.RT6_track_length.phys = @sysvar::MsgRT6_DIS::SigRT6_track_length;
   Msg_RT6_DIS.RT6_age.phys = @sysvar::MsgRT6_DIS::SigRT6_age;
   Msg_RT6_DIS.RT6_prob_det.phys = @sysvar::MsgRT6_DIS::SigRT6_prob_det;
   Msg_RT6_DIS.RT6_track_width.phys = @sysvar::MsgRT6_DIS::SigRT6_track_width;
   Msg_RT6_DIS.RT6_FARcorner_lat.phys = @sysvar::MsgRT6_DIS::SigRT6_FARcorner_lat;
   Msg_RT6_DIS.RT6_FARcorner_long.phys = @sysvar::MsgRT6_DIS::SigRT6_FARcorner_long;
   Msg_RT6_DIS.RT6_left_corner_lat.phys = @sysvar::MsgRT6_DIS::SigRT6_left_corner_lat;
   Msg_RT6_DIS.RT6_right_corner_lat.phys = @sysvar::MsgRT6_DIS::SigRT6_right_corner_lat;
   Msg_RT6_DIS.RT6_right_corner_long.phys = @sysvar::MsgRT6_DIS::SigRT6_right_corner_long;
   Msg_RT6_DIS.RT6_detectionSensor.phys = @sysvar::MsgRT6_DIS::SigRT6_detectionSensor;
   output(Msg_RT6_DIS);
   Msg_RT5_DIS.RT5_posn_long.phys = @sysvar::MsgRT5_DIS::SigRT5_posn_long;
   Msg_RT5_DIS.RT5_long_vel.phys = @sysvar::MsgRT5_DIS::SigRT5_long_vel;
   Msg_RT5_DIS.RT5_posn_lat.phys = @sysvar::MsgRT5_DIS::SigRT5_posn_lat;
   Msg_RT5_DIS.RT5_lat_vel.phys = @sysvar::MsgRT5_DIS::SigRT5_lat_vel;
   Msg_RT5_DIS.RT5_long_accel.phys = @sysvar::MsgRT5_DIS::SigRT5_long_accel;
   Msg_RT5_DIS.RT5_FARLeftRight.phys = @sysvar::MsgRT5_DIS::SigRT5_FARLeftRight;
   Msg_RT5_DIS.RT5_lat_accel.phys = @sysvar::MsgRT5_DIS::SigRT5_lat_accel;
   Msg_RT5_DIS.RT5_lane.phys = @sysvar::MsgRT5_DIS::SigRT5_lane;
   Msg_RT5_DIS.RT5_Movement.phys = @sysvar::MsgRT5_DIS::SigRT5_Movement;
   Msg_RT5_DIS.RT5_status.phys = @sysvar::MsgRT5_DIS::SigRT5_status;
   Msg_RT5_DIS.RT5_track_lane_confidence.phys = @sysvar::MsgRT5_DIS::SigRT5_track_lane_confidence;
   Msg_RT5_DIS.RT5_object_class.phys = @sysvar::MsgRT5_DIS::SigRT5_object_class;
   Msg_RT5_DIS.RT5_TrackID.phys = @sysvar::MsgRT5_DIS::SigRT5_TrackID;
   Msg_RT5_DIS.RT5_position_confidence.phys = @sysvar::MsgRT5_DIS::SigRT5_position_confidence;
   Msg_RT5_DIS.RT5_lane_HD.phys = @sysvar::MsgRT5_DIS::SigRT5_lane_HD;
   Msg_RT5_DIS.RT5_left_corner_long.phys = @sysvar::MsgRT5_DIS::SigRT5_left_corner_long;
   Msg_RT5_DIS.RT5_MessageCounter.phys = @sysvar::MsgRT5_DIS::SigRT5_MessageCounter;
   Msg_RT5_DIS.RT5_track_length.phys = @sysvar::MsgRT5_DIS::SigRT5_track_length;
   Msg_RT5_DIS.RT5_age.phys = @sysvar::MsgRT5_DIS::SigRT5_age;
   Msg_RT5_DIS.RT5_prob_det.phys = @sysvar::MsgRT5_DIS::SigRT5_prob_det;
   Msg_RT5_DIS.RT5_track_width.phys = @sysvar::MsgRT5_DIS::SigRT5_track_width;
   Msg_RT5_DIS.RT5_FARcorner_lat.phys = @sysvar::MsgRT5_DIS::SigRT5_FARcorner_lat;
   Msg_RT5_DIS.RT5_FARcorner_long.phys = @sysvar::MsgRT5_DIS::SigRT5_FARcorner_long;
   Msg_RT5_DIS.RT5_left_corner_lat.phys = @sysvar::MsgRT5_DIS::SigRT5_left_corner_lat;
   Msg_RT5_DIS.RT5_right_corner_lat.phys = @sysvar::MsgRT5_DIS::SigRT5_right_corner_lat;
   Msg_RT5_DIS.RT5_right_corner_long.phys = @sysvar::MsgRT5_DIS::SigRT5_right_corner_long;
   Msg_RT5_DIS.RT5_detectionSensor.phys = @sysvar::MsgRT5_DIS::SigRT5_detectionSensor;
   output(Msg_RT5_DIS);
   Msg_RT4_DIS.RT4_posn_long.phys = @sysvar::MsgRT4_DIS::SigRT4_posn_long;
   Msg_RT4_DIS.RT4_long_vel.phys = @sysvar::MsgRT4_DIS::SigRT4_long_vel;
   Msg_RT4_DIS.RT4_posn_lat.phys = @sysvar::MsgRT4_DIS::SigRT4_posn_lat;
   Msg_RT4_DIS.RT4_lat_vel.phys = @sysvar::MsgRT4_DIS::SigRT4_lat_vel;
   Msg_RT4_DIS.RT4_long_accel.phys = @sysvar::MsgRT4_DIS::SigRT4_long_accel;
   Msg_RT4_DIS.RT4_FARLeftRight.phys = @sysvar::MsgRT4_DIS::SigRT4_FARLeftRight;
   Msg_RT4_DIS.RT4_lat_accel.phys = @sysvar::MsgRT4_DIS::SigRT4_lat_accel;
   Msg_RT4_DIS.RT4_lane.phys = @sysvar::MsgRT4_DIS::SigRT4_lane;
   Msg_RT4_DIS.RT4_Movement.phys = @sysvar::MsgRT4_DIS::SigRT4_Movement;
   Msg_RT4_DIS.RT4_status.phys = @sysvar::MsgRT4_DIS::SigRT4_status;
   Msg_RT4_DIS.RT4_track_lane_confidence.phys = @sysvar::MsgRT4_DIS::SigRT4_track_lane_confidence;
   Msg_RT4_DIS.RT4_object_class.phys = @sysvar::MsgRT4_DIS::SigRT4_object_class;
   Msg_RT4_DIS.RT4_TrackID.phys = @sysvar::MsgRT4_DIS::SigRT4_TrackID;
   Msg_RT4_DIS.RT4_position_confidence.phys = @sysvar::MsgRT4_DIS::SigRT4_position_confidence;
   Msg_RT4_DIS.RT4_lane_HD.phys = @sysvar::MsgRT4_DIS::SigRT4_lane_HD;
   Msg_RT4_DIS.RT4_left_corner_long.phys = @sysvar::MsgRT4_DIS::SigRT4_left_corner_long;
   Msg_RT4_DIS.RT4_MessageCounter.phys = @sysvar::MsgRT4_DIS::SigRT4_MessageCounter;
   Msg_RT4_DIS.RT4_track_length.phys = @sysvar::MsgRT4_DIS::SigRT4_track_length;
   Msg_RT4_DIS.RT4_age.phys = @sysvar::MsgRT4_DIS::SigRT4_age;
   Msg_RT4_DIS.RT4_prob_det.phys = @sysvar::MsgRT4_DIS::SigRT4_prob_det;
   Msg_RT4_DIS.RT4_track_width.phys = @sysvar::MsgRT4_DIS::SigRT4_track_width;
   Msg_RT4_DIS.RT4_FARcorner_lat.phys = @sysvar::MsgRT4_DIS::SigRT4_FARcorner_lat;
   Msg_RT4_DIS.RT4_FARcorner_long.phys = @sysvar::MsgRT4_DIS::SigRT4_FARcorner_long;
   Msg_RT4_DIS.RT4_left_corner_lat.phys = @sysvar::MsgRT4_DIS::SigRT4_left_corner_lat;
   Msg_RT4_DIS.RT4_right_corner_lat.phys = @sysvar::MsgRT4_DIS::SigRT4_right_corner_lat;
   Msg_RT4_DIS.RT4_right_corner_long.phys = @sysvar::MsgRT4_DIS::SigRT4_right_corner_long;
   Msg_RT4_DIS.RT4_detectionSensor.phys = @sysvar::MsgRT4_DIS::SigRT4_detectionSensor;
   output(Msg_RT4_DIS);
   Msg_RT3_DIS.RT3_posn_long.phys = @sysvar::MsgRT3_DIS::SigRT3_posn_long;
   Msg_RT3_DIS.RT3_long_vel.phys = @sysvar::MsgRT3_DIS::SigRT3_long_vel;
   Msg_RT3_DIS.RT3_posn_lat.phys = @sysvar::MsgRT3_DIS::SigRT3_posn_lat;
   Msg_RT3_DIS.RT3_lat_vel.phys = @sysvar::MsgRT3_DIS::SigRT3_lat_vel;
   Msg_RT3_DIS.RT3_long_accel.phys = @sysvar::MsgRT3_DIS::SigRT3_long_accel;
   Msg_RT3_DIS.RT3_FARLeftRight.phys = @sysvar::MsgRT3_DIS::SigRT3_FARLeftRight;
   Msg_RT3_DIS.RT3_lat_accel.phys = @sysvar::MsgRT3_DIS::SigRT3_lat_accel;
   Msg_RT3_DIS.RT3_lane.phys = @sysvar::MsgRT3_DIS::SigRT3_lane;
   Msg_RT3_DIS.RT3_Movement.phys = @sysvar::MsgRT3_DIS::SigRT3_Movement;
   Msg_RT3_DIS.RT3_status.phys = @sysvar::MsgRT3_DIS::SigRT3_status;
   Msg_RT3_DIS.RT3_track_lane_confidence.phys = @sysvar::MsgRT3_DIS::SigRT3_track_lane_confidence;
   Msg_RT3_DIS.RT3_object_class.phys = @sysvar::MsgRT3_DIS::SigRT3_object_class;
   Msg_RT3_DIS.RT3_TrackID.phys = @sysvar::MsgRT3_DIS::SigRT3_TrackID;
   Msg_RT3_DIS.RT3_position_confidence.phys = @sysvar::MsgRT3_DIS::SigRT3_position_confidence;
   Msg_RT3_DIS.RT3_lane_HD.phys = @sysvar::MsgRT3_DIS::SigRT3_lane_HD;
   Msg_RT3_DIS.RT3_left_corner_long.phys = @sysvar::MsgRT3_DIS::SigRT3_left_corner_long;
   Msg_RT3_DIS.RT3_MessageCounter.phys = @sysvar::MsgRT3_DIS::SigRT3_MessageCounter;
   Msg_RT3_DIS.RT3_track_length.phys = @sysvar::MsgRT3_DIS::SigRT3_track_length;
   Msg_RT3_DIS.RT3_age.phys = @sysvar::MsgRT3_DIS::SigRT3_age;
   Msg_RT3_DIS.RT3_prob_det.phys = @sysvar::MsgRT3_DIS::SigRT3_prob_det;
   Msg_RT3_DIS.RT3_track_width.phys = @sysvar::MsgRT3_DIS::SigRT3_track_width;
   Msg_RT3_DIS.RT3_FARcorner_lat.phys = @sysvar::MsgRT3_DIS::SigRT3_FARcorner_lat;
   Msg_RT3_DIS.RT3_FARcorner_long.phys = @sysvar::MsgRT3_DIS::SigRT3_FARcorner_long;
   Msg_RT3_DIS.RT3_left_corner_lat.phys = @sysvar::MsgRT3_DIS::SigRT3_left_corner_lat;
   Msg_RT3_DIS.RT3_right_corner_lat.phys = @sysvar::MsgRT3_DIS::SigRT3_right_corner_lat;
   Msg_RT3_DIS.RT3_right_corner_long.phys = @sysvar::MsgRT3_DIS::SigRT3_right_corner_long;
   Msg_RT3_DIS.RT3_detectionSensor.phys = @sysvar::MsgRT3_DIS::SigRT3_detectionSensor;
   output(Msg_RT3_DIS);
   Msg_RT2_DIS.RT2_posn_long.phys = @sysvar::MsgRT2_DIS::SigRT2_posn_long;
   Msg_RT2_DIS.RT2_long_vel.phys = @sysvar::MsgRT2_DIS::SigRT2_long_vel;
   Msg_RT2_DIS.RT2_posn_lat.phys = @sysvar::MsgRT2_DIS::SigRT2_posn_lat;
   Msg_RT2_DIS.RT2_lat_vel.phys = @sysvar::MsgRT2_DIS::SigRT2_lat_vel;
   Msg_RT2_DIS.RT2_long_accel.phys = @sysvar::MsgRT2_DIS::SigRT2_long_accel;
   Msg_RT2_DIS.RT2_FARLeftRight.phys = @sysvar::MsgRT2_DIS::SigRT2_FARLeftRight;
   Msg_RT2_DIS.RT2_lat_accel.phys = @sysvar::MsgRT2_DIS::SigRT2_lat_accel;
   Msg_RT2_DIS.RT2_lane.phys = @sysvar::MsgRT2_DIS::SigRT2_lane;
   Msg_RT2_DIS.RT2_Movement.phys = @sysvar::MsgRT2_DIS::SigRT2_Movement;
   Msg_RT2_DIS.RT2_status.phys = @sysvar::MsgRT2_DIS::SigRT2_status;
   Msg_RT2_DIS.RT2_track_lane_confidence.phys = @sysvar::MsgRT2_DIS::SigRT2_track_lane_confidence;
   Msg_RT2_DIS.RT2_object_class.phys = @sysvar::MsgRT2_DIS::SigRT2_object_class;
   Msg_RT2_DIS.RT2_TrackID.phys = @sysvar::MsgRT2_DIS::SigRT2_TrackID;
   Msg_RT2_DIS.RT2_position_confidence.phys = @sysvar::MsgRT2_DIS::SigRT2_position_confidence;
   Msg_RT2_DIS.RT2_lane_HD.phys = @sysvar::MsgRT2_DIS::SigRT2_lane_HD;
   Msg_RT2_DIS.RT2_left_corner_long.phys = @sysvar::MsgRT2_DIS::SigRT2_left_corner_long;
   Msg_RT2_DIS.RT2_MessageCounter.phys = @sysvar::MsgRT2_DIS::SigRT2_MessageCounter;
   Msg_RT2_DIS.RT2_track_length.phys = @sysvar::MsgRT2_DIS::SigRT2_track_length;
   Msg_RT2_DIS.RT2_age.phys = @sysvar::MsgRT2_DIS::SigRT2_age;
   Msg_RT2_DIS.RT2_prob_det.phys = @sysvar::MsgRT2_DIS::SigRT2_prob_det;
   Msg_RT2_DIS.RT2_track_width.phys = @sysvar::MsgRT2_DIS::SigRT2_track_width;
   Msg_RT2_DIS.RT2_FARcorner_lat.phys = @sysvar::MsgRT2_DIS::SigRT2_FARcorner_lat;
   Msg_RT2_DIS.RT2_FARcorner_long.phys = @sysvar::MsgRT2_DIS::SigRT2_FARcorner_long;
   Msg_RT2_DIS.RT2_left_corner_lat.phys = @sysvar::MsgRT2_DIS::SigRT2_left_corner_lat;
   Msg_RT2_DIS.RT2_right_corner_lat.phys = @sysvar::MsgRT2_DIS::SigRT2_right_corner_lat;
   Msg_RT2_DIS.RT2_right_corner_long.phys = @sysvar::MsgRT2_DIS::SigRT2_right_corner_long;
   Msg_RT2_DIS.RT2_detectionSensor.phys = @sysvar::MsgRT2_DIS::SigRT2_detectionSensor;
   output(Msg_RT2_DIS);
   Msg_RT1_DIS.RT1_posn_long.phys = @sysvar::MsgRT1_DIS::SigRT1_posn_long;
   Msg_RT1_DIS.RT1_long_vel.phys = @sysvar::MsgRT1_DIS::SigRT1_long_vel;
   Msg_RT1_DIS.RT1_posn_lat.phys = @sysvar::MsgRT1_DIS::SigRT1_posn_lat;
   Msg_RT1_DIS.RT1_lat_vel.phys = @sysvar::MsgRT1_DIS::SigRT1_lat_vel;
   Msg_RT1_DIS.RT1_long_accel.phys = @sysvar::MsgRT1_DIS::SigRT1_long_accel;
   Msg_RT1_DIS.RT1_FARLeftRight.phys = @sysvar::MsgRT1_DIS::SigRT1_FARLeftRight;
   Msg_RT1_DIS.RT1_lat_accel.phys = @sysvar::MsgRT1_DIS::SigRT1_lat_accel;
   Msg_RT1_DIS.RT1_lane.phys = @sysvar::MsgRT1_DIS::SigRT1_lane;
   Msg_RT1_DIS.RT1_Movement.phys = @sysvar::MsgRT1_DIS::SigRT1_Movement;
   Msg_RT1_DIS.RT1_status.phys = @sysvar::MsgRT1_DIS::SigRT1_status;
   Msg_RT1_DIS.RT1_track_lane_confidence.phys = @sysvar::MsgRT1_DIS::SigRT1_track_lane_confidence;
   Msg_RT1_DIS.RT1_object_class.phys = @sysvar::MsgRT1_DIS::SigRT1_object_class;
   Msg_RT1_DIS.RT1_TrackID.phys = @sysvar::MsgRT1_DIS::SigRT1_TrackID;
   Msg_RT1_DIS.RT1_position_confidence.phys = @sysvar::MsgRT1_DIS::SigRT1_position_confidence;
   Msg_RT1_DIS.RT1_lane_HD.phys = @sysvar::MsgRT1_DIS::SigRT1_lane_HD;
   Msg_RT1_DIS.RT1_left_corner_long.phys = @sysvar::MsgRT1_DIS::SigRT1_left_corner_long;
   Msg_RT1_DIS.RT1_MessageCounter.phys = @sysvar::MsgRT1_DIS::SigRT1_MessageCounter;
   Msg_RT1_DIS.RT1_track_length.phys = @sysvar::MsgRT1_DIS::SigRT1_track_length;
   Msg_RT1_DIS.RT1_age.phys = @sysvar::MsgRT1_DIS::SigRT1_age;
   Msg_RT1_DIS.RT1_prob_det.phys = @sysvar::MsgRT1_DIS::SigRT1_prob_det;
   Msg_RT1_DIS.RT1_track_width.phys = @sysvar::MsgRT1_DIS::SigRT1_track_width;
   Msg_RT1_DIS.RT1_FARcorner_lat.phys = @sysvar::MsgRT1_DIS::SigRT1_FARcorner_lat;
   Msg_RT1_DIS.RT1_FARcorner_long.phys = @sysvar::MsgRT1_DIS::SigRT1_FARcorner_long;
   Msg_RT1_DIS.RT1_left_corner_lat.phys = @sysvar::MsgRT1_DIS::SigRT1_left_corner_lat;
   Msg_RT1_DIS.RT1_right_corner_lat.phys = @sysvar::MsgRT1_DIS::SigRT1_right_corner_lat;
   Msg_RT1_DIS.RT1_right_corner_long.phys = @sysvar::MsgRT1_DIS::SigRT1_right_corner_long;
   Msg_RT1_DIS.RT1_detectionSensor.phys = @sysvar::MsgRT1_DIS::SigRT1_detectionSensor;
   output(Msg_RT1_DIS);
   Msg_RTS4_DIS.RTS4_posn_long.phys = @sysvar::MsgRTS4_DIS::SigRTS4_posn_long;
   Msg_RTS4_DIS.RTS4_posn_lat.phys = @sysvar::MsgRTS4_DIS::SigRTS4_posn_lat;
   Msg_RTS4_DIS.RTS4_TrackID.phys = @sysvar::MsgRTS4_DIS::SigRTS4_TrackID;
   Msg_RTS4_DIS.RTS4_lane.phys = @sysvar::MsgRTS4_DIS::SigRTS4_lane;
   Msg_RTS4_DIS.RTS4_track_lane_confidence.phys = @sysvar::MsgRTS4_DIS::SigRTS4_track_lane_confidence;
   Msg_RTS4_DIS.RTS4_FARLeftRight.phys = @sysvar::MsgRTS4_DIS::SigRTS4_FARLeftRight;
   Msg_RTS4_DIS.RTS4_Status.phys = @sysvar::MsgRTS4_DIS::SigRTS4_Status;
   Msg_RTS4_DIS.RTS4_long_accel.phys = @sysvar::MsgRTS4_DIS::SigRTS4_long_accel;
   Msg_RTS4_DIS.RTS4_lat_accel.phys = @sysvar::MsgRTS4_DIS::SigRTS4_lat_accel;
   Msg_RTS4_DIS.RTS4_Movement.phys = @sysvar::MsgRTS4_DIS::SigRTS4_Movement;
   Msg_RTS4_DIS.RTS4_object_class.phys = @sysvar::MsgRTS4_DIS::SigRTS4_object_class;
   Msg_RTS4_DIS.RTS4_lat_vel.phys = @sysvar::MsgRTS4_DIS::SigRTS4_lat_vel;
   Msg_RTS4_DIS.RTS4_position_confidence.phys = @sysvar::MsgRTS4_DIS::SigRTS4_position_confidence;
   Msg_RTS4_DIS.RTS4_long_vel.phys = @sysvar::MsgRTS4_DIS::SigRTS4_long_vel;
   Msg_RTS4_DIS.RTS4_lane_HD.phys = @sysvar::MsgRTS4_DIS::SigRTS4_lane_HD;
   Msg_RTS4_DIS.RTS4_MessageCounter.phys = @sysvar::MsgRTS4_DIS::SigRTS4_MessageCounter;
   Msg_RTS4_DIS.RTS4_track_width.phys = @sysvar::MsgRTS4_DIS::SigRTS4_track_width;
   Msg_RTS4_DIS.RTS4_left_corner_long.phys = @sysvar::MsgRTS4_DIS::SigRTS4_left_corner_long;
   Msg_RTS4_DIS.RTS4_track_length.phys = @sysvar::MsgRTS4_DIS::SigRTS4_track_length;
   Msg_RTS4_DIS.RTS4_age.phys = @sysvar::MsgRTS4_DIS::SigRTS4_age;
   Msg_RTS4_DIS.RTS4_prob_det.phys = @sysvar::MsgRTS4_DIS::SigRTS4_prob_det;
   Msg_RTS4_DIS.RTS4_FARcorner_lat.phys = @sysvar::MsgRTS4_DIS::SigRTS4_FARcorner_lat;
   Msg_RTS4_DIS.RTS4_FARcorner_long.phys = @sysvar::MsgRTS4_DIS::SigRTS4_FARcorner_long;
   Msg_RTS4_DIS.RTS4_left_corner_lat.phys = @sysvar::MsgRTS4_DIS::SigRTS4_left_corner_lat;
   Msg_RTS4_DIS.RTS4_right_corner_lat.phys = @sysvar::MsgRTS4_DIS::SigRTS4_right_corner_lat;
   Msg_RTS4_DIS.RTS4_right_corner_long.phys = @sysvar::MsgRTS4_DIS::SigRTS4_right_corner_long;
   Msg_RTS4_DIS.RTS4_detectionSensor.phys = @sysvar::MsgRTS4_DIS::SigRTS4_detectionSensor;
   output(Msg_RTS4_DIS);
   Msg_RTS3_DIS.RTS3_posn_long.phys = @sysvar::MsgRTS3_DIS::SigRTS3_posn_long;
   Msg_RTS3_DIS.RTS3_posn_lat.phys = @sysvar::MsgRTS3_DIS::SigRTS3_posn_lat;
   Msg_RTS3_DIS.RTS3_TrackID.phys = @sysvar::MsgRTS3_DIS::SigRTS3_TrackID;
   Msg_RTS3_DIS.RTS3_lane.phys = @sysvar::MsgRTS3_DIS::SigRTS3_lane;
   Msg_RTS3_DIS.RTS3_track_lane_confidence.phys = @sysvar::MsgRTS3_DIS::SigRTS3_track_lane_confidence;
   Msg_RTS3_DIS.RTS3_FARLeftRight.phys = @sysvar::MsgRTS3_DIS::SigRTS3_FARLeftRight;
   Msg_RTS3_DIS.RTS3_Status.phys = @sysvar::MsgRTS3_DIS::SigRTS3_Status;
   Msg_RTS3_DIS.RTS3_long_accel.phys = @sysvar::MsgRTS3_DIS::SigRTS3_long_accel;
   Msg_RTS3_DIS.RTS3_lat_accel.phys = @sysvar::MsgRTS3_DIS::SigRTS3_lat_accel;
   Msg_RTS3_DIS.RTS3_Movement.phys = @sysvar::MsgRTS3_DIS::SigRTS3_Movement;
   Msg_RTS3_DIS.RTS3_object_class.phys = @sysvar::MsgRTS3_DIS::SigRTS3_object_class;
   Msg_RTS3_DIS.RTS3_lat_vel.phys = @sysvar::MsgRTS3_DIS::SigRTS3_lat_vel;
   Msg_RTS3_DIS.RTS3_position_confidence.phys = @sysvar::MsgRTS3_DIS::SigRTS3_position_confidence;
   Msg_RTS3_DIS.RTS3_long_vel.phys = @sysvar::MsgRTS3_DIS::SigRTS3_long_vel;
   Msg_RTS3_DIS.RTS3_lane_HD.phys = @sysvar::MsgRTS3_DIS::SigRTS3_lane_HD;
   Msg_RTS3_DIS.RTS3_MessageCounter.phys = @sysvar::MsgRTS3_DIS::SigRTS3_MessageCounter;
   Msg_RTS3_DIS.RTS3_track_width.phys = @sysvar::MsgRTS3_DIS::SigRTS3_track_width;
   Msg_RTS3_DIS.RTS3_left_corner_long.phys = @sysvar::MsgRTS3_DIS::SigRTS3_left_corner_long;
   Msg_RTS3_DIS.RTS3_track_length.phys = @sysvar::MsgRTS3_DIS::SigRTS3_track_length;
   Msg_RTS3_DIS.RTS3_age.phys = @sysvar::MsgRTS3_DIS::SigRTS3_age;
   Msg_RTS3_DIS.RTS3_prob_det.phys = @sysvar::MsgRTS3_DIS::SigRTS3_prob_det;
   Msg_RTS3_DIS.RTS3_FARcorner_lat.phys = @sysvar::MsgRTS3_DIS::SigRTS3_FARcorner_lat;
   Msg_RTS3_DIS.RTS3_FARcorner_long.phys = @sysvar::MsgRTS3_DIS::SigRTS3_FARcorner_long;
   Msg_RTS3_DIS.RTS3_left_corner_lat.phys = @sysvar::MsgRTS3_DIS::SigRTS3_left_corner_lat;
   Msg_RTS3_DIS.RTS3_right_corner_lat.phys = @sysvar::MsgRTS3_DIS::SigRTS3_right_corner_lat;
   Msg_RTS3_DIS.RTS3_right_corner_long.phys = @sysvar::MsgRTS3_DIS::SigRTS3_right_corner_long;
   Msg_RTS3_DIS.RTS3_detectionSensor.phys = @sysvar::MsgRTS3_DIS::SigRTS3_detectionSensor;
   output(Msg_RTS3_DIS);
   Msg_RTS1_DIS.RTS1_posn_long.phys = @sysvar::MsgRTS1_DIS::SigRTS1_posn_long;
   Msg_RTS1_DIS.RTS1_posn_lat.phys = @sysvar::MsgRTS1_DIS::SigRTS1_posn_lat;
   Msg_RTS1_DIS.RTS1_TrackID.phys = @sysvar::MsgRTS1_DIS::SigRTS1_TrackID;
   Msg_RTS1_DIS.RTS1_lane.phys = @sysvar::MsgRTS1_DIS::SigRTS1_lane;
   Msg_RTS1_DIS.RTS1_track_lane_confidence.phys = @sysvar::MsgRTS1_DIS::SigRTS1_track_lane_confidence;
   Msg_RTS1_DIS.RTS1_FARLeftRight.phys = @sysvar::MsgRTS1_DIS::SigRTS1_FARLeftRight;
   Msg_RTS1_DIS.RTS1_Status.phys = @sysvar::MsgRTS1_DIS::SigRTS1_Status;
   Msg_RTS1_DIS.RTS1_long_accel.phys = @sysvar::MsgRTS1_DIS::SigRTS1_long_accel;
   Msg_RTS1_DIS.RTS1_lat_accel.phys = @sysvar::MsgRTS1_DIS::SigRTS1_lat_accel;
   Msg_RTS1_DIS.RTS1_Movement.phys = @sysvar::MsgRTS1_DIS::SigRTS1_Movement;
   Msg_RTS1_DIS.RTS1_object_class.phys = @sysvar::MsgRTS1_DIS::SigRTS1_object_class;
   Msg_RTS1_DIS.RTS1_lat_vel.phys = @sysvar::MsgRTS1_DIS::SigRTS1_lat_vel;
   Msg_RTS1_DIS.RTS1_position_confidence.phys = @sysvar::MsgRTS1_DIS::SigRTS1_position_confidence;
   Msg_RTS1_DIS.RTS1_long_vel.phys = @sysvar::MsgRTS1_DIS::SigRTS1_long_vel;
   Msg_RTS1_DIS.RTS1_lane_HD.phys = @sysvar::MsgRTS1_DIS::SigRTS1_lane_HD;
   Msg_RTS1_DIS.RTS1_MessageCounter.phys = @sysvar::MsgRTS1_DIS::SigRTS1_MessageCounter;
   Msg_RTS1_DIS.RTS1_track_width.phys = @sysvar::MsgRTS1_DIS::SigRTS1_track_width;
   Msg_RTS1_DIS.RTS1_left_corner_long.phys = @sysvar::MsgRTS1_DIS::SigRTS1_left_corner_long;
   Msg_RTS1_DIS.RTS1_track_length.phys = @sysvar::MsgRTS1_DIS::SigRTS1_track_length;
   Msg_RTS1_DIS.RTS1_age.phys = @sysvar::MsgRTS1_DIS::SigRTS1_age;
   Msg_RTS1_DIS.RTS1_prob_det.phys = @sysvar::MsgRTS1_DIS::SigRTS1_prob_det;
   Msg_RTS1_DIS.RTS1_FARcorner_lat.phys = @sysvar::MsgRTS1_DIS::SigRTS1_FARcorner_lat;
   Msg_RTS1_DIS.RTS1_FARcorner_long.phys = @sysvar::MsgRTS1_DIS::SigRTS1_FARcorner_long;
   Msg_RTS1_DIS.RTS1_left_corner_lat.phys = @sysvar::MsgRTS1_DIS::SigRTS1_left_corner_lat;
   Msg_RTS1_DIS.RTS1_right_corner_lat.phys = @sysvar::MsgRTS1_DIS::SigRTS1_right_corner_lat;
   Msg_RTS1_DIS.RTS1_right_corner_long.phys = @sysvar::MsgRTS1_DIS::SigRTS1_right_corner_long;
   Msg_RTS1_DIS.RTS1_detectionSensor.phys = @sysvar::MsgRTS1_DIS::SigRTS1_detectionSensor;
   output(Msg_RTS1_DIS);
   Msg_PCA_Stationary.PCAS_posn_long.phys = @sysvar::MsgPCA_Stationary::SigPCAS_posn_long;
   Msg_PCA_Stationary.PCAS_posn_lat.phys = @sysvar::MsgPCA_Stationary::SigPCAS_posn_lat;
   Msg_PCA_Stationary.PCAS_TrackID.phys = @sysvar::MsgPCA_Stationary::SigPCAS_TrackID;
   Msg_PCA_Stationary.PCAS_lane.phys = @sysvar::MsgPCA_Stationary::SigPCAS_lane;
   Msg_PCA_Stationary.PCAS_track_lane_confidence.phys = @sysvar::MsgPCA_Stationary::SigPCAS_track_lane_confidence;
   Msg_PCA_Stationary.PCAS_Status.phys = @sysvar::MsgPCA_Stationary::SigPCAS_Status;
   Msg_PCA_Stationary.PCAS_long_accel.phys = @sysvar::MsgPCA_Stationary::SigPCAS_long_accel;
   Msg_PCA_Stationary.PCAS_lat_accel.phys = @sysvar::MsgPCA_Stationary::SigPCAS_lat_accel;
   Msg_PCA_Stationary.PCAS_Movement.phys = @sysvar::MsgPCA_Stationary::SigPCAS_Movement;
   Msg_PCA_Stationary.PCAS_object_class.phys = @sysvar::MsgPCA_Stationary::SigPCAS_object_class;
   Msg_PCA_Stationary.PCAS_lat_vel.phys = @sysvar::MsgPCA_Stationary::SigPCAS_lat_vel;
   Msg_PCA_Stationary.PCAS_position_confidence.phys = @sysvar::MsgPCA_Stationary::SigPCAS_position_confidence;
   Msg_PCA_Stationary.PCAS_long_vel.phys = @sysvar::MsgPCA_Stationary::SigPCAS_long_vel;
   Msg_PCA_Stationary.PCAS_track_width.phys = @sysvar::MsgPCA_Stationary::SigPCAS_track_width;
   Msg_PCA_Stationary.PCAS_age.phys = @sysvar::MsgPCA_Stationary::SigPCAS_age;
   Msg_PCA_Stationary.PCAS_prob_det.phys = @sysvar::MsgPCA_Stationary::SigPCAS_prob_det;
   Msg_PCA_Stationary.PCAS_detectionSensor.phys = @sysvar::MsgPCA_Stationary::SigPCAS_detectionSensor;
   output(Msg_PCA_Stationary);
   Msg_PCA_Moving.PCAM_posn_long.phys = @sysvar::MsgPCA_Moving::SigPCAM_posn_long;
   Msg_PCA_Moving.PCAM_posn_lat.phys = @sysvar::MsgPCA_Moving::SigPCAM_posn_lat;
   Msg_PCA_Moving.PCAM_TrackID.phys = @sysvar::MsgPCA_Moving::SigPCAM_TrackID;
   Msg_PCA_Moving.PCAM_lane.phys = @sysvar::MsgPCA_Moving::SigPCAM_lane;
   Msg_PCA_Moving.PCAM_track_lane_confidence.phys = @sysvar::MsgPCA_Moving::SigPCAM_track_lane_confidence;
   Msg_PCA_Moving.PCAM_Status.phys = @sysvar::MsgPCA_Moving::SigPCAM_Status;
   Msg_PCA_Moving.PCAM_long_accel.phys = @sysvar::MsgPCA_Moving::SigPCAM_long_accel;
   Msg_PCA_Moving.PCAM_lat_accel.phys = @sysvar::MsgPCA_Moving::SigPCAM_lat_accel;
   Msg_PCA_Moving.PCAM_Movement.phys = @sysvar::MsgPCA_Moving::SigPCAM_Movement;
   Msg_PCA_Moving.PCAM_object_class.phys = @sysvar::MsgPCA_Moving::SigPCAM_object_class;
   Msg_PCA_Moving.PCAM_lat_vel.phys = @sysvar::MsgPCA_Moving::SigPCAM_lat_vel;
   Msg_PCA_Moving.PCAM_position_confidence.phys = @sysvar::MsgPCA_Moving::SigPCAM_position_confidence;
   Msg_PCA_Moving.PCAM_long_vel.phys = @sysvar::MsgPCA_Moving::SigPCAM_long_vel;
   Msg_PCA_Moving.PCAM_track_width.phys = @sysvar::MsgPCA_Moving::SigPCAM_track_width;
   Msg_PCA_Moving.PCAM_age.phys = @sysvar::MsgPCA_Moving::SigPCAM_age;
   Msg_PCA_Moving.PCAM_prob_det.phys = @sysvar::MsgPCA_Moving::SigPCAM_prob_det;
   Msg_PCA_Moving.PCAM_detectionSensor.phys = @sysvar::MsgPCA_Moving::SigPCAM_detectionSensor;
   output(Msg_PCA_Moving);
   Msg_VIS_LANE_NEIGHBOR.VIS_LANE_LEFT_NEIGHBOR_A0.phys = @sysvar::MsgVIS_LANE_NEIGHBOR::SigVIS_LANE_LEFT_NEIGHBOR_A0;
   Msg_VIS_LANE_NEIGHBOR.VIS_LANE_LEFT_NEIGHBOR_A1.phys = @sysvar::MsgVIS_LANE_NEIGHBOR::SigVIS_LANE_LEFT_NEIGHBOR_A1;
   Msg_VIS_LANE_NEIGHBOR.VIS_LANE_LEFT_NEIGHBOR_A2.phys = @sysvar::MsgVIS_LANE_NEIGHBOR::SigVIS_LANE_LEFT_NEIGHBOR_A2;
   Msg_VIS_LANE_NEIGHBOR.VIS_LANE_LEFT_NEIGHBOR_A3.phys = @sysvar::MsgVIS_LANE_NEIGHBOR::SigVIS_LANE_LEFT_NEIGHBOR_A3;
   Msg_VIS_LANE_NEIGHBOR.VIS_LANE_LEFT_NEIGHBOR_StaRange.phys = @sysvar::MsgVIS_LANE_NEIGHBOR::SigVIS_LANE_LEFT_NEIGHBOR_StaRange;
   Msg_VIS_LANE_NEIGHBOR.VIS_LANE_LEFT_NEIGHBOR_EndRange.phys = @sysvar::MsgVIS_LANE_NEIGHBOR::SigVIS_LANE_LEFT_NEIGHBOR_EndRange;
   Msg_VIS_LANE_NEIGHBOR.VIS_LANE_LEFT_NEIGHBOR_SFConf.phys = @sysvar::MsgVIS_LANE_NEIGHBOR::SigVIS_LANE_LEFT_NEIGHBOR_SFConf;
   Msg_VIS_LANE_NEIGHBOR.VIS_LANE_LEFT_NEIGHBOR_Conf.phys = @sysvar::MsgVIS_LANE_NEIGHBOR::SigVIS_LANE_LEFT_NEIGHBOR_Conf;
   Msg_VIS_LANE_NEIGHBOR.VIS_LANE_LEFT_NEIGHBOR_Color.phys = @sysvar::MsgVIS_LANE_NEIGHBOR::SigVIS_LANE_LEFT_NEIGHBOR_Color;
   Msg_VIS_LANE_NEIGHBOR.VIS_LANE_LEFT_NEIGHBOR_Type.phys = @sysvar::MsgVIS_LANE_NEIGHBOR::SigVIS_LANE_LEFT_NEIGHBOR_Type;
   Msg_VIS_LANE_NEIGHBOR.VIS_LANE_RIGHT_NEIGHBOR_A0.phys = @sysvar::MsgVIS_LANE_NEIGHBOR::SigVIS_LANE_RIGHT_NEIGHBOR_A0;
   Msg_VIS_LANE_NEIGHBOR.VIS_LANE_RIGHT_NEIGHBOR_A1.phys = @sysvar::MsgVIS_LANE_NEIGHBOR::SigVIS_LANE_RIGHT_NEIGHBOR_A1;
   Msg_VIS_LANE_NEIGHBOR.VIS_LANE_RIGHT_NEIGHBOR_A2.phys = @sysvar::MsgVIS_LANE_NEIGHBOR::SigVIS_LANE_RIGHT_NEIGHBOR_A2;
   Msg_VIS_LANE_NEIGHBOR.VIS_LANE_RIGHT_NEIGHBOR_A3.phys = @sysvar::MsgVIS_LANE_NEIGHBOR::SigVIS_LANE_RIGHT_NEIGHBOR_A3;
   Msg_VIS_LANE_NEIGHBOR.VIS_LANE_RIGHT_NEIGHBOR_StaRange.phys = @sysvar::MsgVIS_LANE_NEIGHBOR::SigVIS_LANE_RIGHT_NEIGHBOR_StaRange;
   Msg_VIS_LANE_NEIGHBOR.VIS_LANE_RIGHT_NEIGHBOR_EndRange.phys = @sysvar::MsgVIS_LANE_NEIGHBOR::SigVIS_LANE_RIGHT_NEIGHBOR_EndRange;
   Msg_VIS_LANE_NEIGHBOR.VIS_LANE_RIGHT_NEIGHBOR_SFConf.phys = @sysvar::MsgVIS_LANE_NEIGHBOR::SigVIS_LANE_RIGHT_NEIGHBOR_SFConf;
   Msg_VIS_LANE_NEIGHBOR.VIS_LANE_RIGHT_NEIGHBOR_Conf.phys = @sysvar::MsgVIS_LANE_NEIGHBOR::SigVIS_LANE_RIGHT_NEIGHBOR_Conf;
   Msg_VIS_LANE_NEIGHBOR.VIS_LANE_RIGHT_NEIGHBOR_Type.phys = @sysvar::MsgVIS_LANE_NEIGHBOR::SigVIS_LANE_RIGHT_NEIGHBOR_Type;
   Msg_VIS_LANE_NEIGHBOR.VIS_LANE_RIGHT_NEIGHBOR_Color.phys = @sysvar::MsgVIS_LANE_NEIGHBOR::SigVIS_LANE_RIGHT_NEIGHBOR_Color;
   Msg_VIS_LANE_NEIGHBOR.VIS_LANE_RIGHT_NEIGHBOR_DLMType.phys = @sysvar::MsgVIS_LANE_NEIGHBOR::SigVIS_LANE_RIGHT_NEIGHBOR_DLMType;
   Msg_VIS_LANE_NEIGHBOR.VIS_LANE_LEFT_NEIGHBOR_DeclType.phys = @sysvar::MsgVIS_LANE_NEIGHBOR::SigVIS_LANE_LEFT_NEIGHBOR_DeclType;
   Msg_VIS_LANE_NEIGHBOR.VIS_LANE_LEFT_NEIGHBOR_DLMType.phys = @sysvar::MsgVIS_LANE_NEIGHBOR::SigVIS_LANE_LEFT_NEIGHBOR_DLMType;
   Msg_VIS_LANE_NEIGHBOR.VIS_LANE_RIGHT_NEIGHBOR_DeclType.phys = @sysvar::MsgVIS_LANE_NEIGHBOR::SigVIS_LANE_RIGHT_NEIGHBOR_DeclType;
   Msg_VIS_LANE_NEIGHBOR.VIS_LANE_LEFT_NEIGHBOR_ViewRange.phys = @sysvar::MsgVIS_LANE_NEIGHBOR::SigVIS_LANE_LEFT_NEIGHBOR_ViewRange;
   Msg_VIS_LANE_NEIGHBOR.VIS_LANE_RIGHT_NEIGHBOR_ViewRang.phys = @sysvar::MsgVIS_LANE_NEIGHBOR::SigVIS_LANE_RIGHT_NEIGHBOR_ViewRang;
   output(Msg_VIS_LANE_NEIGHBOR);
   Msg_VIS_LANE_INFORMATION.VIS_PREDICTION_INFORMATION_L.phys = @sysvar::MsgVIS_LANE_INFORMATION::SigVIS_PREDICTION_INFORMATION_L;
   Msg_VIS_LANE_INFORMATION.VIS_PREDICTION_INFORMATION_R.phys = @sysvar::MsgVIS_LANE_INFORMATION::SigVIS_PREDICTION_INFORMATION_R;
   Msg_VIS_LANE_INFORMATION.VIS_LANE_LANE_CHANGE.phys = @sysvar::MsgVIS_LANE_INFORMATION::SigVIS_LANE_LANE_CHANGE;
   Msg_VIS_LANE_INFORMATION.VIS_LANE_AMBIGUOUS_LANE_const_bf.phys = @sysvar::MsgVIS_LANE_INFORMATION::SigVIS_LANE_AMBIGUOUS_LANE_const_bf;
   Msg_VIS_LANE_INFORMATION.TxCntvis.phys = @sysvar::MsgVIS_LANE_INFORMATION::SigTxCntvis;
   Msg_VIS_LANE_INFORMATION.VIS_ImageIndex.phys = @sysvar::MsgVIS_LANE_INFORMATION::SigVIS_ImageIndex;
   Msg_VIS_LANE_INFORMATION.VIS_FrameIndex.phys = @sysvar::MsgVIS_LANE_INFORMATION::SigVIS_FrameIndex;
   output(Msg_VIS_LANE_INFORMATION);
   Msg_VIS_LANE_CHANGE_TA.VIS_LANE_CHANGE_Conf_LEFT.phys = @sysvar::MsgVIS_LANE_CHANGE_TA::SigVIS_LANE_CHANGE_Conf_LEFT;
   Msg_VIS_LANE_CHANGE_TA.VIS_LANE_CHANGE_Conf_RIGHT.phys = @sysvar::MsgVIS_LANE_CHANGE_TA::SigVIS_LANE_CHANGE_Conf_RIGHT;
   output(Msg_VIS_LANE_CHANGE_TA);
   Msg_VIS_LANE_NEAR_INDIVIDUAL.VIS_LANE_LEFT_INDIVID_A0.phys = @sysvar::MsgVIS_LANE_NEAR_INDIVIDUAL::SigVIS_LANE_LEFT_INDIVID_A0;
   Msg_VIS_LANE_NEAR_INDIVIDUAL.VIS_LANE_LEFT_INDIVID_A1.phys = @sysvar::MsgVIS_LANE_NEAR_INDIVIDUAL::SigVIS_LANE_LEFT_INDIVID_A1;
   Msg_VIS_LANE_NEAR_INDIVIDUAL.VIS_LANE_LEFT_INDIVID_A2.phys = @sysvar::MsgVIS_LANE_NEAR_INDIVIDUAL::SigVIS_LANE_LEFT_INDIVID_A2;
   Msg_VIS_LANE_NEAR_INDIVIDUAL.VIS_LANE_LEFT_INDIVID_A3.phys = @sysvar::MsgVIS_LANE_NEAR_INDIVIDUAL::SigVIS_LANE_LEFT_INDIVID_A3;
   Msg_VIS_LANE_NEAR_INDIVIDUAL.VIS_LANE_LEFT_INDIVID_StaRange.phys = @sysvar::MsgVIS_LANE_NEAR_INDIVIDUAL::SigVIS_LANE_LEFT_INDIVID_StaRange;
   Msg_VIS_LANE_NEAR_INDIVIDUAL.VIS_LANE_LEFT_INDIVID_EndRange.phys = @sysvar::MsgVIS_LANE_NEAR_INDIVIDUAL::SigVIS_LANE_LEFT_INDIVID_EndRange;
   Msg_VIS_LANE_NEAR_INDIVIDUAL.VIS_LANE_LEFT_INDIVID_SFConf.phys = @sysvar::MsgVIS_LANE_NEAR_INDIVIDUAL::SigVIS_LANE_LEFT_INDIVID_SFConf;
   Msg_VIS_LANE_NEAR_INDIVIDUAL.VIS_LANE_LEFT_INDIVID_Type.phys = @sysvar::MsgVIS_LANE_NEAR_INDIVIDUAL::SigVIS_LANE_LEFT_INDIVID_Type;
   Msg_VIS_LANE_NEAR_INDIVIDUAL.VIS_LANE_LEFT_INDIVID_Color.phys = @sysvar::MsgVIS_LANE_NEAR_INDIVIDUAL::SigVIS_LANE_LEFT_INDIVID_Color;
   Msg_VIS_LANE_NEAR_INDIVIDUAL.VIS_LANE_LEFT_INDIVID_Conf.phys = @sysvar::MsgVIS_LANE_NEAR_INDIVIDUAL::SigVIS_LANE_LEFT_INDIVID_Conf;
   Msg_VIS_LANE_NEAR_INDIVIDUAL.VIS_LANE_RIGHT_INDIVID_A0.phys = @sysvar::MsgVIS_LANE_NEAR_INDIVIDUAL::SigVIS_LANE_RIGHT_INDIVID_A0;
   Msg_VIS_LANE_NEAR_INDIVIDUAL.VIS_LANE_RIGHT_INDIVID_A1.phys = @sysvar::MsgVIS_LANE_NEAR_INDIVIDUAL::SigVIS_LANE_RIGHT_INDIVID_A1;
   Msg_VIS_LANE_NEAR_INDIVIDUAL.VIS_LANE_RIGHT_INDIVID_A2.phys = @sysvar::MsgVIS_LANE_NEAR_INDIVIDUAL::SigVIS_LANE_RIGHT_INDIVID_A2;
   Msg_VIS_LANE_NEAR_INDIVIDUAL.VIS_LANE_RIGHT_INDIVID_A3.phys = @sysvar::MsgVIS_LANE_NEAR_INDIVIDUAL::SigVIS_LANE_RIGHT_INDIVID_A3;
   Msg_VIS_LANE_NEAR_INDIVIDUAL.VIS_LANE_RIGHT_INDIVID_StaRange.phys = @sysvar::MsgVIS_LANE_NEAR_INDIVIDUAL::SigVIS_LANE_RIGHT_INDIVID_StaRange;
   Msg_VIS_LANE_NEAR_INDIVIDUAL.VIS_LANE_RIGHT_INDIVID_EndRange.phys = @sysvar::MsgVIS_LANE_NEAR_INDIVIDUAL::SigVIS_LANE_RIGHT_INDIVID_EndRange;
   Msg_VIS_LANE_NEAR_INDIVIDUAL.VIS_LANE_RIGHT_INDIVID_SFConf.phys = @sysvar::MsgVIS_LANE_NEAR_INDIVIDUAL::SigVIS_LANE_RIGHT_INDIVID_SFConf;
   Msg_VIS_LANE_NEAR_INDIVIDUAL.VIS_LANE_RIGHT_INDIVID_Type.phys = @sysvar::MsgVIS_LANE_NEAR_INDIVIDUAL::SigVIS_LANE_RIGHT_INDIVID_Type;
   Msg_VIS_LANE_NEAR_INDIVIDUAL.VIS_LANE_RIGHT_INDIVID_Color.phys = @sysvar::MsgVIS_LANE_NEAR_INDIVIDUAL::SigVIS_LANE_RIGHT_INDIVID_Color;
   Msg_VIS_LANE_NEAR_INDIVIDUAL.VIS_LANE_RIGHT_INDIVID_Conf.phys = @sysvar::MsgVIS_LANE_NEAR_INDIVIDUAL::SigVIS_LANE_RIGHT_INDIVID_Conf;
   Msg_VIS_LANE_NEAR_INDIVIDUAL.VIS_LANE_RIGHT_INDIVID_DLMType.phys = @sysvar::MsgVIS_LANE_NEAR_INDIVIDUAL::SigVIS_LANE_RIGHT_INDIVID_DLMType;
   Msg_VIS_LANE_NEAR_INDIVIDUAL.VIS_LANE_LEFT_INDIVID_DeclType.phys = @sysvar::MsgVIS_LANE_NEAR_INDIVIDUAL::SigVIS_LANE_LEFT_INDIVID_DeclType;
   Msg_VIS_LANE_NEAR_INDIVIDUAL.VIS_LANE_LEFT_INDIVID_DLMType.phys = @sysvar::MsgVIS_LANE_NEAR_INDIVIDUAL::SigVIS_LANE_LEFT_INDIVID_DLMType;
   Msg_VIS_LANE_NEAR_INDIVIDUAL.VIS_LANE_RIGHT_INDIVID_DeclType.phys = @sysvar::MsgVIS_LANE_NEAR_INDIVIDUAL::SigVIS_LANE_RIGHT_INDIVID_DeclType;
   Msg_VIS_LANE_NEAR_INDIVIDUAL.VIS_LANE_LEFT_INDIVID_ViewRange.phys = @sysvar::MsgVIS_LANE_NEAR_INDIVIDUAL::SigVIS_LANE_LEFT_INDIVID_ViewRange;
   Msg_VIS_LANE_NEAR_INDIVIDUAL.VIS_LANE_RIGHT_INDIVID_ViewRange.phys = @sysvar::MsgVIS_LANE_NEAR_INDIVIDUAL::SigVIS_LANE_RIGHT_INDIVID_ViewRange;
   output(Msg_VIS_LANE_NEAR_INDIVIDUAL);
   Msg_SPP_SP_Info.LLM_conf.phys = @sysvar::MsgSPP_SP_Info::SigLLM_conf;
   Msg_SPP_SP_Info.RLM_conf.phys = @sysvar::MsgSPP_SP_Info::SigRLM_conf;
   Msg_SPP_SP_Info.SP_lane_width.phys = @sysvar::MsgSPP_SP_Info::SigSP_lane_width;
   Msg_SPP_SP_Info.SP_lane_width_Measured.phys = @sysvar::MsgSPP_SP_Info::SigSP_lane_width_Measured;
   Msg_SPP_SP_Info.SP_lane_width_Filtered.phys = @sysvar::MsgSPP_SP_Info::SigSP_lane_width_Filtered;
   Msg_SPP_SP_Info.SP_LD_max_lw.phys = @sysvar::MsgSPP_SP_Info::SigSP_LD_max_lw;
   Msg_SPP_SP_Info.SP_LD_min_lw.phys = @sysvar::MsgSPP_SP_Info::SigSP_LD_min_lw;
   Msg_SPP_SP_Info.SPP_POLY_COEFF_A0.phys = @sysvar::MsgSPP_SP_Info::SigSPP_POLY_COEFF_A0;
   Msg_SPP_SP_Info.SPP_POLY_COEFF_A1.phys = @sysvar::MsgSPP_SP_Info::SigSPP_POLY_COEFF_A1;
   Msg_SPP_SP_Info.SPP_POLY_COEFF_A2.phys = @sysvar::MsgSPP_SP_Info::SigSPP_POLY_COEFF_A2;
   Msg_SPP_SP_Info.SPP_POLY_COEFF_A3.phys = @sysvar::MsgSPP_SP_Info::SigSPP_POLY_COEFF_A3;
   Msg_SPP_SP_Info.SP_conf.phys = @sysvar::MsgSPP_SP_Info::SigSP_conf;
   Msg_SPP_SP_Info.SP_type.phys = @sysvar::MsgSPP_SP_Info::SigSP_type;
   Msg_SPP_SP_Info.TxCntspp.phys = @sysvar::MsgSPP_SP_Info::SigTxCntspp;
   Msg_SPP_SP_Info.PO_POLY_COEFF_A0.phys = @sysvar::MsgSPP_SP_Info::SigPO_POLY_COEFF_A0;
   Msg_SPP_SP_Info.PO_POLY_COEFF_A1.phys = @sysvar::MsgSPP_SP_Info::SigPO_POLY_COEFF_A1;
   Msg_SPP_SP_Info.PO_POLY_COEFF_A2.phys = @sysvar::MsgSPP_SP_Info::SigPO_POLY_COEFF_A2;
   Msg_SPP_SP_Info.PO_POLY_COEFF_A3.phys = @sysvar::MsgSPP_SP_Info::SigPO_POLY_COEFF_A3;
   Msg_SPP_SP_Info.PO_conf.phys = @sysvar::MsgSPP_SP_Info::SigPO_conf;
   Msg_SPP_SP_Info.SPP_FrameIndex.phys = @sysvar::MsgSPP_SP_Info::SigSPP_FrameIndex;
   Msg_SPP_SP_Info.PO_status.phys = @sysvar::MsgSPP_SP_Info::SigPO_status;
   Msg_SPP_SP_Info.Po_age.phys = @sysvar::MsgSPP_SP_Info::SigPo_age;
   Msg_SPP_SP_Info.PO_fusTrack_ID.phys = @sysvar::MsgSPP_SP_Info::SigPO_fusTrack_ID;
   Msg_SPP_SP_Info.PO_valid_range_max.phys = @sysvar::MsgSPP_SP_Info::SigPO_valid_range_max;
   Msg_SPP_SP_Info.PO_valid_range_min.phys = @sysvar::MsgSPP_SP_Info::SigPO_valid_range_min;
   output(Msg_SPP_SP_Info);
   Msg_Compensated_YawRate.VehYaw_Comp.phys = @sysvar::MsgCompensated_YawRate::SigVehYaw_Comp;
   Msg_Compensated_YawRate.VehYaw_Comp_Qf.phys = @sysvar::MsgCompensated_YawRate::SigVehYaw_Comp_Qf;
   Msg_Compensated_YawRate.TxCnt_CompYawRate.phys = @sysvar::MsgCompensated_YawRate::SigTxCnt_CompYawRate;
   output(Msg_Compensated_YawRate);
   Msg_VIS_TSR_SIGN_01.SIGN_1_VIS_TSR_LongPosition.phys = @sysvar::MsgVIS_TSR_SIGN_01::SigSIGN_1_VIS_TSR_LongPosition;
   Msg_VIS_TSR_SIGN_01.SIGN_1_VIS_TSR_Confidence.phys = @sysvar::MsgVIS_TSR_SIGN_01::SigSIGN_1_VIS_TSR_Confidence;
   Msg_VIS_TSR_SIGN_01.SIGN_1_VIS_TSR_Type.phys = @sysvar::MsgVIS_TSR_SIGN_01::SigSIGN_1_VIS_TSR_Type;
   Msg_VIS_TSR_SIGN_01.SIGN_1_VIS_TSR_SUPPL_Type1.phys = @sysvar::MsgVIS_TSR_SIGN_01::SigSIGN_1_VIS_TSR_SUPPL_Type1;
   Msg_VIS_TSR_SIGN_01.SIGN_1_VIS_TSR_ID.phys = @sysvar::MsgVIS_TSR_SIGN_01::SigSIGN_1_VIS_TSR_ID;
   Msg_VIS_TSR_SIGN_01.SIGN_1_VIS_TSR_SignValue.phys = @sysvar::MsgVIS_TSR_SIGN_01::SigSIGN_1_VIS_TSR_SignValue;
   Msg_VIS_TSR_SIGN_01.SIGN_1_VIS_TSR_LatPosition.phys = @sysvar::MsgVIS_TSR_SIGN_01::SigSIGN_1_VIS_TSR_LatPosition;
   output(Msg_VIS_TSR_SIGN_01);
   Msg_VIS_TSR_SIGN_02.SIGN_2_VIS_TSR_LongPosition.phys = @sysvar::MsgVIS_TSR_SIGN_02::SigSIGN_2_VIS_TSR_LongPosition;
   Msg_VIS_TSR_SIGN_02.SIGN_2_VIS_TSR_Confidence.phys = @sysvar::MsgVIS_TSR_SIGN_02::SigSIGN_2_VIS_TSR_Confidence;
   Msg_VIS_TSR_SIGN_02.SIGN_2_VIS_TSR_Type.phys = @sysvar::MsgVIS_TSR_SIGN_02::SigSIGN_2_VIS_TSR_Type;
   Msg_VIS_TSR_SIGN_02.SIGN_2_VIS_TSR_SUPPL_Type1.phys = @sysvar::MsgVIS_TSR_SIGN_02::SigSIGN_2_VIS_TSR_SUPPL_Type1;
   Msg_VIS_TSR_SIGN_02.SIGN_2_VIS_TSR_ID.phys = @sysvar::MsgVIS_TSR_SIGN_02::SigSIGN_2_VIS_TSR_ID;
   Msg_VIS_TSR_SIGN_02.SIGN_2_VIS_TSR_SignValue.phys = @sysvar::MsgVIS_TSR_SIGN_02::SigSIGN_2_VIS_TSR_SignValue;
   Msg_VIS_TSR_SIGN_02.SIGN_2_VIS_TSR_LatPosition.phys = @sysvar::MsgVIS_TSR_SIGN_02::SigSIGN_2_VIS_TSR_LatPosition;
   output(Msg_VIS_TSR_SIGN_02);
   Msg_VIS_TSR_SIGN_03.SIGN_3_VIS_TSR_LongPosition.phys = @sysvar::MsgVIS_TSR_SIGN_03::SigSIGN_3_VIS_TSR_LongPosition;
   Msg_VIS_TSR_SIGN_03.SIGN_3_VIS_TSR_Confidence.phys = @sysvar::MsgVIS_TSR_SIGN_03::SigSIGN_3_VIS_TSR_Confidence;
   Msg_VIS_TSR_SIGN_03.SIGN_3_VIS_TSR_Type.phys = @sysvar::MsgVIS_TSR_SIGN_03::SigSIGN_3_VIS_TSR_Type;
   Msg_VIS_TSR_SIGN_03.SIGN_3_VIS_TSR_SUPPL_Type1.phys = @sysvar::MsgVIS_TSR_SIGN_03::SigSIGN_3_VIS_TSR_SUPPL_Type1;
   Msg_VIS_TSR_SIGN_03.SIGN_3_VIS_TSR_ID.phys = @sysvar::MsgVIS_TSR_SIGN_03::SigSIGN_3_VIS_TSR_ID;
   Msg_VIS_TSR_SIGN_03.SIGN_3_VIS_TSR_SignValue.phys = @sysvar::MsgVIS_TSR_SIGN_03::SigSIGN_3_VIS_TSR_SignValue;
   Msg_VIS_TSR_SIGN_03.SIGN_3_VIS_TSR_LatPosition.phys = @sysvar::MsgVIS_TSR_SIGN_03::SigSIGN_3_VIS_TSR_LatPosition;
   output(Msg_VIS_TSR_SIGN_03);
   Msg_VIS_TSR_SIGN_04.SIGN_4_VIS_TSR_LongPosition.phys = @sysvar::MsgVIS_TSR_SIGN_04::SigSIGN_4_VIS_TSR_LongPosition;
   Msg_VIS_TSR_SIGN_04.SIGN_4_VIS_TSR_Confidence.phys = @sysvar::MsgVIS_TSR_SIGN_04::SigSIGN_4_VIS_TSR_Confidence;
   Msg_VIS_TSR_SIGN_04.SIGN_4_VIS_TSR_Type.phys = @sysvar::MsgVIS_TSR_SIGN_04::SigSIGN_4_VIS_TSR_Type;
   Msg_VIS_TSR_SIGN_04.SIGN_4_VIS_TSR_SUPPL_Type1.phys = @sysvar::MsgVIS_TSR_SIGN_04::SigSIGN_4_VIS_TSR_SUPPL_Type1;
   Msg_VIS_TSR_SIGN_04.SIGN_4_VIS_TSR_ID.phys = @sysvar::MsgVIS_TSR_SIGN_04::SigSIGN_4_VIS_TSR_ID;
   Msg_VIS_TSR_SIGN_04.SIGN_4_VIS_TSR_SignValue.phys = @sysvar::MsgVIS_TSR_SIGN_04::SigSIGN_4_VIS_TSR_SignValue;
   Msg_VIS_TSR_SIGN_04.SIGN_4_VIS_TSR_LatPosition.phys = @sysvar::MsgVIS_TSR_SIGN_04::SigSIGN_4_VIS_TSR_LatPosition;
   output(Msg_VIS_TSR_SIGN_04);
   Msg_VIS_TSR_SIGN_05.SIGN_5_VIS_TSR_LongPosition.phys = @sysvar::MsgVIS_TSR_SIGN_05::SigSIGN_5_VIS_TSR_LongPosition;
   Msg_VIS_TSR_SIGN_05.SIGN_5_VIS_TSR_Confidence.phys = @sysvar::MsgVIS_TSR_SIGN_05::SigSIGN_5_VIS_TSR_Confidence;
   Msg_VIS_TSR_SIGN_05.SIGN_5_VIS_TSR_Type.phys = @sysvar::MsgVIS_TSR_SIGN_05::SigSIGN_5_VIS_TSR_Type;
   Msg_VIS_TSR_SIGN_05.SIGN_5_VIS_TSR_SUPPL_Type1.phys = @sysvar::MsgVIS_TSR_SIGN_05::SigSIGN_5_VIS_TSR_SUPPL_Type1;
   Msg_VIS_TSR_SIGN_05.SIGN_5_VIS_TSR_ID.phys = @sysvar::MsgVIS_TSR_SIGN_05::SigSIGN_5_VIS_TSR_ID;
   Msg_VIS_TSR_SIGN_05.SIGN_5_VIS_TSR_SignValue.phys = @sysvar::MsgVIS_TSR_SIGN_05::SigSIGN_5_VIS_TSR_SignValue;
   Msg_VIS_TSR_SIGN_05.SIGN_5_VIS_TSR_LatPosition.phys = @sysvar::MsgVIS_TSR_SIGN_05::SigSIGN_5_VIS_TSR_LatPosition;
   output(Msg_VIS_TSR_SIGN_05);
   Msg_VIS_TSR_SIGN_06.SIGN_6_VIS_TSR_LongPosition.phys = @sysvar::MsgVIS_TSR_SIGN_06::SigSIGN_6_VIS_TSR_LongPosition;
   Msg_VIS_TSR_SIGN_06.SIGN_6_VIS_TSR_Confidence.phys = @sysvar::MsgVIS_TSR_SIGN_06::SigSIGN_6_VIS_TSR_Confidence;
   Msg_VIS_TSR_SIGN_06.SIGN_6_VIS_TSR_Type.phys = @sysvar::MsgVIS_TSR_SIGN_06::SigSIGN_6_VIS_TSR_Type;
   Msg_VIS_TSR_SIGN_06.SIGN_6_VIS_TSR_SUPPL_Type1.phys = @sysvar::MsgVIS_TSR_SIGN_06::SigSIGN_6_VIS_TSR_SUPPL_Type1;
   Msg_VIS_TSR_SIGN_06.SIGN_6_VIS_TSR_ID.phys = @sysvar::MsgVIS_TSR_SIGN_06::SigSIGN_6_VIS_TSR_ID;
   Msg_VIS_TSR_SIGN_06.SIGN_6_VIS_TSR_SignValue.phys = @sysvar::MsgVIS_TSR_SIGN_06::SigSIGN_6_VIS_TSR_SignValue;
   Msg_VIS_TSR_SIGN_06.SIGN_6_VIS_TSR_LatPosition.phys = @sysvar::MsgVIS_TSR_SIGN_06::SigSIGN_6_VIS_TSR_LatPosition;
   output(Msg_VIS_TSR_SIGN_06);
   Msg_VIS_TSR_SIGN_07.SIGN_7_VIS_TSR_LongPosition.phys = @sysvar::MsgVIS_TSR_SIGN_07::SigSIGN_7_VIS_TSR_LongPosition;
   Msg_VIS_TSR_SIGN_07.SIGN_7_VIS_TSR_Confidence.phys = @sysvar::MsgVIS_TSR_SIGN_07::SigSIGN_7_VIS_TSR_Confidence;
   Msg_VIS_TSR_SIGN_07.SIGN_7_VIS_TSR_Type.phys = @sysvar::MsgVIS_TSR_SIGN_07::SigSIGN_7_VIS_TSR_Type;
   Msg_VIS_TSR_SIGN_07.SIGN_7_VIS_TSR_SUPPL_Type1.phys = @sysvar::MsgVIS_TSR_SIGN_07::SigSIGN_7_VIS_TSR_SUPPL_Type1;
   Msg_VIS_TSR_SIGN_07.SIGN_7_VIS_TSR_ID.phys = @sysvar::MsgVIS_TSR_SIGN_07::SigSIGN_7_VIS_TSR_ID;
   Msg_VIS_TSR_SIGN_07.SIGN_7_VIS_TSR_SignValue.phys = @sysvar::MsgVIS_TSR_SIGN_07::SigSIGN_7_VIS_TSR_SignValue;
   Msg_VIS_TSR_SIGN_07.SIGN_7_VIS_TSR_LatPosition.phys = @sysvar::MsgVIS_TSR_SIGN_07::SigSIGN_7_VIS_TSR_LatPosition;
   output(Msg_VIS_TSR_SIGN_07);
   Msg_VIS_TSR_SIGN_08.SIGN_8_VIS_TSR_LongPosition.phys = @sysvar::MsgVIS_TSR_SIGN_08::SigSIGN_8_VIS_TSR_LongPosition;
   Msg_VIS_TSR_SIGN_08.SIGN_8_VIS_TSR_Confidence.phys = @sysvar::MsgVIS_TSR_SIGN_08::SigSIGN_8_VIS_TSR_Confidence;
   Msg_VIS_TSR_SIGN_08.SIGN_8_VIS_TSR_Type.phys = @sysvar::MsgVIS_TSR_SIGN_08::SigSIGN_8_VIS_TSR_Type;
   Msg_VIS_TSR_SIGN_08.SIGN_8_VIS_TSR_SUPPL_Type1.phys = @sysvar::MsgVIS_TSR_SIGN_08::SigSIGN_8_VIS_TSR_SUPPL_Type1;
   Msg_VIS_TSR_SIGN_08.SIGN_8_VIS_TSR_ID.phys = @sysvar::MsgVIS_TSR_SIGN_08::SigSIGN_8_VIS_TSR_ID;
   Msg_VIS_TSR_SIGN_08.SIGN_8_VIS_TSR_SignValue.phys = @sysvar::MsgVIS_TSR_SIGN_08::SigSIGN_8_VIS_TSR_SignValue;
   Msg_VIS_TSR_SIGN_08.SIGN_8_VIS_TSR_LatPosition.phys = @sysvar::MsgVIS_TSR_SIGN_08::SigSIGN_8_VIS_TSR_LatPosition;
   output(Msg_VIS_TSR_SIGN_08);
   Msg_VIS_TSR_SIGN_09.SIGN_9_VIS_TSR_LongPosition.phys = @sysvar::MsgVIS_TSR_SIGN_09::SigSIGN_9_VIS_TSR_LongPosition;
   Msg_VIS_TSR_SIGN_09.SIGN_9_VIS_TSR_Confidence.phys = @sysvar::MsgVIS_TSR_SIGN_09::SigSIGN_9_VIS_TSR_Confidence;
   Msg_VIS_TSR_SIGN_09.SIGN_9_VIS_TSR_Type.phys = @sysvar::MsgVIS_TSR_SIGN_09::SigSIGN_9_VIS_TSR_Type;
   Msg_VIS_TSR_SIGN_09.SIGN_9_VIS_TSR_SUPPL_Type1.phys = @sysvar::MsgVIS_TSR_SIGN_09::SigSIGN_9_VIS_TSR_SUPPL_Type1;
   Msg_VIS_TSR_SIGN_09.SIGN_9_VIS_TSR_ID.phys = @sysvar::MsgVIS_TSR_SIGN_09::SigSIGN_9_VIS_TSR_ID;
   Msg_VIS_TSR_SIGN_09.SIGN_9_VIS_TSR_SignValue.phys = @sysvar::MsgVIS_TSR_SIGN_09::SigSIGN_9_VIS_TSR_SignValue;
   Msg_VIS_TSR_SIGN_09.SIGN_9_VIS_TSR_LatPosition.phys = @sysvar::MsgVIS_TSR_SIGN_09::SigSIGN_9_VIS_TSR_LatPosition;
   output(Msg_VIS_TSR_SIGN_09);
   Msg_VIS_TSR_SIGN_10.SIGN_10_VIS_TSR_LongPosition.phys = @sysvar::MsgVIS_TSR_SIGN_10::SigSIGN_10_VIS_TSR_LongPosition;
   Msg_VIS_TSR_SIGN_10.SIGN_10_VIS_TSR_Confidence.phys = @sysvar::MsgVIS_TSR_SIGN_10::SigSIGN_10_VIS_TSR_Confidence;
   Msg_VIS_TSR_SIGN_10.SIGN_10_VIS_TSR_Type.phys = @sysvar::MsgVIS_TSR_SIGN_10::SigSIGN_10_VIS_TSR_Type;
   Msg_VIS_TSR_SIGN_10.SIGN_10_VIS_TSR_SUPPL_Type1.phys = @sysvar::MsgVIS_TSR_SIGN_10::SigSIGN_10_VIS_TSR_SUPPL_Type1;
   Msg_VIS_TSR_SIGN_10.SIGN_10_VIS_TSR_ID.phys = @sysvar::MsgVIS_TSR_SIGN_10::SigSIGN_10_VIS_TSR_ID;
   Msg_VIS_TSR_SIGN_10.SIGN_10_VIS_TSR_SignValue.phys = @sysvar::MsgVIS_TSR_SIGN_10::SigSIGN_10_VIS_TSR_SignValue;
   Msg_VIS_TSR_SIGN_10.SIGN_10_VIS_TSR_LatPosition.phys = @sysvar::MsgVIS_TSR_SIGN_10::SigSIGN_10_VIS_TSR_LatPosition;
   output(Msg_VIS_TSR_SIGN_10);
   Msg_VIS_TSR_SIGN_11.SIGN_11_VIS_TSR_LongPosition.phys = @sysvar::MsgVIS_TSR_SIGN_11::SigSIGN_11_VIS_TSR_LongPosition;
   Msg_VIS_TSR_SIGN_11.SIGN_11_VIS_TSR_Confidence.phys = @sysvar::MsgVIS_TSR_SIGN_11::SigSIGN_11_VIS_TSR_Confidence;
   Msg_VIS_TSR_SIGN_11.SIGN_11_VIS_TSR_Type.phys = @sysvar::MsgVIS_TSR_SIGN_11::SigSIGN_11_VIS_TSR_Type;
   Msg_VIS_TSR_SIGN_11.SIGN_11_VIS_TSR_SUPPL_Type1.phys = @sysvar::MsgVIS_TSR_SIGN_11::SigSIGN_11_VIS_TSR_SUPPL_Type1;
   Msg_VIS_TSR_SIGN_11.SIGN_11_VIS_TSR_ID.phys = @sysvar::MsgVIS_TSR_SIGN_11::SigSIGN_11_VIS_TSR_ID;
   Msg_VIS_TSR_SIGN_11.SIGN_11_VIS_TSR_SignValue.phys = @sysvar::MsgVIS_TSR_SIGN_11::SigSIGN_11_VIS_TSR_SignValue;
   Msg_VIS_TSR_SIGN_11.SIGN_11_VIS_TSR_LatPosition.phys = @sysvar::MsgVIS_TSR_SIGN_11::SigSIGN_11_VIS_TSR_LatPosition;
   output(Msg_VIS_TSR_SIGN_11);
   Msg_VIS_TSR_SIGN_12.SIGN_12_VIS_TSR_LongPosition.phys = @sysvar::MsgVIS_TSR_SIGN_12::SigSIGN_12_VIS_TSR_LongPosition;
   Msg_VIS_TSR_SIGN_12.SIGN_12_VIS_TSR_Confidence.phys = @sysvar::MsgVIS_TSR_SIGN_12::SigSIGN_12_VIS_TSR_Confidence;
   Msg_VIS_TSR_SIGN_12.SIGN_12_VIS_TSR_Type.phys = @sysvar::MsgVIS_TSR_SIGN_12::SigSIGN_12_VIS_TSR_Type;
   Msg_VIS_TSR_SIGN_12.SIGN_12_VIS_TSR_SUPPL_Type1.phys = @sysvar::MsgVIS_TSR_SIGN_12::SigSIGN_12_VIS_TSR_SUPPL_Type1;
   Msg_VIS_TSR_SIGN_12.SIGN_12_VIS_TSR_ID.phys = @sysvar::MsgVIS_TSR_SIGN_12::SigSIGN_12_VIS_TSR_ID;
   Msg_VIS_TSR_SIGN_12.SIGN_12_VIS_TSR_SignValue.phys = @sysvar::MsgVIS_TSR_SIGN_12::SigSIGN_12_VIS_TSR_SignValue;
   Msg_VIS_TSR_SIGN_12.SIGN_12_VIS_TSR_LatPosition.phys = @sysvar::MsgVIS_TSR_SIGN_12::SigSIGN_12_VIS_TSR_LatPosition;
   output(Msg_VIS_TSR_SIGN_12);
   Msg_VIS_TSR_SIGN_13.SIGN_13_VIS_TSR_LongPosition.phys = @sysvar::MsgVIS_TSR_SIGN_13::SigSIGN_13_VIS_TSR_LongPosition;
   Msg_VIS_TSR_SIGN_13.SIGN_13_VIS_TSR_Confidence.phys = @sysvar::MsgVIS_TSR_SIGN_13::SigSIGN_13_VIS_TSR_Confidence;
   Msg_VIS_TSR_SIGN_13.SIGN_13_VIS_TSR_Type.phys = @sysvar::MsgVIS_TSR_SIGN_13::SigSIGN_13_VIS_TSR_Type;
   Msg_VIS_TSR_SIGN_13.SIGN_13_VIS_TSR_SUPPL_Type1.phys = @sysvar::MsgVIS_TSR_SIGN_13::SigSIGN_13_VIS_TSR_SUPPL_Type1;
   Msg_VIS_TSR_SIGN_13.SIGN_13_VIS_TSR_ID.phys = @sysvar::MsgVIS_TSR_SIGN_13::SigSIGN_13_VIS_TSR_ID;
   Msg_VIS_TSR_SIGN_13.SIGN_13_VIS_TSR_SignValue.phys = @sysvar::MsgVIS_TSR_SIGN_13::SigSIGN_13_VIS_TSR_SignValue;
   Msg_VIS_TSR_SIGN_13.SIGN_13_VIS_TSR_LatPosition.phys = @sysvar::MsgVIS_TSR_SIGN_13::SigSIGN_13_VIS_TSR_LatPosition;
   output(Msg_VIS_TSR_SIGN_13);
   Msg_VIS_TSR_SIGN_14.SIGN_14_VIS_TSR_LongPosition.phys = @sysvar::MsgVIS_TSR_SIGN_14::SigSIGN_14_VIS_TSR_LongPosition;
   Msg_VIS_TSR_SIGN_14.SIGN_14_VIS_TSR_Confidence.phys = @sysvar::MsgVIS_TSR_SIGN_14::SigSIGN_14_VIS_TSR_Confidence;
   Msg_VIS_TSR_SIGN_14.SIGN_14_VIS_TSR_Type.phys = @sysvar::MsgVIS_TSR_SIGN_14::SigSIGN_14_VIS_TSR_Type;
   Msg_VIS_TSR_SIGN_14.SIGN_14_VIS_TSR_SUPPL_Type1.phys = @sysvar::MsgVIS_TSR_SIGN_14::SigSIGN_14_VIS_TSR_SUPPL_Type1;
   Msg_VIS_TSR_SIGN_14.SIGN_14_VIS_TSR_ID.phys = @sysvar::MsgVIS_TSR_SIGN_14::SigSIGN_14_VIS_TSR_ID;
   Msg_VIS_TSR_SIGN_14.SIGN_14_VIS_TSR_SignValue.phys = @sysvar::MsgVIS_TSR_SIGN_14::SigSIGN_14_VIS_TSR_SignValue;
   Msg_VIS_TSR_SIGN_14.SIGN_14_VIS_TSR_LatPosition.phys = @sysvar::MsgVIS_TSR_SIGN_14::SigSIGN_14_VIS_TSR_LatPosition;
   output(Msg_VIS_TSR_SIGN_14);
   Msg_VIS_TSR_SIGN_15.SIGN_15_VIS_TSR_LongPosition.phys = @sysvar::MsgVIS_TSR_SIGN_15::SigSIGN_15_VIS_TSR_LongPosition;
   Msg_VIS_TSR_SIGN_15.SIGN_15_VIS_TSR_Confidence.phys = @sysvar::MsgVIS_TSR_SIGN_15::SigSIGN_15_VIS_TSR_Confidence;
   Msg_VIS_TSR_SIGN_15.SIGN_15_VIS_TSR_Type.phys = @sysvar::MsgVIS_TSR_SIGN_15::SigSIGN_15_VIS_TSR_Type;
   Msg_VIS_TSR_SIGN_15.SIGN_15_VIS_TSR_SUPPL_Type1.phys = @sysvar::MsgVIS_TSR_SIGN_15::SigSIGN_15_VIS_TSR_SUPPL_Type1;
   Msg_VIS_TSR_SIGN_15.SIGN_15_VIS_TSR_ID.phys = @sysvar::MsgVIS_TSR_SIGN_15::SigSIGN_15_VIS_TSR_ID;
   Msg_VIS_TSR_SIGN_15.SIGN_15_VIS_TSR_SignValue.phys = @sysvar::MsgVIS_TSR_SIGN_15::SigSIGN_15_VIS_TSR_SignValue;
   Msg_VIS_TSR_SIGN_15.SIGN_15_VIS_TSR_LatPosition.phys = @sysvar::MsgVIS_TSR_SIGN_15::SigSIGN_15_VIS_TSR_LatPosition;
   output(Msg_VIS_TSR_SIGN_15);
   Msg_VIS_TSR_SIGN_16.SIGN_16_VIS_TSR_LongPosition.phys = @sysvar::MsgVIS_TSR_SIGN_16::SigSIGN_16_VIS_TSR_LongPosition;
   Msg_VIS_TSR_SIGN_16.SIGN_16_VIS_TSR_Confidence.phys = @sysvar::MsgVIS_TSR_SIGN_16::SigSIGN_16_VIS_TSR_Confidence;
   Msg_VIS_TSR_SIGN_16.SIGN_16_VIS_TSR_Type.phys = @sysvar::MsgVIS_TSR_SIGN_16::SigSIGN_16_VIS_TSR_Type;
   Msg_VIS_TSR_SIGN_16.SIGN_16_VIS_TSR_SUPPL_Type1.phys = @sysvar::MsgVIS_TSR_SIGN_16::SigSIGN_16_VIS_TSR_SUPPL_Type1;
   Msg_VIS_TSR_SIGN_16.SIGN_16_VIS_TSR_ID.phys = @sysvar::MsgVIS_TSR_SIGN_16::SigSIGN_16_VIS_TSR_ID;
   Msg_VIS_TSR_SIGN_16.SIGN_16_VIS_TSR_SignValue.phys = @sysvar::MsgVIS_TSR_SIGN_16::SigSIGN_16_VIS_TSR_SignValue;
   Msg_VIS_TSR_SIGN_16.SIGN_16_VIS_TSR_LatPosition.phys = @sysvar::MsgVIS_TSR_SIGN_16::SigSIGN_16_VIS_TSR_LatPosition;
   output(Msg_VIS_TSR_SIGN_16);
   Msg_VIS_TSR_SIGN_17.SIGN_17_VIS_TSR_LongPosition.phys = @sysvar::MsgVIS_TSR_SIGN_17::SigSIGN_17_VIS_TSR_LongPosition;
   Msg_VIS_TSR_SIGN_17.SIGN_17_VIS_TSR_Confidence.phys = @sysvar::MsgVIS_TSR_SIGN_17::SigSIGN_17_VIS_TSR_Confidence;
   Msg_VIS_TSR_SIGN_17.SIGN_17_VIS_TSR_Type.phys = @sysvar::MsgVIS_TSR_SIGN_17::SigSIGN_17_VIS_TSR_Type;
   Msg_VIS_TSR_SIGN_17.SIGN_17_VIS_TSR_SUPPL_Type1.phys = @sysvar::MsgVIS_TSR_SIGN_17::SigSIGN_17_VIS_TSR_SUPPL_Type1;
   Msg_VIS_TSR_SIGN_17.SIGN_17_VIS_TSR_ID.phys = @sysvar::MsgVIS_TSR_SIGN_17::SigSIGN_17_VIS_TSR_ID;
   Msg_VIS_TSR_SIGN_17.SIGN_17_VIS_TSR_SignValue.phys = @sysvar::MsgVIS_TSR_SIGN_17::SigSIGN_17_VIS_TSR_SignValue;
   Msg_VIS_TSR_SIGN_17.SIGN_17_VIS_TSR_LatPosition.phys = @sysvar::MsgVIS_TSR_SIGN_17::SigSIGN_17_VIS_TSR_LatPosition;
   output(Msg_VIS_TSR_SIGN_17);
   Msg_VIS_TSR_SIGN_18.SIGN_18_VIS_TSR_LongPosition.phys = @sysvar::MsgVIS_TSR_SIGN_18::SigSIGN_18_VIS_TSR_LongPosition;
   Msg_VIS_TSR_SIGN_18.SIGN_18_VIS_TSR_Confidence.phys = @sysvar::MsgVIS_TSR_SIGN_18::SigSIGN_18_VIS_TSR_Confidence;
   Msg_VIS_TSR_SIGN_18.SIGN_18_VIS_TSR_Type.phys = @sysvar::MsgVIS_TSR_SIGN_18::SigSIGN_18_VIS_TSR_Type;
   Msg_VIS_TSR_SIGN_18.SIGN_18_VIS_TSR_SUPPL_Type1.phys = @sysvar::MsgVIS_TSR_SIGN_18::SigSIGN_18_VIS_TSR_SUPPL_Type1;
   Msg_VIS_TSR_SIGN_18.SIGN_18_VIS_TSR_ID.phys = @sysvar::MsgVIS_TSR_SIGN_18::SigSIGN_18_VIS_TSR_ID;
   Msg_VIS_TSR_SIGN_18.SIGN_18_VIS_TSR_SignValue.phys = @sysvar::MsgVIS_TSR_SIGN_18::SigSIGN_18_VIS_TSR_SignValue;
   Msg_VIS_TSR_SIGN_18.SIGN_18_VIS_TSR_LatPosition.phys = @sysvar::MsgVIS_TSR_SIGN_18::SigSIGN_18_VIS_TSR_LatPosition;
   output(Msg_VIS_TSR_SIGN_18);
   Msg_VIS_TSR_SIGN_19.SIGN_19_VIS_TSR_LongPosition.phys = @sysvar::MsgVIS_TSR_SIGN_19::SigSIGN_19_VIS_TSR_LongPosition;
   Msg_VIS_TSR_SIGN_19.SIGN_19_VIS_TSR_Confidence.phys = @sysvar::MsgVIS_TSR_SIGN_19::SigSIGN_19_VIS_TSR_Confidence;
   Msg_VIS_TSR_SIGN_19.SIGN_19_VIS_TSR_Type.phys = @sysvar::MsgVIS_TSR_SIGN_19::SigSIGN_19_VIS_TSR_Type;
   Msg_VIS_TSR_SIGN_19.SIGN_19_VIS_TSR_SUPPL_Type1.phys = @sysvar::MsgVIS_TSR_SIGN_19::SigSIGN_19_VIS_TSR_SUPPL_Type1;
   Msg_VIS_TSR_SIGN_19.SIGN_19_VIS_TSR_ID.phys = @sysvar::MsgVIS_TSR_SIGN_19::SigSIGN_19_VIS_TSR_ID;
   Msg_VIS_TSR_SIGN_19.SIGN_19_VIS_TSR_SignValue.phys = @sysvar::MsgVIS_TSR_SIGN_19::SigSIGN_19_VIS_TSR_SignValue;
   Msg_VIS_TSR_SIGN_19.SIGN_19_VIS_TSR_LatPosition.phys = @sysvar::MsgVIS_TSR_SIGN_19::SigSIGN_19_VIS_TSR_LatPosition;
   output(Msg_VIS_TSR_SIGN_19);
   Msg_VIS_TSR_SIGN_20.SIGN_20_VIS_TSR_LongPosition.phys = @sysvar::MsgVIS_TSR_SIGN_20::SigSIGN_20_VIS_TSR_LongPosition;
   Msg_VIS_TSR_SIGN_20.SIGN_20_VIS_TSR_Confidence.phys = @sysvar::MsgVIS_TSR_SIGN_20::SigSIGN_20_VIS_TSR_Confidence;
   Msg_VIS_TSR_SIGN_20.SIGN_20_VIS_TSR_Type.phys = @sysvar::MsgVIS_TSR_SIGN_20::SigSIGN_20_VIS_TSR_Type;
   Msg_VIS_TSR_SIGN_20.SIGN_20_VIS_TSR_SUPPL_Type1.phys = @sysvar::MsgVIS_TSR_SIGN_20::SigSIGN_20_VIS_TSR_SUPPL_Type1;
   Msg_VIS_TSR_SIGN_20.SIGN_20_VIS_TSR_ID.phys = @sysvar::MsgVIS_TSR_SIGN_20::SigSIGN_20_VIS_TSR_ID;
   Msg_VIS_TSR_SIGN_20.SIGN_20_VIS_TSR_SignValue.phys = @sysvar::MsgVIS_TSR_SIGN_20::SigSIGN_20_VIS_TSR_SignValue;
   Msg_VIS_TSR_SIGN_20.SIGN_20_VIS_TSR_LatPosition.phys = @sysvar::MsgVIS_TSR_SIGN_20::SigSIGN_20_VIS_TSR_LatPosition;
   output(Msg_VIS_TSR_SIGN_20);
   Msg_VIS_StopLine_01.StopLine_01_stopLineColorType.phys = @sysvar::MsgVIS_StopLine_01::SigStopLine_01_stopLineColorType;
   Msg_VIS_StopLine_01.StopLine_01_stopLineType.phys = @sysvar::MsgVIS_StopLine_01::SigStopLine_01_stopLineType;
   Msg_VIS_StopLine_01.StopLine_01_id.phys = @sysvar::MsgVIS_StopLine_01::SigStopLine_01_id;
   Msg_VIS_StopLine_01.StopLine_01_longitudinalDistance.phys = @sysvar::MsgVIS_StopLine_01::SigStopLine_01_longitudinalDistance;
   Msg_VIS_StopLine_01.StopLine_01_lateralDistance.phys = @sysvar::MsgVIS_StopLine_01::SigStopLine_01_lateralDistance;
   Msg_VIS_StopLine_01.StopLine_01_confidence.phys = @sysvar::MsgVIS_StopLine_01::SigStopLine_01_confidence;
   output(Msg_VIS_StopLine_01);
   Msg_VIS_StopLine_02.StopLine_02_stopLineColorType.phys = @sysvar::MsgVIS_StopLine_02::SigStopLine_02_stopLineColorType;
   Msg_VIS_StopLine_02.StopLine_02_stopLineType.phys = @sysvar::MsgVIS_StopLine_02::SigStopLine_02_stopLineType;
   Msg_VIS_StopLine_02.StopLine_02_id.phys = @sysvar::MsgVIS_StopLine_02::SigStopLine_02_id;
   Msg_VIS_StopLine_02.StopLine_02_longitudinalDistance.phys = @sysvar::MsgVIS_StopLine_02::SigStopLine_02_longitudinalDistance;
   Msg_VIS_StopLine_02.StopLine_02_lateralDistance.phys = @sysvar::MsgVIS_StopLine_02::SigStopLine_02_lateralDistance;
   Msg_VIS_StopLine_02.StopLine_02_confidence.phys = @sysvar::MsgVIS_StopLine_02::SigStopLine_02_confidence;
   output(Msg_VIS_StopLine_02);
   Msg_VIS_StopLine_03.StopLine_03_stopLineColorType.phys = @sysvar::MsgVIS_StopLine_03::SigStopLine_03_stopLineColorType;
   Msg_VIS_StopLine_03.StopLine_03_stopLineType.phys = @sysvar::MsgVIS_StopLine_03::SigStopLine_03_stopLineType;
   Msg_VIS_StopLine_03.StopLine_03_id.phys = @sysvar::MsgVIS_StopLine_03::SigStopLine_03_id;
   Msg_VIS_StopLine_03.StopLine_03_longitudinalDistance.phys = @sysvar::MsgVIS_StopLine_03::SigStopLine_03_longitudinalDistance;
   Msg_VIS_StopLine_03.StopLine_03_lateralDistance.phys = @sysvar::MsgVIS_StopLine_03::SigStopLine_03_lateralDistance;
   Msg_VIS_StopLine_03.StopLine_03_confidence.phys = @sysvar::MsgVIS_StopLine_03::SigStopLine_03_confidence;
   output(Msg_VIS_StopLine_03);
   Msg_VIS_StopLine_04.StopLine_04_stopLineColorType.phys = @sysvar::MsgVIS_StopLine_04::SigStopLine_04_stopLineColorType;
   Msg_VIS_StopLine_04.StopLine_04_stopLineType.phys = @sysvar::MsgVIS_StopLine_04::SigStopLine_04_stopLineType;
   Msg_VIS_StopLine_04.StopLine_04_id.phys = @sysvar::MsgVIS_StopLine_04::SigStopLine_04_id;
   Msg_VIS_StopLine_04.StopLine_04_longitudinalDistance.phys = @sysvar::MsgVIS_StopLine_04::SigStopLine_04_longitudinalDistance;
   Msg_VIS_StopLine_04.StopLine_04_lateralDistance.phys = @sysvar::MsgVIS_StopLine_04::SigStopLine_04_lateralDistance;
   Msg_VIS_StopLine_04.StopLine_04_confidence.phys = @sysvar::MsgVIS_StopLine_04::SigStopLine_04_confidence;
   output(Msg_VIS_StopLine_04);
   Msg_VIS_StopLine_05.StopLine_05_stopLineColorType.phys = @sysvar::MsgVIS_StopLine_05::SigStopLine_05_stopLineColorType;
   Msg_VIS_StopLine_05.StopLine_05_stopLineType.phys = @sysvar::MsgVIS_StopLine_05::SigStopLine_05_stopLineType;
   Msg_VIS_StopLine_05.StopLine_05_id.phys = @sysvar::MsgVIS_StopLine_05::SigStopLine_05_id;
   Msg_VIS_StopLine_05.StopLine_05_longitudinalDistance.phys = @sysvar::MsgVIS_StopLine_05::SigStopLine_05_longitudinalDistance;
   Msg_VIS_StopLine_05.StopLine_05_lateralDistance.phys = @sysvar::MsgVIS_StopLine_05::SigStopLine_05_lateralDistance;
   Msg_VIS_StopLine_05.StopLine_05_confidence.phys = @sysvar::MsgVIS_StopLine_05::SigStopLine_05_confidence;
   output(Msg_VIS_StopLine_05);
   Msg_VIS_StopLine_06.StopLine_06_stopLineColorType.phys = @sysvar::MsgVIS_StopLine_06::SigStopLine_06_stopLineColorType;
   Msg_VIS_StopLine_06.StopLine_06_stopLineType.phys = @sysvar::MsgVIS_StopLine_06::SigStopLine_06_stopLineType;
   Msg_VIS_StopLine_06.StopLine_06_id.phys = @sysvar::MsgVIS_StopLine_06::SigStopLine_06_id;
   Msg_VIS_StopLine_06.StopLine_06_longitudinalDistance.phys = @sysvar::MsgVIS_StopLine_06::SigStopLine_06_longitudinalDistance;
   Msg_VIS_StopLine_06.StopLine_06_lateralDistance.phys = @sysvar::MsgVIS_StopLine_06::SigStopLine_06_lateralDistance;
   Msg_VIS_StopLine_06.StopLine_06_confidence.phys = @sysvar::MsgVIS_StopLine_06::SigStopLine_06_confidence;
   output(Msg_VIS_StopLine_06);
   Msg_VIS_StopLine_07.StopLine_07_stopLineColorType.phys = @sysvar::MsgVIS_StopLine_07::SigStopLine_07_stopLineColorType;
   Msg_VIS_StopLine_07.StopLine_07_stopLineType.phys = @sysvar::MsgVIS_StopLine_07::SigStopLine_07_stopLineType;
   Msg_VIS_StopLine_07.StopLine_07_id.phys = @sysvar::MsgVIS_StopLine_07::SigStopLine_07_id;
   Msg_VIS_StopLine_07.StopLine_07_longitudinalDistance.phys = @sysvar::MsgVIS_StopLine_07::SigStopLine_07_longitudinalDistance;
   Msg_VIS_StopLine_07.StopLine_07_lateralDistance.phys = @sysvar::MsgVIS_StopLine_07::SigStopLine_07_lateralDistance;
   Msg_VIS_StopLine_07.StopLine_07_confidence.phys = @sysvar::MsgVIS_StopLine_07::SigStopLine_07_confidence;
   output(Msg_VIS_StopLine_07);
   Msg_VIS_StopLine_08.StopLine_08_stopLineColorType.phys = @sysvar::MsgVIS_StopLine_08::SigStopLine_08_stopLineColorType;
   Msg_VIS_StopLine_08.StopLine_08_stopLineType.phys = @sysvar::MsgVIS_StopLine_08::SigStopLine_08_stopLineType;
   Msg_VIS_StopLine_08.StopLine_08_id.phys = @sysvar::MsgVIS_StopLine_08::SigStopLine_08_id;
   Msg_VIS_StopLine_08.StopLine_08_longitudinalDistance.phys = @sysvar::MsgVIS_StopLine_08::SigStopLine_08_longitudinalDistance;
   Msg_VIS_StopLine_08.StopLine_08_lateralDistance.phys = @sysvar::MsgVIS_StopLine_08::SigStopLine_08_lateralDistance;
   Msg_VIS_StopLine_08.StopLine_08_confidence.phys = @sysvar::MsgVIS_StopLine_08::SigStopLine_08_confidence;
   output(Msg_VIS_StopLine_08);
   Msg_VIS_StopLine_09.StopLine_09_stopLineColorType.phys = @sysvar::MsgVIS_StopLine_09::SigStopLine_09_stopLineColorType;
   Msg_VIS_StopLine_09.StopLine_09_stopLineType.phys = @sysvar::MsgVIS_StopLine_09::SigStopLine_09_stopLineType;
   Msg_VIS_StopLine_09.StopLine_09_id.phys = @sysvar::MsgVIS_StopLine_09::SigStopLine_09_id;
   Msg_VIS_StopLine_09.StopLine_09_longitudinalDistance.phys = @sysvar::MsgVIS_StopLine_09::SigStopLine_09_longitudinalDistance;
   Msg_VIS_StopLine_09.StopLine_09_lateralDistance.phys = @sysvar::MsgVIS_StopLine_09::SigStopLine_09_lateralDistance;
   Msg_VIS_StopLine_09.StopLine_09_confidence.phys = @sysvar::MsgVIS_StopLine_09::SigStopLine_09_confidence;
   output(Msg_VIS_StopLine_09);
   Msg_VIS_StopLine_10.StopLine_10_stopLineColorType.phys = @sysvar::MsgVIS_StopLine_10::SigStopLine_10_stopLineColorType;
   Msg_VIS_StopLine_10.StopLine_10_stopLineType.phys = @sysvar::MsgVIS_StopLine_10::SigStopLine_10_stopLineType;
   Msg_VIS_StopLine_10.StopLine_10_id.phys = @sysvar::MsgVIS_StopLine_10::SigStopLine_10_id;
   Msg_VIS_StopLine_10.StopLine_10_longitudinalDistance.phys = @sysvar::MsgVIS_StopLine_10::SigStopLine_10_longitudinalDistance;
   Msg_VIS_StopLine_10.StopLine_10_lateralDistance.phys = @sysvar::MsgVIS_StopLine_10::SigStopLine_10_lateralDistance;
   Msg_VIS_StopLine_10.StopLine_10_confidence.phys = @sysvar::MsgVIS_StopLine_10::SigStopLine_10_confidence;
   output(Msg_VIS_StopLine_10);
   Msg_VIS_Arrow_01.Arrow_01_ArrowType.phys = @sysvar::MsgVIS_Arrow_01::SigArrow_01_ArrowType;
   Msg_VIS_Arrow_01.Arrow_01_id.phys = @sysvar::MsgVIS_Arrow_01::SigArrow_01_id;
   Msg_VIS_Arrow_01.Arrow_01_longitudinalDistance.phys = @sysvar::MsgVIS_Arrow_01::SigArrow_01_longitudinalDistance;
   Msg_VIS_Arrow_01.Arrow_01_lateralDistance.phys = @sysvar::MsgVIS_Arrow_01::SigArrow_01_lateralDistance;
   Msg_VIS_Arrow_01.Arrow_01_confidence.phys = @sysvar::MsgVIS_Arrow_01::SigArrow_01_confidence;
   output(Msg_VIS_Arrow_01);
   Msg_VIS_Arrow_02.Arrow_02_ArrowType.phys = @sysvar::MsgVIS_Arrow_02::SigArrow_02_ArrowType;
   Msg_VIS_Arrow_02.Arrow_02_id.phys = @sysvar::MsgVIS_Arrow_02::SigArrow_02_id;
   Msg_VIS_Arrow_02.Arrow_02_longitudinalDistance.phys = @sysvar::MsgVIS_Arrow_02::SigArrow_02_longitudinalDistance;
   Msg_VIS_Arrow_02.Arrow_02_lateralDistance.phys = @sysvar::MsgVIS_Arrow_02::SigArrow_02_lateralDistance;
   Msg_VIS_Arrow_02.Arrow_02_confidence.phys = @sysvar::MsgVIS_Arrow_02::SigArrow_02_confidence;
   output(Msg_VIS_Arrow_02);
   Msg_VIS_Arrow_03.Arrow_03_ArrowType.phys = @sysvar::MsgVIS_Arrow_03::SigArrow_03_ArrowType;
   Msg_VIS_Arrow_03.Arrow_03_id.phys = @sysvar::MsgVIS_Arrow_03::SigArrow_03_id;
   Msg_VIS_Arrow_03.Arrow_03_longitudinalDistance.phys = @sysvar::MsgVIS_Arrow_03::SigArrow_03_longitudinalDistance;
   Msg_VIS_Arrow_03.Arrow_03_lateralDistance.phys = @sysvar::MsgVIS_Arrow_03::SigArrow_03_lateralDistance;
   Msg_VIS_Arrow_03.Arrow_03_confidence.phys = @sysvar::MsgVIS_Arrow_03::SigArrow_03_confidence;
   output(Msg_VIS_Arrow_03);
   Msg_VIS_Arrow_04.Arrow_04_ArrowType.phys = @sysvar::MsgVIS_Arrow_04::SigArrow_04_ArrowType;
   Msg_VIS_Arrow_04.Arrow_04_id.phys = @sysvar::MsgVIS_Arrow_04::SigArrow_04_id;
   Msg_VIS_Arrow_04.Arrow_04_longitudinalDistance.phys = @sysvar::MsgVIS_Arrow_04::SigArrow_04_longitudinalDistance;
   Msg_VIS_Arrow_04.Arrow_04_lateralDistance.phys = @sysvar::MsgVIS_Arrow_04::SigArrow_04_lateralDistance;
   Msg_VIS_Arrow_04.Arrow_04_confidence.phys = @sysvar::MsgVIS_Arrow_04::SigArrow_04_confidence;
   output(Msg_VIS_Arrow_04);
   Msg_VIS_Arrow_05.Arrow_05_ArrowType.phys = @sysvar::MsgVIS_Arrow_05::SigArrow_05_ArrowType;
   Msg_VIS_Arrow_05.Arrow_05_id.phys = @sysvar::MsgVIS_Arrow_05::SigArrow_05_id;
   Msg_VIS_Arrow_05.Arrow_05_longitudinalDistance.phys = @sysvar::MsgVIS_Arrow_05::SigArrow_05_longitudinalDistance;
   Msg_VIS_Arrow_05.Arrow_05_lateralDistance.phys = @sysvar::MsgVIS_Arrow_05::SigArrow_05_lateralDistance;
   Msg_VIS_Arrow_05.Arrow_05_confidence.phys = @sysvar::MsgVIS_Arrow_05::SigArrow_05_confidence;
   output(Msg_VIS_Arrow_05);
   Msg_VIS_Arrow_06.Arrow_06_ArrowType.phys = @sysvar::MsgVIS_Arrow_06::SigArrow_06_ArrowType;
   Msg_VIS_Arrow_06.Arrow_06_id.phys = @sysvar::MsgVIS_Arrow_06::SigArrow_06_id;
   Msg_VIS_Arrow_06.Arrow_06_longitudinalDistance.phys = @sysvar::MsgVIS_Arrow_06::SigArrow_06_longitudinalDistance;
   Msg_VIS_Arrow_06.Arrow_06_lateralDistance.phys = @sysvar::MsgVIS_Arrow_06::SigArrow_06_lateralDistance;
   Msg_VIS_Arrow_06.Arrow_06_confidence.phys = @sysvar::MsgVIS_Arrow_06::SigArrow_06_confidence;
   output(Msg_VIS_Arrow_06);
   Msg_VIS_Arrow_07.Arrow_07_ArrowType.phys = @sysvar::MsgVIS_Arrow_07::SigArrow_07_ArrowType;
   Msg_VIS_Arrow_07.Arrow_07_id.phys = @sysvar::MsgVIS_Arrow_07::SigArrow_07_id;
   Msg_VIS_Arrow_07.Arrow_07_longitudinalDistance.phys = @sysvar::MsgVIS_Arrow_07::SigArrow_07_longitudinalDistance;
   Msg_VIS_Arrow_07.Arrow_07_lateralDistance.phys = @sysvar::MsgVIS_Arrow_07::SigArrow_07_lateralDistance;
   Msg_VIS_Arrow_07.Arrow_07_confidence.phys = @sysvar::MsgVIS_Arrow_07::SigArrow_07_confidence;
   output(Msg_VIS_Arrow_07);
   Msg_VIS_Arrow_08.Arrow_08_ArrowType.phys = @sysvar::MsgVIS_Arrow_08::SigArrow_08_ArrowType;
   Msg_VIS_Arrow_08.Arrow_08_id.phys = @sysvar::MsgVIS_Arrow_08::SigArrow_08_id;
   Msg_VIS_Arrow_08.Arrow_08_longitudinalDistance.phys = @sysvar::MsgVIS_Arrow_08::SigArrow_08_longitudinalDistance;
   Msg_VIS_Arrow_08.Arrow_08_lateralDistance.phys = @sysvar::MsgVIS_Arrow_08::SigArrow_08_lateralDistance;
   Msg_VIS_Arrow_08.Arrow_08_confidence.phys = @sysvar::MsgVIS_Arrow_08::SigArrow_08_confidence;
   output(Msg_VIS_Arrow_08);
   Msg_VIS_Arrow_09.Arrow_09_ArrowType.phys = @sysvar::MsgVIS_Arrow_09::SigArrow_09_ArrowType;
   Msg_VIS_Arrow_09.Arrow_09_id.phys = @sysvar::MsgVIS_Arrow_09::SigArrow_09_id;
   Msg_VIS_Arrow_09.Arrow_09_longitudinalDistance.phys = @sysvar::MsgVIS_Arrow_09::SigArrow_09_longitudinalDistance;
   Msg_VIS_Arrow_09.Arrow_09_lateralDistance.phys = @sysvar::MsgVIS_Arrow_09::SigArrow_09_lateralDistance;
   Msg_VIS_Arrow_09.Arrow_09_confidence.phys = @sysvar::MsgVIS_Arrow_09::SigArrow_09_confidence;
   output(Msg_VIS_Arrow_09);
   Msg_VIS_Arrow_10.Arrow_10_ArrowType.phys = @sysvar::MsgVIS_Arrow_10::SigArrow_10_ArrowType;
   Msg_VIS_Arrow_10.Arrow_10_id.phys = @sysvar::MsgVIS_Arrow_10::SigArrow_10_id;
   Msg_VIS_Arrow_10.Arrow_10_longitudinalDistance.phys = @sysvar::MsgVIS_Arrow_10::SigArrow_10_longitudinalDistance;
   Msg_VIS_Arrow_10.Arrow_10_lateralDistance.phys = @sysvar::MsgVIS_Arrow_10::SigArrow_10_lateralDistance;
   Msg_VIS_Arrow_10.Arrow_10_confidence.phys = @sysvar::MsgVIS_Arrow_10::SigArrow_10_confidence;
   output(Msg_VIS_Arrow_10);
   Msg_VIS_Transition_01.Transition_01_LineRole.phys = @sysvar::MsgVIS_Transition_01::SigTransition_01_LineRole;
   Msg_VIS_Transition_01.Transition_01_StartOrEnd.phys = @sysvar::MsgVIS_Transition_01::SigTransition_01_StartOrEnd;
   Msg_VIS_Transition_01.Transition_01_Type.phys = @sysvar::MsgVIS_Transition_01::SigTransition_01_Type;
   Msg_VIS_Transition_01.Transition_01_longPosition.phys = @sysvar::MsgVIS_Transition_01::SigTransition_01_longPosition;
   Msg_VIS_Transition_01.Transition_01_lateralPosition.phys = @sysvar::MsgVIS_Transition_01::SigTransition_01_lateralPosition;
   Msg_VIS_Transition_01.Transition_01_Probability.phys = @sysvar::MsgVIS_Transition_01::SigTransition_01_Probability;
   output(Msg_VIS_Transition_01);
   Msg_VIS_Transition_02.Transition_02_LineRole.phys = @sysvar::MsgVIS_Transition_02::SigTransition_02_LineRole;
   Msg_VIS_Transition_02.Transition_02_StartOrEnd.phys = @sysvar::MsgVIS_Transition_02::SigTransition_02_StartOrEnd;
   Msg_VIS_Transition_02.Transition_02_Type.phys = @sysvar::MsgVIS_Transition_02::SigTransition_02_Type;
   Msg_VIS_Transition_02.Transition_02_longPosition.phys = @sysvar::MsgVIS_Transition_02::SigTransition_02_longPosition;
   Msg_VIS_Transition_02.Transition_02_lateralPosition.phys = @sysvar::MsgVIS_Transition_02::SigTransition_02_lateralPosition;
   Msg_VIS_Transition_02.Transition_02_Probability.phys = @sysvar::MsgVIS_Transition_02::SigTransition_02_Probability;
   output(Msg_VIS_Transition_02);
   Msg_VIS_Transition_03.Transition_03_LineRole.phys = @sysvar::MsgVIS_Transition_03::SigTransition_03_LineRole;
   Msg_VIS_Transition_03.Transition_03_StartOrEnd.phys = @sysvar::MsgVIS_Transition_03::SigTransition_03_StartOrEnd;
   Msg_VIS_Transition_03.Transition_03_Type.phys = @sysvar::MsgVIS_Transition_03::SigTransition_03_Type;
   Msg_VIS_Transition_03.Transition_03_longPosition.phys = @sysvar::MsgVIS_Transition_03::SigTransition_03_longPosition;
   Msg_VIS_Transition_03.Transition_03_lateralPosition.phys = @sysvar::MsgVIS_Transition_03::SigTransition_03_lateralPosition;
   Msg_VIS_Transition_03.Transition_03_Probability.phys = @sysvar::MsgVIS_Transition_03::SigTransition_03_Probability;
   output(Msg_VIS_Transition_03);
   Msg_VIS_Transition_04.Transition_04_LineRole.phys = @sysvar::MsgVIS_Transition_04::SigTransition_04_LineRole;
   Msg_VIS_Transition_04.Transition_04_StartOrEnd.phys = @sysvar::MsgVIS_Transition_04::SigTransition_04_StartOrEnd;
   Msg_VIS_Transition_04.Transition_04_Type.phys = @sysvar::MsgVIS_Transition_04::SigTransition_04_Type;
   Msg_VIS_Transition_04.Transition_04_longPosition.phys = @sysvar::MsgVIS_Transition_04::SigTransition_04_longPosition;
   Msg_VIS_Transition_04.Transition_04_lateralPosition.phys = @sysvar::MsgVIS_Transition_04::SigTransition_04_lateralPosition;
   Msg_VIS_Transition_04.Transition_04_Probability.phys = @sysvar::MsgVIS_Transition_04::SigTransition_04_Probability;
   output(Msg_VIS_Transition_04);
   Msg_VIS_Transition_05.Transition_05_LineRole.phys = @sysvar::MsgVIS_Transition_05::SigTransition_05_LineRole;
   Msg_VIS_Transition_05.Transition_05_StartOrEnd.phys = @sysvar::MsgVIS_Transition_05::SigTransition_05_StartOrEnd;
   Msg_VIS_Transition_05.Transition_05_Type.phys = @sysvar::MsgVIS_Transition_05::SigTransition_05_Type;
   Msg_VIS_Transition_05.Transition_05_longPosition.phys = @sysvar::MsgVIS_Transition_05::SigTransition_05_longPosition;
   Msg_VIS_Transition_05.Transition_05_lateralPosition.phys = @sysvar::MsgVIS_Transition_05::SigTransition_05_lateralPosition;
   Msg_VIS_Transition_05.Transition_05_Probability.phys = @sysvar::MsgVIS_Transition_05::SigTransition_05_Probability;
   output(Msg_VIS_Transition_05);
   Msg_VIS_Transition_06.Transition_06_LineRole.phys = @sysvar::MsgVIS_Transition_06::SigTransition_06_LineRole;
   Msg_VIS_Transition_06.Transition_06_StartOrEnd.phys = @sysvar::MsgVIS_Transition_06::SigTransition_06_StartOrEnd;
   Msg_VIS_Transition_06.Transition_06_Type.phys = @sysvar::MsgVIS_Transition_06::SigTransition_06_Type;
   Msg_VIS_Transition_06.Transition_06_longPosition.phys = @sysvar::MsgVIS_Transition_06::SigTransition_06_longPosition;
   Msg_VIS_Transition_06.Transition_06_lateralPosition.phys = @sysvar::MsgVIS_Transition_06::SigTransition_06_lateralPosition;
   Msg_VIS_Transition_06.Transition_06_Probability.phys = @sysvar::MsgVIS_Transition_06::SigTransition_06_Probability;
   output(Msg_VIS_Transition_06);
   Msg_VIS_Transition_07.Transition_07_LineRole.phys = @sysvar::MsgVIS_Transition_07::SigTransition_07_LineRole;
   Msg_VIS_Transition_07.Transition_07_StartOrEnd.phys = @sysvar::MsgVIS_Transition_07::SigTransition_07_StartOrEnd;
   Msg_VIS_Transition_07.Transition_07_Type.phys = @sysvar::MsgVIS_Transition_07::SigTransition_07_Type;
   Msg_VIS_Transition_07.Transition_07_longPosition.phys = @sysvar::MsgVIS_Transition_07::SigTransition_07_longPosition;
   Msg_VIS_Transition_07.Transition_07_lateralPosition.phys = @sysvar::MsgVIS_Transition_07::SigTransition_07_lateralPosition;
   Msg_VIS_Transition_07.Transition_07_Probability.phys = @sysvar::MsgVIS_Transition_07::SigTransition_07_Probability;
   output(Msg_VIS_Transition_07);
   Msg_VIS_Transition_08.Transition_08_LineRole.phys = @sysvar::MsgVIS_Transition_08::SigTransition_08_LineRole;
   Msg_VIS_Transition_08.Transition_08_StartOrEnd.phys = @sysvar::MsgVIS_Transition_08::SigTransition_08_StartOrEnd;
   Msg_VIS_Transition_08.Transition_08_Type.phys = @sysvar::MsgVIS_Transition_08::SigTransition_08_Type;
   Msg_VIS_Transition_08.Transition_08_longPosition.phys = @sysvar::MsgVIS_Transition_08::SigTransition_08_longPosition;
   Msg_VIS_Transition_08.Transition_08_lateralPosition.phys = @sysvar::MsgVIS_Transition_08::SigTransition_08_lateralPosition;
   Msg_VIS_Transition_08.Transition_08_Probability.phys = @sysvar::MsgVIS_Transition_08::SigTransition_08_Probability;
   output(Msg_VIS_Transition_08);
   Msg_VIS_Transition_09.Transition_09_LineRole.phys = @sysvar::MsgVIS_Transition_09::SigTransition_09_LineRole;
   Msg_VIS_Transition_09.Transition_09_StartOrEnd.phys = @sysvar::MsgVIS_Transition_09::SigTransition_09_StartOrEnd;
   Msg_VIS_Transition_09.Transition_09_Type.phys = @sysvar::MsgVIS_Transition_09::SigTransition_09_Type;
   Msg_VIS_Transition_09.Transition_09_longPosition.phys = @sysvar::MsgVIS_Transition_09::SigTransition_09_longPosition;
   Msg_VIS_Transition_09.Transition_09_lateralPosition.phys = @sysvar::MsgVIS_Transition_09::SigTransition_09_lateralPosition;
   Msg_VIS_Transition_09.Transition_09_Probability.phys = @sysvar::MsgVIS_Transition_09::SigTransition_09_Probability;
   output(Msg_VIS_Transition_09);
   Msg_VIS_Transition_10.Transition_10_LineRole.phys = @sysvar::MsgVIS_Transition_10::SigTransition_10_LineRole;
   Msg_VIS_Transition_10.Transition_10_StartOrEnd.phys = @sysvar::MsgVIS_Transition_10::SigTransition_10_StartOrEnd;
   Msg_VIS_Transition_10.Transition_10_Type.phys = @sysvar::MsgVIS_Transition_10::SigTransition_10_Type;
   Msg_VIS_Transition_10.Transition_10_longPosition.phys = @sysvar::MsgVIS_Transition_10::SigTransition_10_longPosition;
   Msg_VIS_Transition_10.Transition_10_lateralPosition.phys = @sysvar::MsgVIS_Transition_10::SigTransition_10_lateralPosition;
   Msg_VIS_Transition_10.Transition_10_Probability.phys = @sysvar::MsgVIS_Transition_10::SigTransition_10_Probability;
   output(Msg_VIS_Transition_10);
   Msg_VIS_Transition_11.Transition_11_LineRole.phys = @sysvar::MsgVIS_Transition_11::SigTransition_11_LineRole;
   Msg_VIS_Transition_11.Transition_11_StartOrEnd.phys = @sysvar::MsgVIS_Transition_11::SigTransition_11_StartOrEnd;
   Msg_VIS_Transition_11.Transition_11_Type.phys = @sysvar::MsgVIS_Transition_11::SigTransition_11_Type;
   Msg_VIS_Transition_11.Transition_11_longPosition.phys = @sysvar::MsgVIS_Transition_11::SigTransition_11_longPosition;
   Msg_VIS_Transition_11.Transition_11_lateralPosition.phys = @sysvar::MsgVIS_Transition_11::SigTransition_11_lateralPosition;
   Msg_VIS_Transition_11.Transition_11_Probability.phys = @sysvar::MsgVIS_Transition_11::SigTransition_11_Probability;
   output(Msg_VIS_Transition_11);
   Msg_VIS_Transition_12.Transition_12_LineRole.phys = @sysvar::MsgVIS_Transition_12::SigTransition_12_LineRole;
   Msg_VIS_Transition_12.Transition_12_StartOrEnd.phys = @sysvar::MsgVIS_Transition_12::SigTransition_12_StartOrEnd;
   Msg_VIS_Transition_12.Transition_12_Type.phys = @sysvar::MsgVIS_Transition_12::SigTransition_12_Type;
   Msg_VIS_Transition_12.Transition_12_longPosition.phys = @sysvar::MsgVIS_Transition_12::SigTransition_12_longPosition;
   Msg_VIS_Transition_12.Transition_12_lateralPosition.phys = @sysvar::MsgVIS_Transition_12::SigTransition_12_lateralPosition;
   Msg_VIS_Transition_12.Transition_12_Probability.phys = @sysvar::MsgVIS_Transition_12::SigTransition_12_Probability;
   output(Msg_VIS_Transition_12);
   Msg_streamTxCntCheck.streamTxCnt.phys = @sysvar::MsgstreamTxCntCheck::SigstreamTxCnt;
   Msg_streamTxCntCheck.Counter_ValidMovObj_ALL.phys = @sysvar::MsgstreamTxCntCheck::SigCounter_ValidMovObj_ALL;
   Msg_streamTxCntCheck.Counter_ValidMovObj_HalfBehind.phys = @sysvar::MsgstreamTxCntCheck::SigCounter_ValidMovObj_HalfBehind;
   output(Msg_streamTxCntCheck);
}
on timer Timer_50ms
{
   Msg_StreamCounter_ETSEL.StreamCounter_ETSEL.phys = @sysvar::MsgStreamCounter_ETSEL::SigStreamCounter_ETSEL;
   output(Msg_StreamCounter_ETSEL);
   Msg_U3T_Obj_88_50ms.U3T88_age.phys = @sysvar::MsgU3T_Obj_88_50ms::SigU3T88_age;
   Msg_U3T_Obj_88_50ms.U3T88_f_moveable.phys = @sysvar::MsgU3T_Obj_88_50ms::SigU3T88_f_moveable;
   Msg_U3T_Obj_88_50ms.U3T88_f_stationary.phys = @sysvar::MsgU3T_Obj_88_50ms::SigU3T88_f_stationary;
   Msg_U3T_Obj_88_50ms.U3T88_FLcorner_lat.phys = @sysvar::MsgU3T_Obj_88_50ms::SigU3T88_FLcorner_lat;
   Msg_U3T_Obj_88_50ms.U3T88_object_class.phys = @sysvar::MsgU3T_Obj_88_50ms::SigU3T88_object_class;
   Msg_U3T_Obj_88_50ms.U3T88_FLcorner_long.phys = @sysvar::MsgU3T_Obj_88_50ms::SigU3T88_FLcorner_long;
   Msg_U3T_Obj_88_50ms.U3T88_status.phys = @sysvar::MsgU3T_Obj_88_50ms::SigU3T88_status;
   Msg_U3T_Obj_88_50ms.U3T88_FRcorner_lat.phys = @sysvar::MsgU3T_Obj_88_50ms::SigU3T88_FRcorner_lat;
   Msg_U3T_Obj_88_50ms.U3T88_FRcorner_long.phys = @sysvar::MsgU3T_Obj_88_50ms::SigU3T88_FRcorner_long;
   Msg_U3T_Obj_88_50ms.U3T88_heading_rate.phys = @sysvar::MsgU3T_Obj_88_50ms::SigU3T88_heading_rate;
   Msg_U3T_Obj_88_50ms.U3T88_id.phys = @sysvar::MsgU3T_Obj_88_50ms::SigU3T88_id;
   Msg_U3T_Obj_88_50ms.U3T88_length.phys = @sysvar::MsgU3T_Obj_88_50ms::SigU3T88_length;
   Msg_U3T_Obj_88_50ms.U3T88_RLcorner_lat.phys = @sysvar::MsgU3T_Obj_88_50ms::SigU3T88_RLcorner_lat;
   Msg_U3T_Obj_88_50ms.U3T88_RLcorner_long.phys = @sysvar::MsgU3T_Obj_88_50ms::SigU3T88_RLcorner_long;
   Msg_U3T_Obj_88_50ms.U3T88_RRcorner_lat.phys = @sysvar::MsgU3T_Obj_88_50ms::SigU3T88_RRcorner_lat;
   Msg_U3T_Obj_88_50ms.U3T88_RRcorner_long.phys = @sysvar::MsgU3T_Obj_88_50ms::SigU3T88_RRcorner_long;
   Msg_U3T_Obj_88_50ms.U3T88_speed.phys = @sysvar::MsgU3T_Obj_88_50ms::SigU3T88_speed;
   Msg_U3T_Obj_88_50ms.U3T88_width.phys = @sysvar::MsgU3T_Obj_88_50ms::SigU3T88_width;
   Msg_U3T_Obj_88_50ms.U3T88_fusion_source.phys = @sysvar::MsgU3T_Obj_88_50ms::SigU3T88_fusion_source;
   Msg_U3T_Obj_88_50ms.U3T88_vcs_heading.phys = @sysvar::MsgU3T_Obj_88_50ms::SigU3T88_vcs_heading;
   Msg_U3T_Obj_88_50ms.U3T88_vcs_lat_accel.phys = @sysvar::MsgU3T_Obj_88_50ms::SigU3T88_vcs_lat_accel;
   Msg_U3T_Obj_88_50ms.U3T88_vcs_lat_posn.phys = @sysvar::MsgU3T_Obj_88_50ms::SigU3T88_vcs_lat_posn;
   Msg_U3T_Obj_88_50ms.U3T88_vcs_lat_vel.phys = @sysvar::MsgU3T_Obj_88_50ms::SigU3T88_vcs_lat_vel;
   Msg_U3T_Obj_88_50ms.U3T88_vcs_long_accel.phys = @sysvar::MsgU3T_Obj_88_50ms::SigU3T88_vcs_long_accel;
   Msg_U3T_Obj_88_50ms.U3T88_vcs_long_posn.phys = @sysvar::MsgU3T_Obj_88_50ms::SigU3T88_vcs_long_posn;
   Msg_U3T_Obj_88_50ms.U3T88_vcs_long_vel.phys = @sysvar::MsgU3T_Obj_88_50ms::SigU3T88_vcs_long_vel;
   Msg_U3T_Obj_88_50ms.U3T88_conf_overall.phys = @sysvar::MsgU3T_Obj_88_50ms::SigU3T88_conf_overall;
   Msg_U3T_Obj_88_50ms.U3T88_f_oncoming.phys = @sysvar::MsgU3T_Obj_88_50ms::SigU3T88_f_oncoming;
   Msg_U3T_Obj_88_50ms.U3T88_f_receding.phys = @sysvar::MsgU3T_Obj_88_50ms::SigU3T88_f_receding;
   output(Msg_U3T_Obj_88_50ms);
   Msg_U3T_Obj_87_50ms.U3T87_age.phys = @sysvar::MsgU3T_Obj_87_50ms::SigU3T87_age;
   Msg_U3T_Obj_87_50ms.U3T87_f_moveable.phys = @sysvar::MsgU3T_Obj_87_50ms::SigU3T87_f_moveable;
   Msg_U3T_Obj_87_50ms.U3T87_f_stationary.phys = @sysvar::MsgU3T_Obj_87_50ms::SigU3T87_f_stationary;
   Msg_U3T_Obj_87_50ms.U3T87_FLcorner_lat.phys = @sysvar::MsgU3T_Obj_87_50ms::SigU3T87_FLcorner_lat;
   Msg_U3T_Obj_87_50ms.U3T87_object_class.phys = @sysvar::MsgU3T_Obj_87_50ms::SigU3T87_object_class;
   Msg_U3T_Obj_87_50ms.U3T87_FLcorner_long.phys = @sysvar::MsgU3T_Obj_87_50ms::SigU3T87_FLcorner_long;
   Msg_U3T_Obj_87_50ms.U3T87_status.phys = @sysvar::MsgU3T_Obj_87_50ms::SigU3T87_status;
   Msg_U3T_Obj_87_50ms.U3T87_FRcorner_lat.phys = @sysvar::MsgU3T_Obj_87_50ms::SigU3T87_FRcorner_lat;
   Msg_U3T_Obj_87_50ms.U3T87_FRcorner_long.phys = @sysvar::MsgU3T_Obj_87_50ms::SigU3T87_FRcorner_long;
   Msg_U3T_Obj_87_50ms.U3T87_heading_rate.phys = @sysvar::MsgU3T_Obj_87_50ms::SigU3T87_heading_rate;
   Msg_U3T_Obj_87_50ms.U3T87_id.phys = @sysvar::MsgU3T_Obj_87_50ms::SigU3T87_id;
   Msg_U3T_Obj_87_50ms.U3T87_length.phys = @sysvar::MsgU3T_Obj_87_50ms::SigU3T87_length;
   Msg_U3T_Obj_87_50ms.U3T87_RLcorner_lat.phys = @sysvar::MsgU3T_Obj_87_50ms::SigU3T87_RLcorner_lat;
   Msg_U3T_Obj_87_50ms.U3T87_RLcorner_long.phys = @sysvar::MsgU3T_Obj_87_50ms::SigU3T87_RLcorner_long;
   Msg_U3T_Obj_87_50ms.U3T87_RRcorner_lat.phys = @sysvar::MsgU3T_Obj_87_50ms::SigU3T87_RRcorner_lat;
   Msg_U3T_Obj_87_50ms.U3T87_RRcorner_long.phys = @sysvar::MsgU3T_Obj_87_50ms::SigU3T87_RRcorner_long;
   Msg_U3T_Obj_87_50ms.U3T87_speed.phys = @sysvar::MsgU3T_Obj_87_50ms::SigU3T87_speed;
   Msg_U3T_Obj_87_50ms.U3T87_width.phys = @sysvar::MsgU3T_Obj_87_50ms::SigU3T87_width;
   Msg_U3T_Obj_87_50ms.U3T87_fusion_source.phys = @sysvar::MsgU3T_Obj_87_50ms::SigU3T87_fusion_source;
   Msg_U3T_Obj_87_50ms.U3T87_vcs_heading.phys = @sysvar::MsgU3T_Obj_87_50ms::SigU3T87_vcs_heading;
   Msg_U3T_Obj_87_50ms.U3T87_vcs_lat_accel.phys = @sysvar::MsgU3T_Obj_87_50ms::SigU3T87_vcs_lat_accel;
   Msg_U3T_Obj_87_50ms.U3T87_vcs_lat_posn.phys = @sysvar::MsgU3T_Obj_87_50ms::SigU3T87_vcs_lat_posn;
   Msg_U3T_Obj_87_50ms.U3T87_vcs_lat_vel.phys = @sysvar::MsgU3T_Obj_87_50ms::SigU3T87_vcs_lat_vel;
   Msg_U3T_Obj_87_50ms.U3T87_vcs_long_accel.phys = @sysvar::MsgU3T_Obj_87_50ms::SigU3T87_vcs_long_accel;
   Msg_U3T_Obj_87_50ms.U3T87_vcs_long_posn.phys = @sysvar::MsgU3T_Obj_87_50ms::SigU3T87_vcs_long_posn;
   Msg_U3T_Obj_87_50ms.U3T87_vcs_long_vel.phys = @sysvar::MsgU3T_Obj_87_50ms::SigU3T87_vcs_long_vel;
   Msg_U3T_Obj_87_50ms.U3T87_conf_overall.phys = @sysvar::MsgU3T_Obj_87_50ms::SigU3T87_conf_overall;
   Msg_U3T_Obj_87_50ms.U3T87_f_oncoming.phys = @sysvar::MsgU3T_Obj_87_50ms::SigU3T87_f_oncoming;
   Msg_U3T_Obj_87_50ms.U3T87_f_receding.phys = @sysvar::MsgU3T_Obj_87_50ms::SigU3T87_f_receding;
   output(Msg_U3T_Obj_87_50ms);
   Msg_U3T_Obj_86_50ms.U3T86_age.phys = @sysvar::MsgU3T_Obj_86_50ms::SigU3T86_age;
   Msg_U3T_Obj_86_50ms.U3T86_f_moveable.phys = @sysvar::MsgU3T_Obj_86_50ms::SigU3T86_f_moveable;
   Msg_U3T_Obj_86_50ms.U3T86_f_stationary.phys = @sysvar::MsgU3T_Obj_86_50ms::SigU3T86_f_stationary;
   Msg_U3T_Obj_86_50ms.U3T86_FLcorner_lat.phys = @sysvar::MsgU3T_Obj_86_50ms::SigU3T86_FLcorner_lat;
   Msg_U3T_Obj_86_50ms.U3T86_object_class.phys = @sysvar::MsgU3T_Obj_86_50ms::SigU3T86_object_class;
   Msg_U3T_Obj_86_50ms.U3T86_FLcorner_long.phys = @sysvar::MsgU3T_Obj_86_50ms::SigU3T86_FLcorner_long;
   Msg_U3T_Obj_86_50ms.U3T86_status.phys = @sysvar::MsgU3T_Obj_86_50ms::SigU3T86_status;
   Msg_U3T_Obj_86_50ms.U3T86_FRcorner_lat.phys = @sysvar::MsgU3T_Obj_86_50ms::SigU3T86_FRcorner_lat;
   Msg_U3T_Obj_86_50ms.U3T86_FRcorner_long.phys = @sysvar::MsgU3T_Obj_86_50ms::SigU3T86_FRcorner_long;
   Msg_U3T_Obj_86_50ms.U3T86_heading_rate.phys = @sysvar::MsgU3T_Obj_86_50ms::SigU3T86_heading_rate;
   Msg_U3T_Obj_86_50ms.U3T86_id.phys = @sysvar::MsgU3T_Obj_86_50ms::SigU3T86_id;
   Msg_U3T_Obj_86_50ms.U3T86_length.phys = @sysvar::MsgU3T_Obj_86_50ms::SigU3T86_length;
   Msg_U3T_Obj_86_50ms.U3T86_RLcorner_lat.phys = @sysvar::MsgU3T_Obj_86_50ms::SigU3T86_RLcorner_lat;
   Msg_U3T_Obj_86_50ms.U3T86_RLcorner_long.phys = @sysvar::MsgU3T_Obj_86_50ms::SigU3T86_RLcorner_long;
   Msg_U3T_Obj_86_50ms.U3T86_RRcorner_lat.phys = @sysvar::MsgU3T_Obj_86_50ms::SigU3T86_RRcorner_lat;
   Msg_U3T_Obj_86_50ms.U3T86_RRcorner_long.phys = @sysvar::MsgU3T_Obj_86_50ms::SigU3T86_RRcorner_long;
   Msg_U3T_Obj_86_50ms.U3T86_speed.phys = @sysvar::MsgU3T_Obj_86_50ms::SigU3T86_speed;
   Msg_U3T_Obj_86_50ms.U3T86_width.phys = @sysvar::MsgU3T_Obj_86_50ms::SigU3T86_width;
   Msg_U3T_Obj_86_50ms.U3T86_fusion_source.phys = @sysvar::MsgU3T_Obj_86_50ms::SigU3T86_fusion_source;
   Msg_U3T_Obj_86_50ms.U3T86_vcs_heading.phys = @sysvar::MsgU3T_Obj_86_50ms::SigU3T86_vcs_heading;
   Msg_U3T_Obj_86_50ms.U3T86_vcs_lat_accel.phys = @sysvar::MsgU3T_Obj_86_50ms::SigU3T86_vcs_lat_accel;
   Msg_U3T_Obj_86_50ms.U3T86_vcs_lat_posn.phys = @sysvar::MsgU3T_Obj_86_50ms::SigU3T86_vcs_lat_posn;
   Msg_U3T_Obj_86_50ms.U3T86_vcs_lat_vel.phys = @sysvar::MsgU3T_Obj_86_50ms::SigU3T86_vcs_lat_vel;
   Msg_U3T_Obj_86_50ms.U3T86_vcs_long_accel.phys = @sysvar::MsgU3T_Obj_86_50ms::SigU3T86_vcs_long_accel;
   Msg_U3T_Obj_86_50ms.U3T86_vcs_long_posn.phys = @sysvar::MsgU3T_Obj_86_50ms::SigU3T86_vcs_long_posn;
   Msg_U3T_Obj_86_50ms.U3T86_vcs_long_vel.phys = @sysvar::MsgU3T_Obj_86_50ms::SigU3T86_vcs_long_vel;
   Msg_U3T_Obj_86_50ms.U3T86_conf_overall.phys = @sysvar::MsgU3T_Obj_86_50ms::SigU3T86_conf_overall;
   Msg_U3T_Obj_86_50ms.U3T86_f_oncoming.phys = @sysvar::MsgU3T_Obj_86_50ms::SigU3T86_f_oncoming;
   Msg_U3T_Obj_86_50ms.U3T86_f_receding.phys = @sysvar::MsgU3T_Obj_86_50ms::SigU3T86_f_receding;
   output(Msg_U3T_Obj_86_50ms);
   Msg_U3T_Obj_85_50ms.U3T85_age.phys = @sysvar::MsgU3T_Obj_85_50ms::SigU3T85_age;
   Msg_U3T_Obj_85_50ms.U3T85_f_moveable.phys = @sysvar::MsgU3T_Obj_85_50ms::SigU3T85_f_moveable;
   Msg_U3T_Obj_85_50ms.U3T85_f_stationary.phys = @sysvar::MsgU3T_Obj_85_50ms::SigU3T85_f_stationary;
   Msg_U3T_Obj_85_50ms.U3T85_FLcorner_lat.phys = @sysvar::MsgU3T_Obj_85_50ms::SigU3T85_FLcorner_lat;
   Msg_U3T_Obj_85_50ms.U3T85_object_class.phys = @sysvar::MsgU3T_Obj_85_50ms::SigU3T85_object_class;
   Msg_U3T_Obj_85_50ms.U3T85_FLcorner_long.phys = @sysvar::MsgU3T_Obj_85_50ms::SigU3T85_FLcorner_long;
   Msg_U3T_Obj_85_50ms.U3T85_status.phys = @sysvar::MsgU3T_Obj_85_50ms::SigU3T85_status;
   Msg_U3T_Obj_85_50ms.U3T85_FRcorner_lat.phys = @sysvar::MsgU3T_Obj_85_50ms::SigU3T85_FRcorner_lat;
   Msg_U3T_Obj_85_50ms.U3T85_FRcorner_long.phys = @sysvar::MsgU3T_Obj_85_50ms::SigU3T85_FRcorner_long;
   Msg_U3T_Obj_85_50ms.U3T85_heading_rate.phys = @sysvar::MsgU3T_Obj_85_50ms::SigU3T85_heading_rate;
   Msg_U3T_Obj_85_50ms.U3T85_id.phys = @sysvar::MsgU3T_Obj_85_50ms::SigU3T85_id;
   Msg_U3T_Obj_85_50ms.U3T85_length.phys = @sysvar::MsgU3T_Obj_85_50ms::SigU3T85_length;
   Msg_U3T_Obj_85_50ms.U3T85_RLcorner_lat.phys = @sysvar::MsgU3T_Obj_85_50ms::SigU3T85_RLcorner_lat;
   Msg_U3T_Obj_85_50ms.U3T85_RLcorner_long.phys = @sysvar::MsgU3T_Obj_85_50ms::SigU3T85_RLcorner_long;
   Msg_U3T_Obj_85_50ms.U3T85_RRcorner_lat.phys = @sysvar::MsgU3T_Obj_85_50ms::SigU3T85_RRcorner_lat;
   Msg_U3T_Obj_85_50ms.U3T85_RRcorner_long.phys = @sysvar::MsgU3T_Obj_85_50ms::SigU3T85_RRcorner_long;
   Msg_U3T_Obj_85_50ms.U3T85_speed.phys = @sysvar::MsgU3T_Obj_85_50ms::SigU3T85_speed;
   Msg_U3T_Obj_85_50ms.U3T85_width.phys = @sysvar::MsgU3T_Obj_85_50ms::SigU3T85_width;
   Msg_U3T_Obj_85_50ms.U3T85_fusion_source.phys = @sysvar::MsgU3T_Obj_85_50ms::SigU3T85_fusion_source;
   Msg_U3T_Obj_85_50ms.U3T85_vcs_heading.phys = @sysvar::MsgU3T_Obj_85_50ms::SigU3T85_vcs_heading;
   Msg_U3T_Obj_85_50ms.U3T85_vcs_lat_accel.phys = @sysvar::MsgU3T_Obj_85_50ms::SigU3T85_vcs_lat_accel;
   Msg_U3T_Obj_85_50ms.U3T85_vcs_lat_posn.phys = @sysvar::MsgU3T_Obj_85_50ms::SigU3T85_vcs_lat_posn;
   Msg_U3T_Obj_85_50ms.U3T85_vcs_lat_vel.phys = @sysvar::MsgU3T_Obj_85_50ms::SigU3T85_vcs_lat_vel;
   Msg_U3T_Obj_85_50ms.U3T85_vcs_long_accel.phys = @sysvar::MsgU3T_Obj_85_50ms::SigU3T85_vcs_long_accel;
   Msg_U3T_Obj_85_50ms.U3T85_vcs_long_posn.phys = @sysvar::MsgU3T_Obj_85_50ms::SigU3T85_vcs_long_posn;
   Msg_U3T_Obj_85_50ms.U3T85_vcs_long_vel.phys = @sysvar::MsgU3T_Obj_85_50ms::SigU3T85_vcs_long_vel;
   Msg_U3T_Obj_85_50ms.U3T85_conf_overall.phys = @sysvar::MsgU3T_Obj_85_50ms::SigU3T85_conf_overall;
   Msg_U3T_Obj_85_50ms.U3T85_f_oncoming.phys = @sysvar::MsgU3T_Obj_85_50ms::SigU3T85_f_oncoming;
   Msg_U3T_Obj_85_50ms.U3T85_f_receding.phys = @sysvar::MsgU3T_Obj_85_50ms::SigU3T85_f_receding;
   output(Msg_U3T_Obj_85_50ms);
   Msg_U3T_Obj_84_50ms.U3T84_age.phys = @sysvar::MsgU3T_Obj_84_50ms::SigU3T84_age;
   Msg_U3T_Obj_84_50ms.U3T84_f_moveable.phys = @sysvar::MsgU3T_Obj_84_50ms::SigU3T84_f_moveable;
   Msg_U3T_Obj_84_50ms.U3T84_f_stationary.phys = @sysvar::MsgU3T_Obj_84_50ms::SigU3T84_f_stationary;
   Msg_U3T_Obj_84_50ms.U3T84_FLcorner_lat.phys = @sysvar::MsgU3T_Obj_84_50ms::SigU3T84_FLcorner_lat;
   Msg_U3T_Obj_84_50ms.U3T84_object_class.phys = @sysvar::MsgU3T_Obj_84_50ms::SigU3T84_object_class;
   Msg_U3T_Obj_84_50ms.U3T84_FLcorner_long.phys = @sysvar::MsgU3T_Obj_84_50ms::SigU3T84_FLcorner_long;
   Msg_U3T_Obj_84_50ms.U3T84_status.phys = @sysvar::MsgU3T_Obj_84_50ms::SigU3T84_status;
   Msg_U3T_Obj_84_50ms.U3T84_FRcorner_lat.phys = @sysvar::MsgU3T_Obj_84_50ms::SigU3T84_FRcorner_lat;
   Msg_U3T_Obj_84_50ms.U3T84_FRcorner_long.phys = @sysvar::MsgU3T_Obj_84_50ms::SigU3T84_FRcorner_long;
   Msg_U3T_Obj_84_50ms.U3T84_heading_rate.phys = @sysvar::MsgU3T_Obj_84_50ms::SigU3T84_heading_rate;
   Msg_U3T_Obj_84_50ms.U3T84_id.phys = @sysvar::MsgU3T_Obj_84_50ms::SigU3T84_id;
   Msg_U3T_Obj_84_50ms.U3T84_length.phys = @sysvar::MsgU3T_Obj_84_50ms::SigU3T84_length;
   Msg_U3T_Obj_84_50ms.U3T84_RLcorner_lat.phys = @sysvar::MsgU3T_Obj_84_50ms::SigU3T84_RLcorner_lat;
   Msg_U3T_Obj_84_50ms.U3T84_RLcorner_long.phys = @sysvar::MsgU3T_Obj_84_50ms::SigU3T84_RLcorner_long;
   Msg_U3T_Obj_84_50ms.U3T84_RRcorner_lat.phys = @sysvar::MsgU3T_Obj_84_50ms::SigU3T84_RRcorner_lat;
   Msg_U3T_Obj_84_50ms.U3T84_RRcorner_long.phys = @sysvar::MsgU3T_Obj_84_50ms::SigU3T84_RRcorner_long;
   Msg_U3T_Obj_84_50ms.U3T84_speed.phys = @sysvar::MsgU3T_Obj_84_50ms::SigU3T84_speed;
   Msg_U3T_Obj_84_50ms.U3T84_width.phys = @sysvar::MsgU3T_Obj_84_50ms::SigU3T84_width;
   Msg_U3T_Obj_84_50ms.U3T84_fusion_source.phys = @sysvar::MsgU3T_Obj_84_50ms::SigU3T84_fusion_source;
   Msg_U3T_Obj_84_50ms.U3T84_vcs_heading.phys = @sysvar::MsgU3T_Obj_84_50ms::SigU3T84_vcs_heading;
   Msg_U3T_Obj_84_50ms.U3T84_vcs_lat_accel.phys = @sysvar::MsgU3T_Obj_84_50ms::SigU3T84_vcs_lat_accel;
   Msg_U3T_Obj_84_50ms.U3T84_vcs_lat_posn.phys = @sysvar::MsgU3T_Obj_84_50ms::SigU3T84_vcs_lat_posn;
   Msg_U3T_Obj_84_50ms.U3T84_vcs_lat_vel.phys = @sysvar::MsgU3T_Obj_84_50ms::SigU3T84_vcs_lat_vel;
   Msg_U3T_Obj_84_50ms.U3T84_vcs_long_accel.phys = @sysvar::MsgU3T_Obj_84_50ms::SigU3T84_vcs_long_accel;
   Msg_U3T_Obj_84_50ms.U3T84_vcs_long_posn.phys = @sysvar::MsgU3T_Obj_84_50ms::SigU3T84_vcs_long_posn;
   Msg_U3T_Obj_84_50ms.U3T84_vcs_long_vel.phys = @sysvar::MsgU3T_Obj_84_50ms::SigU3T84_vcs_long_vel;
   Msg_U3T_Obj_84_50ms.U3T84_conf_overall.phys = @sysvar::MsgU3T_Obj_84_50ms::SigU3T84_conf_overall;
   Msg_U3T_Obj_84_50ms.U3T84_f_oncoming.phys = @sysvar::MsgU3T_Obj_84_50ms::SigU3T84_f_oncoming;
   Msg_U3T_Obj_84_50ms.U3T84_f_receding.phys = @sysvar::MsgU3T_Obj_84_50ms::SigU3T84_f_receding;
   output(Msg_U3T_Obj_84_50ms);
   Msg_U3T_Obj_83_50ms.U3T83_age.phys = @sysvar::MsgU3T_Obj_83_50ms::SigU3T83_age;
   Msg_U3T_Obj_83_50ms.U3T83_f_moveable.phys = @sysvar::MsgU3T_Obj_83_50ms::SigU3T83_f_moveable;
   Msg_U3T_Obj_83_50ms.U3T83_f_stationary.phys = @sysvar::MsgU3T_Obj_83_50ms::SigU3T83_f_stationary;
   Msg_U3T_Obj_83_50ms.U3T83_FLcorner_lat.phys = @sysvar::MsgU3T_Obj_83_50ms::SigU3T83_FLcorner_lat;
   Msg_U3T_Obj_83_50ms.U3T83_object_class.phys = @sysvar::MsgU3T_Obj_83_50ms::SigU3T83_object_class;
   Msg_U3T_Obj_83_50ms.U3T83_FLcorner_long.phys = @sysvar::MsgU3T_Obj_83_50ms::SigU3T83_FLcorner_long;
   Msg_U3T_Obj_83_50ms.U3T83_status.phys = @sysvar::MsgU3T_Obj_83_50ms::SigU3T83_status;
   Msg_U3T_Obj_83_50ms.U3T83_FRcorner_lat.phys = @sysvar::MsgU3T_Obj_83_50ms::SigU3T83_FRcorner_lat;
   Msg_U3T_Obj_83_50ms.U3T83_FRcorner_long.phys = @sysvar::MsgU3T_Obj_83_50ms::SigU3T83_FRcorner_long;
   Msg_U3T_Obj_83_50ms.U3T83_heading_rate.phys = @sysvar::MsgU3T_Obj_83_50ms::SigU3T83_heading_rate;
   Msg_U3T_Obj_83_50ms.U3T83_id.phys = @sysvar::MsgU3T_Obj_83_50ms::SigU3T83_id;
   Msg_U3T_Obj_83_50ms.U3T83_length.phys = @sysvar::MsgU3T_Obj_83_50ms::SigU3T83_length;
   Msg_U3T_Obj_83_50ms.U3T83_RLcorner_lat.phys = @sysvar::MsgU3T_Obj_83_50ms::SigU3T83_RLcorner_lat;
   Msg_U3T_Obj_83_50ms.U3T83_RLcorner_long.phys = @sysvar::MsgU3T_Obj_83_50ms::SigU3T83_RLcorner_long;
   Msg_U3T_Obj_83_50ms.U3T83_RRcorner_lat.phys = @sysvar::MsgU3T_Obj_83_50ms::SigU3T83_RRcorner_lat;
   Msg_U3T_Obj_83_50ms.U3T83_RRcorner_long.phys = @sysvar::MsgU3T_Obj_83_50ms::SigU3T83_RRcorner_long;
   Msg_U3T_Obj_83_50ms.U3T83_speed.phys = @sysvar::MsgU3T_Obj_83_50ms::SigU3T83_speed;
   Msg_U3T_Obj_83_50ms.U3T83_width.phys = @sysvar::MsgU3T_Obj_83_50ms::SigU3T83_width;
   Msg_U3T_Obj_83_50ms.U3T83_fusion_source.phys = @sysvar::MsgU3T_Obj_83_50ms::SigU3T83_fusion_source;
   Msg_U3T_Obj_83_50ms.U3T83_vcs_heading.phys = @sysvar::MsgU3T_Obj_83_50ms::SigU3T83_vcs_heading;
   Msg_U3T_Obj_83_50ms.U3T83_vcs_lat_accel.phys = @sysvar::MsgU3T_Obj_83_50ms::SigU3T83_vcs_lat_accel;
   Msg_U3T_Obj_83_50ms.U3T83_vcs_lat_posn.phys = @sysvar::MsgU3T_Obj_83_50ms::SigU3T83_vcs_lat_posn;
   Msg_U3T_Obj_83_50ms.U3T83_vcs_lat_vel.phys = @sysvar::MsgU3T_Obj_83_50ms::SigU3T83_vcs_lat_vel;
   Msg_U3T_Obj_83_50ms.U3T83_vcs_long_accel.phys = @sysvar::MsgU3T_Obj_83_50ms::SigU3T83_vcs_long_accel;
   Msg_U3T_Obj_83_50ms.U3T83_vcs_long_posn.phys = @sysvar::MsgU3T_Obj_83_50ms::SigU3T83_vcs_long_posn;
   Msg_U3T_Obj_83_50ms.U3T83_vcs_long_vel.phys = @sysvar::MsgU3T_Obj_83_50ms::SigU3T83_vcs_long_vel;
   Msg_U3T_Obj_83_50ms.U3T83_conf_overall.phys = @sysvar::MsgU3T_Obj_83_50ms::SigU3T83_conf_overall;
   Msg_U3T_Obj_83_50ms.U3T83_f_oncoming.phys = @sysvar::MsgU3T_Obj_83_50ms::SigU3T83_f_oncoming;
   Msg_U3T_Obj_83_50ms.U3T83_f_receding.phys = @sysvar::MsgU3T_Obj_83_50ms::SigU3T83_f_receding;
   output(Msg_U3T_Obj_83_50ms);
   Msg_U3T_Obj_82_50ms.U3T82_age.phys = @sysvar::MsgU3T_Obj_82_50ms::SigU3T82_age;
   Msg_U3T_Obj_82_50ms.U3T82_f_moveable.phys = @sysvar::MsgU3T_Obj_82_50ms::SigU3T82_f_moveable;
   Msg_U3T_Obj_82_50ms.U3T82_f_stationary.phys = @sysvar::MsgU3T_Obj_82_50ms::SigU3T82_f_stationary;
   Msg_U3T_Obj_82_50ms.U3T82_FLcorner_lat.phys = @sysvar::MsgU3T_Obj_82_50ms::SigU3T82_FLcorner_lat;
   Msg_U3T_Obj_82_50ms.U3T82_object_class.phys = @sysvar::MsgU3T_Obj_82_50ms::SigU3T82_object_class;
   Msg_U3T_Obj_82_50ms.U3T82_FLcorner_long.phys = @sysvar::MsgU3T_Obj_82_50ms::SigU3T82_FLcorner_long;
   Msg_U3T_Obj_82_50ms.U3T82_status.phys = @sysvar::MsgU3T_Obj_82_50ms::SigU3T82_status;
   Msg_U3T_Obj_82_50ms.U3T82_FRcorner_lat.phys = @sysvar::MsgU3T_Obj_82_50ms::SigU3T82_FRcorner_lat;
   Msg_U3T_Obj_82_50ms.U3T82_FRcorner_long.phys = @sysvar::MsgU3T_Obj_82_50ms::SigU3T82_FRcorner_long;
   Msg_U3T_Obj_82_50ms.U3T82_heading_rate.phys = @sysvar::MsgU3T_Obj_82_50ms::SigU3T82_heading_rate;
   Msg_U3T_Obj_82_50ms.U3T82_id.phys = @sysvar::MsgU3T_Obj_82_50ms::SigU3T82_id;
   Msg_U3T_Obj_82_50ms.U3T82_length.phys = @sysvar::MsgU3T_Obj_82_50ms::SigU3T82_length;
   Msg_U3T_Obj_82_50ms.U3T82_RLcorner_lat.phys = @sysvar::MsgU3T_Obj_82_50ms::SigU3T82_RLcorner_lat;
   Msg_U3T_Obj_82_50ms.U3T82_RLcorner_long.phys = @sysvar::MsgU3T_Obj_82_50ms::SigU3T82_RLcorner_long;
   Msg_U3T_Obj_82_50ms.U3T82_RRcorner_lat.phys = @sysvar::MsgU3T_Obj_82_50ms::SigU3T82_RRcorner_lat;
   Msg_U3T_Obj_82_50ms.U3T82_RRcorner_long.phys = @sysvar::MsgU3T_Obj_82_50ms::SigU3T82_RRcorner_long;
   Msg_U3T_Obj_82_50ms.U3T82_speed.phys = @sysvar::MsgU3T_Obj_82_50ms::SigU3T82_speed;
   Msg_U3T_Obj_82_50ms.U3T82_width.phys = @sysvar::MsgU3T_Obj_82_50ms::SigU3T82_width;
   Msg_U3T_Obj_82_50ms.U3T82_fusion_source.phys = @sysvar::MsgU3T_Obj_82_50ms::SigU3T82_fusion_source;
   Msg_U3T_Obj_82_50ms.U3T82_vcs_heading.phys = @sysvar::MsgU3T_Obj_82_50ms::SigU3T82_vcs_heading;
   Msg_U3T_Obj_82_50ms.U3T82_vcs_lat_accel.phys = @sysvar::MsgU3T_Obj_82_50ms::SigU3T82_vcs_lat_accel;
   Msg_U3T_Obj_82_50ms.U3T82_vcs_lat_posn.phys = @sysvar::MsgU3T_Obj_82_50ms::SigU3T82_vcs_lat_posn;
   Msg_U3T_Obj_82_50ms.U3T82_vcs_lat_vel.phys = @sysvar::MsgU3T_Obj_82_50ms::SigU3T82_vcs_lat_vel;
   Msg_U3T_Obj_82_50ms.U3T82_vcs_long_accel.phys = @sysvar::MsgU3T_Obj_82_50ms::SigU3T82_vcs_long_accel;
   Msg_U3T_Obj_82_50ms.U3T82_vcs_long_posn.phys = @sysvar::MsgU3T_Obj_82_50ms::SigU3T82_vcs_long_posn;
   Msg_U3T_Obj_82_50ms.U3T82_vcs_long_vel.phys = @sysvar::MsgU3T_Obj_82_50ms::SigU3T82_vcs_long_vel;
   Msg_U3T_Obj_82_50ms.U3T82_conf_overall.phys = @sysvar::MsgU3T_Obj_82_50ms::SigU3T82_conf_overall;
   Msg_U3T_Obj_82_50ms.U3T82_f_oncoming.phys = @sysvar::MsgU3T_Obj_82_50ms::SigU3T82_f_oncoming;
   Msg_U3T_Obj_82_50ms.U3T82_f_receding.phys = @sysvar::MsgU3T_Obj_82_50ms::SigU3T82_f_receding;
   output(Msg_U3T_Obj_82_50ms);
   Msg_U3T_Obj_96_50ms.U3T96_age.phys = @sysvar::MsgU3T_Obj_96_50ms::SigU3T96_age;
   Msg_U3T_Obj_96_50ms.U3T96_f_moveable.phys = @sysvar::MsgU3T_Obj_96_50ms::SigU3T96_f_moveable;
   Msg_U3T_Obj_96_50ms.U3T96_f_stationary.phys = @sysvar::MsgU3T_Obj_96_50ms::SigU3T96_f_stationary;
   Msg_U3T_Obj_96_50ms.U3T96_FLcorner_lat.phys = @sysvar::MsgU3T_Obj_96_50ms::SigU3T96_FLcorner_lat;
   Msg_U3T_Obj_96_50ms.U3T96_object_class.phys = @sysvar::MsgU3T_Obj_96_50ms::SigU3T96_object_class;
   Msg_U3T_Obj_96_50ms.U3T96_FLcorner_long.phys = @sysvar::MsgU3T_Obj_96_50ms::SigU3T96_FLcorner_long;
   Msg_U3T_Obj_96_50ms.U3T96_status.phys = @sysvar::MsgU3T_Obj_96_50ms::SigU3T96_status;
   Msg_U3T_Obj_96_50ms.U3T96_FRcorner_lat.phys = @sysvar::MsgU3T_Obj_96_50ms::SigU3T96_FRcorner_lat;
   Msg_U3T_Obj_96_50ms.U3T96_turn_indicator.phys = @sysvar::MsgU3T_Obj_96_50ms::SigU3T96_turn_indicator;
   Msg_U3T_Obj_96_50ms.U3T96_FRcorner_long.phys = @sysvar::MsgU3T_Obj_96_50ms::SigU3T96_FRcorner_long;
   Msg_U3T_Obj_96_50ms.U3T96_heading_rate.phys = @sysvar::MsgU3T_Obj_96_50ms::SigU3T96_heading_rate;
   Msg_U3T_Obj_96_50ms.U3T96_id.phys = @sysvar::MsgU3T_Obj_96_50ms::SigU3T96_id;
   Msg_U3T_Obj_96_50ms.U3T96_length.phys = @sysvar::MsgU3T_Obj_96_50ms::SigU3T96_length;
   Msg_U3T_Obj_96_50ms.U3T96_RLcorner_lat.phys = @sysvar::MsgU3T_Obj_96_50ms::SigU3T96_RLcorner_lat;
   Msg_U3T_Obj_96_50ms.U3T96_RLcorner_long.phys = @sysvar::MsgU3T_Obj_96_50ms::SigU3T96_RLcorner_long;
   Msg_U3T_Obj_96_50ms.U3T96_RRcorner_lat.phys = @sysvar::MsgU3T_Obj_96_50ms::SigU3T96_RRcorner_lat;
   Msg_U3T_Obj_96_50ms.U3T96_RRcorner_long.phys = @sysvar::MsgU3T_Obj_96_50ms::SigU3T96_RRcorner_long;
   Msg_U3T_Obj_96_50ms.U3T96_speed.phys = @sysvar::MsgU3T_Obj_96_50ms::SigU3T96_speed;
   Msg_U3T_Obj_96_50ms.U3T96_width.phys = @sysvar::MsgU3T_Obj_96_50ms::SigU3T96_width;
   Msg_U3T_Obj_96_50ms.U3T96_fusion_source.phys = @sysvar::MsgU3T_Obj_96_50ms::SigU3T96_fusion_source;
   Msg_U3T_Obj_96_50ms.U3T96_vcs_heading.phys = @sysvar::MsgU3T_Obj_96_50ms::SigU3T96_vcs_heading;
   Msg_U3T_Obj_96_50ms.U3T96_vcs_lat_accel.phys = @sysvar::MsgU3T_Obj_96_50ms::SigU3T96_vcs_lat_accel;
   Msg_U3T_Obj_96_50ms.U3T96_vcs_lat_posn.phys = @sysvar::MsgU3T_Obj_96_50ms::SigU3T96_vcs_lat_posn;
   Msg_U3T_Obj_96_50ms.U3T96_vcs_lat_vel.phys = @sysvar::MsgU3T_Obj_96_50ms::SigU3T96_vcs_lat_vel;
   Msg_U3T_Obj_96_50ms.U3T96_vcs_long_accel.phys = @sysvar::MsgU3T_Obj_96_50ms::SigU3T96_vcs_long_accel;
   Msg_U3T_Obj_96_50ms.U3T96_vcs_long_posn.phys = @sysvar::MsgU3T_Obj_96_50ms::SigU3T96_vcs_long_posn;
   Msg_U3T_Obj_96_50ms.U3T96_vcs_long_vel.phys = @sysvar::MsgU3T_Obj_96_50ms::SigU3T96_vcs_long_vel;
   Msg_U3T_Obj_96_50ms.U3T96_conf_overall.phys = @sysvar::MsgU3T_Obj_96_50ms::SigU3T96_conf_overall;
   Msg_U3T_Obj_96_50ms.U3T96_f_oncoming.phys = @sysvar::MsgU3T_Obj_96_50ms::SigU3T96_f_oncoming;
   Msg_U3T_Obj_96_50ms.U3T96_f_receding.phys = @sysvar::MsgU3T_Obj_96_50ms::SigU3T96_f_receding;
   output(Msg_U3T_Obj_96_50ms);
   Msg_U3T_Obj_95_50ms.U3T95_age.phys = @sysvar::MsgU3T_Obj_95_50ms::SigU3T95_age;
   Msg_U3T_Obj_95_50ms.U3T95_f_moveable.phys = @sysvar::MsgU3T_Obj_95_50ms::SigU3T95_f_moveable;
   Msg_U3T_Obj_95_50ms.U3T95_f_stationary.phys = @sysvar::MsgU3T_Obj_95_50ms::SigU3T95_f_stationary;
   Msg_U3T_Obj_95_50ms.U3T95_FLcorner_lat.phys = @sysvar::MsgU3T_Obj_95_50ms::SigU3T95_FLcorner_lat;
   Msg_U3T_Obj_95_50ms.U3T95_object_class.phys = @sysvar::MsgU3T_Obj_95_50ms::SigU3T95_object_class;
   Msg_U3T_Obj_95_50ms.U3T95_FLcorner_long.phys = @sysvar::MsgU3T_Obj_95_50ms::SigU3T95_FLcorner_long;
   Msg_U3T_Obj_95_50ms.U3T95_status.phys = @sysvar::MsgU3T_Obj_95_50ms::SigU3T95_status;
   Msg_U3T_Obj_95_50ms.U3T95_FRcorner_lat.phys = @sysvar::MsgU3T_Obj_95_50ms::SigU3T95_FRcorner_lat;
   Msg_U3T_Obj_95_50ms.U3T95_FRcorner_long.phys = @sysvar::MsgU3T_Obj_95_50ms::SigU3T95_FRcorner_long;
   Msg_U3T_Obj_95_50ms.U3T95_heading_rate.phys = @sysvar::MsgU3T_Obj_95_50ms::SigU3T95_heading_rate;
   Msg_U3T_Obj_95_50ms.U3T95_id.phys = @sysvar::MsgU3T_Obj_95_50ms::SigU3T95_id;
   Msg_U3T_Obj_95_50ms.U3T95_length.phys = @sysvar::MsgU3T_Obj_95_50ms::SigU3T95_length;
   Msg_U3T_Obj_95_50ms.U3T95_RLcorner_lat.phys = @sysvar::MsgU3T_Obj_95_50ms::SigU3T95_RLcorner_lat;
   Msg_U3T_Obj_95_50ms.U3T95_RLcorner_long.phys = @sysvar::MsgU3T_Obj_95_50ms::SigU3T95_RLcorner_long;
   Msg_U3T_Obj_95_50ms.U3T95_RRcorner_lat.phys = @sysvar::MsgU3T_Obj_95_50ms::SigU3T95_RRcorner_lat;
   Msg_U3T_Obj_95_50ms.U3T95_RRcorner_long.phys = @sysvar::MsgU3T_Obj_95_50ms::SigU3T95_RRcorner_long;
   Msg_U3T_Obj_95_50ms.U3T95_speed.phys = @sysvar::MsgU3T_Obj_95_50ms::SigU3T95_speed;
   Msg_U3T_Obj_95_50ms.U3T95_width.phys = @sysvar::MsgU3T_Obj_95_50ms::SigU3T95_width;
   Msg_U3T_Obj_95_50ms.U3T95_fusion_source.phys = @sysvar::MsgU3T_Obj_95_50ms::SigU3T95_fusion_source;
   Msg_U3T_Obj_95_50ms.U3T95_vcs_heading.phys = @sysvar::MsgU3T_Obj_95_50ms::SigU3T95_vcs_heading;
   Msg_U3T_Obj_95_50ms.U3T95_vcs_lat_accel.phys = @sysvar::MsgU3T_Obj_95_50ms::SigU3T95_vcs_lat_accel;
   Msg_U3T_Obj_95_50ms.U3T95_vcs_lat_posn.phys = @sysvar::MsgU3T_Obj_95_50ms::SigU3T95_vcs_lat_posn;
   Msg_U3T_Obj_95_50ms.U3T95_vcs_lat_vel.phys = @sysvar::MsgU3T_Obj_95_50ms::SigU3T95_vcs_lat_vel;
   Msg_U3T_Obj_95_50ms.U3T95_vcs_long_accel.phys = @sysvar::MsgU3T_Obj_95_50ms::SigU3T95_vcs_long_accel;
   Msg_U3T_Obj_95_50ms.U3T95_vcs_long_posn.phys = @sysvar::MsgU3T_Obj_95_50ms::SigU3T95_vcs_long_posn;
   Msg_U3T_Obj_95_50ms.U3T95_vcs_long_vel.phys = @sysvar::MsgU3T_Obj_95_50ms::SigU3T95_vcs_long_vel;
   Msg_U3T_Obj_95_50ms.U3T95_conf_overall.phys = @sysvar::MsgU3T_Obj_95_50ms::SigU3T95_conf_overall;
   Msg_U3T_Obj_95_50ms.U3T95_f_oncoming.phys = @sysvar::MsgU3T_Obj_95_50ms::SigU3T95_f_oncoming;
   Msg_U3T_Obj_95_50ms.U3T95_f_receding.phys = @sysvar::MsgU3T_Obj_95_50ms::SigU3T95_f_receding;
   output(Msg_U3T_Obj_95_50ms);
   Msg_U3T_Obj_94_50ms.U3T94_age.phys = @sysvar::MsgU3T_Obj_94_50ms::SigU3T94_age;
   Msg_U3T_Obj_94_50ms.U3T94_f_moveable.phys = @sysvar::MsgU3T_Obj_94_50ms::SigU3T94_f_moveable;
   Msg_U3T_Obj_94_50ms.U3T94_f_stationary.phys = @sysvar::MsgU3T_Obj_94_50ms::SigU3T94_f_stationary;
   Msg_U3T_Obj_94_50ms.U3T94_FLcorner_lat.phys = @sysvar::MsgU3T_Obj_94_50ms::SigU3T94_FLcorner_lat;
   Msg_U3T_Obj_94_50ms.U3T94_object_class.phys = @sysvar::MsgU3T_Obj_94_50ms::SigU3T94_object_class;
   Msg_U3T_Obj_94_50ms.U3T94_FLcorner_long.phys = @sysvar::MsgU3T_Obj_94_50ms::SigU3T94_FLcorner_long;
   Msg_U3T_Obj_94_50ms.U3T94_status.phys = @sysvar::MsgU3T_Obj_94_50ms::SigU3T94_status;
   Msg_U3T_Obj_94_50ms.U3T94_FRcorner_lat.phys = @sysvar::MsgU3T_Obj_94_50ms::SigU3T94_FRcorner_lat;
   Msg_U3T_Obj_94_50ms.U3T94_FRcorner_long.phys = @sysvar::MsgU3T_Obj_94_50ms::SigU3T94_FRcorner_long;
   Msg_U3T_Obj_94_50ms.U3T94_heading_rate.phys = @sysvar::MsgU3T_Obj_94_50ms::SigU3T94_heading_rate;
   Msg_U3T_Obj_94_50ms.U3T94_id.phys = @sysvar::MsgU3T_Obj_94_50ms::SigU3T94_id;
   Msg_U3T_Obj_94_50ms.U3T94_length.phys = @sysvar::MsgU3T_Obj_94_50ms::SigU3T94_length;
   Msg_U3T_Obj_94_50ms.U3T94_RLcorner_lat.phys = @sysvar::MsgU3T_Obj_94_50ms::SigU3T94_RLcorner_lat;
   Msg_U3T_Obj_94_50ms.U3T94_RLcorner_long.phys = @sysvar::MsgU3T_Obj_94_50ms::SigU3T94_RLcorner_long;
   Msg_U3T_Obj_94_50ms.U3T94_RRcorner_lat.phys = @sysvar::MsgU3T_Obj_94_50ms::SigU3T94_RRcorner_lat;
   Msg_U3T_Obj_94_50ms.U3T94_RRcorner_long.phys = @sysvar::MsgU3T_Obj_94_50ms::SigU3T94_RRcorner_long;
   Msg_U3T_Obj_94_50ms.U3T94_speed.phys = @sysvar::MsgU3T_Obj_94_50ms::SigU3T94_speed;
   Msg_U3T_Obj_94_50ms.U3T94_width.phys = @sysvar::MsgU3T_Obj_94_50ms::SigU3T94_width;
   Msg_U3T_Obj_94_50ms.U3T94_fusion_source.phys = @sysvar::MsgU3T_Obj_94_50ms::SigU3T94_fusion_source;
   Msg_U3T_Obj_94_50ms.U3T94_vcs_heading.phys = @sysvar::MsgU3T_Obj_94_50ms::SigU3T94_vcs_heading;
   Msg_U3T_Obj_94_50ms.U3T94_vcs_lat_accel.phys = @sysvar::MsgU3T_Obj_94_50ms::SigU3T94_vcs_lat_accel;
   Msg_U3T_Obj_94_50ms.U3T94_vcs_lat_posn.phys = @sysvar::MsgU3T_Obj_94_50ms::SigU3T94_vcs_lat_posn;
   Msg_U3T_Obj_94_50ms.U3T94_vcs_lat_vel.phys = @sysvar::MsgU3T_Obj_94_50ms::SigU3T94_vcs_lat_vel;
   Msg_U3T_Obj_94_50ms.U3T94_vcs_long_accel.phys = @sysvar::MsgU3T_Obj_94_50ms::SigU3T94_vcs_long_accel;
   Msg_U3T_Obj_94_50ms.U3T94_vcs_long_posn.phys = @sysvar::MsgU3T_Obj_94_50ms::SigU3T94_vcs_long_posn;
   Msg_U3T_Obj_94_50ms.U3T94_vcs_long_vel.phys = @sysvar::MsgU3T_Obj_94_50ms::SigU3T94_vcs_long_vel;
   Msg_U3T_Obj_94_50ms.U3T94_conf_overall.phys = @sysvar::MsgU3T_Obj_94_50ms::SigU3T94_conf_overall;
   Msg_U3T_Obj_94_50ms.U3T94_f_oncoming.phys = @sysvar::MsgU3T_Obj_94_50ms::SigU3T94_f_oncoming;
   Msg_U3T_Obj_94_50ms.U3T94_f_receding.phys = @sysvar::MsgU3T_Obj_94_50ms::SigU3T94_f_receding;
   output(Msg_U3T_Obj_94_50ms);
   Msg_U3T_Obj_93_50ms.U3T93_age.phys = @sysvar::MsgU3T_Obj_93_50ms::SigU3T93_age;
   Msg_U3T_Obj_93_50ms.U3T93_f_moveable.phys = @sysvar::MsgU3T_Obj_93_50ms::SigU3T93_f_moveable;
   Msg_U3T_Obj_93_50ms.U3T93_f_stationary.phys = @sysvar::MsgU3T_Obj_93_50ms::SigU3T93_f_stationary;
   Msg_U3T_Obj_93_50ms.U3T93_FLcorner_lat.phys = @sysvar::MsgU3T_Obj_93_50ms::SigU3T93_FLcorner_lat;
   Msg_U3T_Obj_93_50ms.U3T93_object_class.phys = @sysvar::MsgU3T_Obj_93_50ms::SigU3T93_object_class;
   Msg_U3T_Obj_93_50ms.U3T93_FLcorner_long.phys = @sysvar::MsgU3T_Obj_93_50ms::SigU3T93_FLcorner_long;
   Msg_U3T_Obj_93_50ms.U3T93_status.phys = @sysvar::MsgU3T_Obj_93_50ms::SigU3T93_status;
   Msg_U3T_Obj_93_50ms.U3T93_FRcorner_lat.phys = @sysvar::MsgU3T_Obj_93_50ms::SigU3T93_FRcorner_lat;
   Msg_U3T_Obj_93_50ms.U3T93_FRcorner_long.phys = @sysvar::MsgU3T_Obj_93_50ms::SigU3T93_FRcorner_long;
   Msg_U3T_Obj_93_50ms.U3T93_heading_rate.phys = @sysvar::MsgU3T_Obj_93_50ms::SigU3T93_heading_rate;
   Msg_U3T_Obj_93_50ms.U3T93_id.phys = @sysvar::MsgU3T_Obj_93_50ms::SigU3T93_id;
   Msg_U3T_Obj_93_50ms.U3T93_length.phys = @sysvar::MsgU3T_Obj_93_50ms::SigU3T93_length;
   Msg_U3T_Obj_93_50ms.U3T93_RLcorner_lat.phys = @sysvar::MsgU3T_Obj_93_50ms::SigU3T93_RLcorner_lat;
   Msg_U3T_Obj_93_50ms.U3T93_RLcorner_long.phys = @sysvar::MsgU3T_Obj_93_50ms::SigU3T93_RLcorner_long;
   Msg_U3T_Obj_93_50ms.U3T93_RRcorner_lat.phys = @sysvar::MsgU3T_Obj_93_50ms::SigU3T93_RRcorner_lat;
   Msg_U3T_Obj_93_50ms.U3T93_RRcorner_long.phys = @sysvar::MsgU3T_Obj_93_50ms::SigU3T93_RRcorner_long;
   Msg_U3T_Obj_93_50ms.U3T93_speed.phys = @sysvar::MsgU3T_Obj_93_50ms::SigU3T93_speed;
   Msg_U3T_Obj_93_50ms.U3T93_width.phys = @sysvar::MsgU3T_Obj_93_50ms::SigU3T93_width;
   Msg_U3T_Obj_93_50ms.U3T93_fusion_source.phys = @sysvar::MsgU3T_Obj_93_50ms::SigU3T93_fusion_source;
   Msg_U3T_Obj_93_50ms.U3T93_vcs_heading.phys = @sysvar::MsgU3T_Obj_93_50ms::SigU3T93_vcs_heading;
   Msg_U3T_Obj_93_50ms.U3T93_vcs_lat_accel.phys = @sysvar::MsgU3T_Obj_93_50ms::SigU3T93_vcs_lat_accel;
   Msg_U3T_Obj_93_50ms.U3T93_vcs_lat_posn.phys = @sysvar::MsgU3T_Obj_93_50ms::SigU3T93_vcs_lat_posn;
   Msg_U3T_Obj_93_50ms.U3T93_vcs_lat_vel.phys = @sysvar::MsgU3T_Obj_93_50ms::SigU3T93_vcs_lat_vel;
   Msg_U3T_Obj_93_50ms.U3T93_vcs_long_accel.phys = @sysvar::MsgU3T_Obj_93_50ms::SigU3T93_vcs_long_accel;
   Msg_U3T_Obj_93_50ms.U3T93_vcs_long_posn.phys = @sysvar::MsgU3T_Obj_93_50ms::SigU3T93_vcs_long_posn;
   Msg_U3T_Obj_93_50ms.U3T93_vcs_long_vel.phys = @sysvar::MsgU3T_Obj_93_50ms::SigU3T93_vcs_long_vel;
   Msg_U3T_Obj_93_50ms.U3T93_conf_overall.phys = @sysvar::MsgU3T_Obj_93_50ms::SigU3T93_conf_overall;
   Msg_U3T_Obj_93_50ms.U3T93_f_oncoming.phys = @sysvar::MsgU3T_Obj_93_50ms::SigU3T93_f_oncoming;
   Msg_U3T_Obj_93_50ms.U3T93_f_receding.phys = @sysvar::MsgU3T_Obj_93_50ms::SigU3T93_f_receding;
   output(Msg_U3T_Obj_93_50ms);
   Msg_U3T_Obj_92_50ms.U3T92_age.phys = @sysvar::MsgU3T_Obj_92_50ms::SigU3T92_age;
   Msg_U3T_Obj_92_50ms.U3T92_f_moveable.phys = @sysvar::MsgU3T_Obj_92_50ms::SigU3T92_f_moveable;
   Msg_U3T_Obj_92_50ms.U3T92_f_stationary.phys = @sysvar::MsgU3T_Obj_92_50ms::SigU3T92_f_stationary;
   Msg_U3T_Obj_92_50ms.U3T92_FLcorner_lat.phys = @sysvar::MsgU3T_Obj_92_50ms::SigU3T92_FLcorner_lat;
   Msg_U3T_Obj_92_50ms.U3T92_object_class.phys = @sysvar::MsgU3T_Obj_92_50ms::SigU3T92_object_class;
   Msg_U3T_Obj_92_50ms.U3T92_FLcorner_long.phys = @sysvar::MsgU3T_Obj_92_50ms::SigU3T92_FLcorner_long;
   Msg_U3T_Obj_92_50ms.U3T92_status.phys = @sysvar::MsgU3T_Obj_92_50ms::SigU3T92_status;
   Msg_U3T_Obj_92_50ms.U3T92_FRcorner_lat.phys = @sysvar::MsgU3T_Obj_92_50ms::SigU3T92_FRcorner_lat;
   Msg_U3T_Obj_92_50ms.U3T92_FRcorner_long.phys = @sysvar::MsgU3T_Obj_92_50ms::SigU3T92_FRcorner_long;
   Msg_U3T_Obj_92_50ms.U3T92_heading_rate.phys = @sysvar::MsgU3T_Obj_92_50ms::SigU3T92_heading_rate;
   Msg_U3T_Obj_92_50ms.U3T92_id.phys = @sysvar::MsgU3T_Obj_92_50ms::SigU3T92_id;
   Msg_U3T_Obj_92_50ms.U3T92_length.phys = @sysvar::MsgU3T_Obj_92_50ms::SigU3T92_length;
   Msg_U3T_Obj_92_50ms.U3T92_RLcorner_lat.phys = @sysvar::MsgU3T_Obj_92_50ms::SigU3T92_RLcorner_lat;
   Msg_U3T_Obj_92_50ms.U3T92_RLcorner_long.phys = @sysvar::MsgU3T_Obj_92_50ms::SigU3T92_RLcorner_long;
   Msg_U3T_Obj_92_50ms.U3T92_RRcorner_lat.phys = @sysvar::MsgU3T_Obj_92_50ms::SigU3T92_RRcorner_lat;
   Msg_U3T_Obj_92_50ms.U3T92_RRcorner_long.phys = @sysvar::MsgU3T_Obj_92_50ms::SigU3T92_RRcorner_long;
   Msg_U3T_Obj_92_50ms.U3T92_speed.phys = @sysvar::MsgU3T_Obj_92_50ms::SigU3T92_speed;
   Msg_U3T_Obj_92_50ms.U3T92_width.phys = @sysvar::MsgU3T_Obj_92_50ms::SigU3T92_width;
   Msg_U3T_Obj_92_50ms.U3T92_fusion_source.phys = @sysvar::MsgU3T_Obj_92_50ms::SigU3T92_fusion_source;
   Msg_U3T_Obj_92_50ms.U3T92_vcs_heading.phys = @sysvar::MsgU3T_Obj_92_50ms::SigU3T92_vcs_heading;
   Msg_U3T_Obj_92_50ms.U3T92_vcs_lat_accel.phys = @sysvar::MsgU3T_Obj_92_50ms::SigU3T92_vcs_lat_accel;
   Msg_U3T_Obj_92_50ms.U3T92_vcs_lat_posn.phys = @sysvar::MsgU3T_Obj_92_50ms::SigU3T92_vcs_lat_posn;
   Msg_U3T_Obj_92_50ms.U3T92_vcs_lat_vel.phys = @sysvar::MsgU3T_Obj_92_50ms::SigU3T92_vcs_lat_vel;
   Msg_U3T_Obj_92_50ms.U3T92_vcs_long_accel.phys = @sysvar::MsgU3T_Obj_92_50ms::SigU3T92_vcs_long_accel;
   Msg_U3T_Obj_92_50ms.U3T92_vcs_long_posn.phys = @sysvar::MsgU3T_Obj_92_50ms::SigU3T92_vcs_long_posn;
   Msg_U3T_Obj_92_50ms.U3T92_vcs_long_vel.phys = @sysvar::MsgU3T_Obj_92_50ms::SigU3T92_vcs_long_vel;
   Msg_U3T_Obj_92_50ms.U3T92_conf_overall.phys = @sysvar::MsgU3T_Obj_92_50ms::SigU3T92_conf_overall;
   Msg_U3T_Obj_92_50ms.U3T92_f_oncoming.phys = @sysvar::MsgU3T_Obj_92_50ms::SigU3T92_f_oncoming;
   Msg_U3T_Obj_92_50ms.U3T92_f_receding.phys = @sysvar::MsgU3T_Obj_92_50ms::SigU3T92_f_receding;
   output(Msg_U3T_Obj_92_50ms);
   Msg_U3T_Obj_91_50ms.U3T91_age.phys = @sysvar::MsgU3T_Obj_91_50ms::SigU3T91_age;
   Msg_U3T_Obj_91_50ms.U3T91_f_moveable.phys = @sysvar::MsgU3T_Obj_91_50ms::SigU3T91_f_moveable;
   Msg_U3T_Obj_91_50ms.U3T91_f_stationary.phys = @sysvar::MsgU3T_Obj_91_50ms::SigU3T91_f_stationary;
   Msg_U3T_Obj_91_50ms.U3T91_FLcorner_lat.phys = @sysvar::MsgU3T_Obj_91_50ms::SigU3T91_FLcorner_lat;
   Msg_U3T_Obj_91_50ms.U3T91_object_class.phys = @sysvar::MsgU3T_Obj_91_50ms::SigU3T91_object_class;
   Msg_U3T_Obj_91_50ms.U3T91_FLcorner_long.phys = @sysvar::MsgU3T_Obj_91_50ms::SigU3T91_FLcorner_long;
   Msg_U3T_Obj_91_50ms.U3T91_status.phys = @sysvar::MsgU3T_Obj_91_50ms::SigU3T91_status;
   Msg_U3T_Obj_91_50ms.U3T91_FRcorner_lat.phys = @sysvar::MsgU3T_Obj_91_50ms::SigU3T91_FRcorner_lat;
   Msg_U3T_Obj_91_50ms.U3T91_FRcorner_long.phys = @sysvar::MsgU3T_Obj_91_50ms::SigU3T91_FRcorner_long;
   Msg_U3T_Obj_91_50ms.U3T91_heading_rate.phys = @sysvar::MsgU3T_Obj_91_50ms::SigU3T91_heading_rate;
   Msg_U3T_Obj_91_50ms.U3T91_id.phys = @sysvar::MsgU3T_Obj_91_50ms::SigU3T91_id;
   Msg_U3T_Obj_91_50ms.U3T91_length.phys = @sysvar::MsgU3T_Obj_91_50ms::SigU3T91_length;
   Msg_U3T_Obj_91_50ms.U3T91_RLcorner_lat.phys = @sysvar::MsgU3T_Obj_91_50ms::SigU3T91_RLcorner_lat;
   Msg_U3T_Obj_91_50ms.U3T91_RLcorner_long.phys = @sysvar::MsgU3T_Obj_91_50ms::SigU3T91_RLcorner_long;
   Msg_U3T_Obj_91_50ms.U3T91_RRcorner_lat.phys = @sysvar::MsgU3T_Obj_91_50ms::SigU3T91_RRcorner_lat;
   Msg_U3T_Obj_91_50ms.U3T91_RRcorner_long.phys = @sysvar::MsgU3T_Obj_91_50ms::SigU3T91_RRcorner_long;
   Msg_U3T_Obj_91_50ms.U3T91_speed.phys = @sysvar::MsgU3T_Obj_91_50ms::SigU3T91_speed;
   Msg_U3T_Obj_91_50ms.U3T91_width.phys = @sysvar::MsgU3T_Obj_91_50ms::SigU3T91_width;
   Msg_U3T_Obj_91_50ms.U3T91_fusion_source.phys = @sysvar::MsgU3T_Obj_91_50ms::SigU3T91_fusion_source;
   Msg_U3T_Obj_91_50ms.U3T91_vcs_heading.phys = @sysvar::MsgU3T_Obj_91_50ms::SigU3T91_vcs_heading;
   Msg_U3T_Obj_91_50ms.U3T91_vcs_lat_accel.phys = @sysvar::MsgU3T_Obj_91_50ms::SigU3T91_vcs_lat_accel;
   Msg_U3T_Obj_91_50ms.U3T91_vcs_lat_posn.phys = @sysvar::MsgU3T_Obj_91_50ms::SigU3T91_vcs_lat_posn;
   Msg_U3T_Obj_91_50ms.U3T91_vcs_lat_vel.phys = @sysvar::MsgU3T_Obj_91_50ms::SigU3T91_vcs_lat_vel;
   Msg_U3T_Obj_91_50ms.U3T91_vcs_long_accel.phys = @sysvar::MsgU3T_Obj_91_50ms::SigU3T91_vcs_long_accel;
   Msg_U3T_Obj_91_50ms.U3T91_vcs_long_posn.phys = @sysvar::MsgU3T_Obj_91_50ms::SigU3T91_vcs_long_posn;
   Msg_U3T_Obj_91_50ms.U3T91_vcs_long_vel.phys = @sysvar::MsgU3T_Obj_91_50ms::SigU3T91_vcs_long_vel;
   Msg_U3T_Obj_91_50ms.U3T91_conf_overall.phys = @sysvar::MsgU3T_Obj_91_50ms::SigU3T91_conf_overall;
   Msg_U3T_Obj_91_50ms.U3T91_f_oncoming.phys = @sysvar::MsgU3T_Obj_91_50ms::SigU3T91_f_oncoming;
   Msg_U3T_Obj_91_50ms.U3T91_f_receding.phys = @sysvar::MsgU3T_Obj_91_50ms::SigU3T91_f_receding;
   output(Msg_U3T_Obj_91_50ms);
   Msg_U3T_Obj_90_50ms.U3T90_age.phys = @sysvar::MsgU3T_Obj_90_50ms::SigU3T90_age;
   Msg_U3T_Obj_90_50ms.U3T90_f_moveable.phys = @sysvar::MsgU3T_Obj_90_50ms::SigU3T90_f_moveable;
   Msg_U3T_Obj_90_50ms.U3T90_f_stationary.phys = @sysvar::MsgU3T_Obj_90_50ms::SigU3T90_f_stationary;
   Msg_U3T_Obj_90_50ms.U3T90_FLcorner_lat.phys = @sysvar::MsgU3T_Obj_90_50ms::SigU3T90_FLcorner_lat;
   Msg_U3T_Obj_90_50ms.U3T90_object_class.phys = @sysvar::MsgU3T_Obj_90_50ms::SigU3T90_object_class;
   Msg_U3T_Obj_90_50ms.U3T90_FLcorner_long.phys = @sysvar::MsgU3T_Obj_90_50ms::SigU3T90_FLcorner_long;
   Msg_U3T_Obj_90_50ms.U3T90_status.phys = @sysvar::MsgU3T_Obj_90_50ms::SigU3T90_status;
   Msg_U3T_Obj_90_50ms.U3T90_FRcorner_lat.phys = @sysvar::MsgU3T_Obj_90_50ms::SigU3T90_FRcorner_lat;
   Msg_U3T_Obj_90_50ms.U3T90_FRcorner_long.phys = @sysvar::MsgU3T_Obj_90_50ms::SigU3T90_FRcorner_long;
   Msg_U3T_Obj_90_50ms.U3T90_heading_rate.phys = @sysvar::MsgU3T_Obj_90_50ms::SigU3T90_heading_rate;
   Msg_U3T_Obj_90_50ms.U3T90_id.phys = @sysvar::MsgU3T_Obj_90_50ms::SigU3T90_id;
   Msg_U3T_Obj_90_50ms.U3T90_length.phys = @sysvar::MsgU3T_Obj_90_50ms::SigU3T90_length;
   Msg_U3T_Obj_90_50ms.U3T90_RLcorner_lat.phys = @sysvar::MsgU3T_Obj_90_50ms::SigU3T90_RLcorner_lat;
   Msg_U3T_Obj_90_50ms.U3T90_RLcorner_long.phys = @sysvar::MsgU3T_Obj_90_50ms::SigU3T90_RLcorner_long;
   Msg_U3T_Obj_90_50ms.U3T90_RRcorner_lat.phys = @sysvar::MsgU3T_Obj_90_50ms::SigU3T90_RRcorner_lat;
   Msg_U3T_Obj_90_50ms.U3T90_RRcorner_long.phys = @sysvar::MsgU3T_Obj_90_50ms::SigU3T90_RRcorner_long;
   Msg_U3T_Obj_90_50ms.U3T90_speed.phys = @sysvar::MsgU3T_Obj_90_50ms::SigU3T90_speed;
   Msg_U3T_Obj_90_50ms.U3T90_width.phys = @sysvar::MsgU3T_Obj_90_50ms::SigU3T90_width;
   Msg_U3T_Obj_90_50ms.U3T90_fusion_source.phys = @sysvar::MsgU3T_Obj_90_50ms::SigU3T90_fusion_source;
   Msg_U3T_Obj_90_50ms.U3T90_vcs_heading.phys = @sysvar::MsgU3T_Obj_90_50ms::SigU3T90_vcs_heading;
   Msg_U3T_Obj_90_50ms.U3T90_vcs_lat_accel.phys = @sysvar::MsgU3T_Obj_90_50ms::SigU3T90_vcs_lat_accel;
   Msg_U3T_Obj_90_50ms.U3T90_vcs_lat_posn.phys = @sysvar::MsgU3T_Obj_90_50ms::SigU3T90_vcs_lat_posn;
   Msg_U3T_Obj_90_50ms.U3T90_vcs_lat_vel.phys = @sysvar::MsgU3T_Obj_90_50ms::SigU3T90_vcs_lat_vel;
   Msg_U3T_Obj_90_50ms.U3T90_vcs_long_accel.phys = @sysvar::MsgU3T_Obj_90_50ms::SigU3T90_vcs_long_accel;
   Msg_U3T_Obj_90_50ms.U3T90_vcs_long_posn.phys = @sysvar::MsgU3T_Obj_90_50ms::SigU3T90_vcs_long_posn;
   Msg_U3T_Obj_90_50ms.U3T90_vcs_long_vel.phys = @sysvar::MsgU3T_Obj_90_50ms::SigU3T90_vcs_long_vel;
   Msg_U3T_Obj_90_50ms.U3T90_conf_overall.phys = @sysvar::MsgU3T_Obj_90_50ms::SigU3T90_conf_overall;
   Msg_U3T_Obj_90_50ms.U3T90_f_oncoming.phys = @sysvar::MsgU3T_Obj_90_50ms::SigU3T90_f_oncoming;
   Msg_U3T_Obj_90_50ms.U3T90_f_receding.phys = @sysvar::MsgU3T_Obj_90_50ms::SigU3T90_f_receding;
   output(Msg_U3T_Obj_90_50ms);
   Msg_U3T_Obj_89_50ms.U3T89_age.phys = @sysvar::MsgU3T_Obj_89_50ms::SigU3T89_age;
   Msg_U3T_Obj_89_50ms.U3T89_f_moveable.phys = @sysvar::MsgU3T_Obj_89_50ms::SigU3T89_f_moveable;
   Msg_U3T_Obj_89_50ms.U3T89_f_stationary.phys = @sysvar::MsgU3T_Obj_89_50ms::SigU3T89_f_stationary;
   Msg_U3T_Obj_89_50ms.U3T89_FLcorner_lat.phys = @sysvar::MsgU3T_Obj_89_50ms::SigU3T89_FLcorner_lat;
   Msg_U3T_Obj_89_50ms.U3T89_object_class.phys = @sysvar::MsgU3T_Obj_89_50ms::SigU3T89_object_class;
   Msg_U3T_Obj_89_50ms.U3T89_FLcorner_long.phys = @sysvar::MsgU3T_Obj_89_50ms::SigU3T89_FLcorner_long;
   Msg_U3T_Obj_89_50ms.U3T89_status.phys = @sysvar::MsgU3T_Obj_89_50ms::SigU3T89_status;
   Msg_U3T_Obj_89_50ms.U3T89_FRcorner_lat.phys = @sysvar::MsgU3T_Obj_89_50ms::SigU3T89_FRcorner_lat;
   Msg_U3T_Obj_89_50ms.U3T89_FRcorner_long.phys = @sysvar::MsgU3T_Obj_89_50ms::SigU3T89_FRcorner_long;
   Msg_U3T_Obj_89_50ms.U3T89_heading_rate.phys = @sysvar::MsgU3T_Obj_89_50ms::SigU3T89_heading_rate;
   Msg_U3T_Obj_89_50ms.U3T89_id.phys = @sysvar::MsgU3T_Obj_89_50ms::SigU3T89_id;
   Msg_U3T_Obj_89_50ms.U3T89_length.phys = @sysvar::MsgU3T_Obj_89_50ms::SigU3T89_length;
   Msg_U3T_Obj_89_50ms.U3T89_RLcorner_lat.phys = @sysvar::MsgU3T_Obj_89_50ms::SigU3T89_RLcorner_lat;
   Msg_U3T_Obj_89_50ms.U3T89_RLcorner_long.phys = @sysvar::MsgU3T_Obj_89_50ms::SigU3T89_RLcorner_long;
   Msg_U3T_Obj_89_50ms.U3T89_RRcorner_lat.phys = @sysvar::MsgU3T_Obj_89_50ms::SigU3T89_RRcorner_lat;
   Msg_U3T_Obj_89_50ms.U3T89_RRcorner_long.phys = @sysvar::MsgU3T_Obj_89_50ms::SigU3T89_RRcorner_long;
   Msg_U3T_Obj_89_50ms.U3T89_speed.phys = @sysvar::MsgU3T_Obj_89_50ms::SigU3T89_speed;
   Msg_U3T_Obj_89_50ms.U3T89_width.phys = @sysvar::MsgU3T_Obj_89_50ms::SigU3T89_width;
   Msg_U3T_Obj_89_50ms.U3T89_fusion_source.phys = @sysvar::MsgU3T_Obj_89_50ms::SigU3T89_fusion_source;
   Msg_U3T_Obj_89_50ms.U3T89_vcs_heading.phys = @sysvar::MsgU3T_Obj_89_50ms::SigU3T89_vcs_heading;
   Msg_U3T_Obj_89_50ms.U3T89_vcs_lat_accel.phys = @sysvar::MsgU3T_Obj_89_50ms::SigU3T89_vcs_lat_accel;
   Msg_U3T_Obj_89_50ms.U3T89_vcs_lat_posn.phys = @sysvar::MsgU3T_Obj_89_50ms::SigU3T89_vcs_lat_posn;
   Msg_U3T_Obj_89_50ms.U3T89_vcs_lat_vel.phys = @sysvar::MsgU3T_Obj_89_50ms::SigU3T89_vcs_lat_vel;
   Msg_U3T_Obj_89_50ms.U3T89_vcs_long_accel.phys = @sysvar::MsgU3T_Obj_89_50ms::SigU3T89_vcs_long_accel;
   Msg_U3T_Obj_89_50ms.U3T89_vcs_long_posn.phys = @sysvar::MsgU3T_Obj_89_50ms::SigU3T89_vcs_long_posn;
   Msg_U3T_Obj_89_50ms.U3T89_vcs_long_vel.phys = @sysvar::MsgU3T_Obj_89_50ms::SigU3T89_vcs_long_vel;
   Msg_U3T_Obj_89_50ms.U3T89_conf_overall.phys = @sysvar::MsgU3T_Obj_89_50ms::SigU3T89_conf_overall;
   Msg_U3T_Obj_89_50ms.U3T89_f_oncoming.phys = @sysvar::MsgU3T_Obj_89_50ms::SigU3T89_f_oncoming;
   Msg_U3T_Obj_89_50ms.U3T89_f_receding.phys = @sysvar::MsgU3T_Obj_89_50ms::SigU3T89_f_receding;
   output(Msg_U3T_Obj_89_50ms);
   Msg_U3T_Obj_81_50ms.U3T81_age.phys = @sysvar::MsgU3T_Obj_81_50ms::SigU3T81_age;
   Msg_U3T_Obj_81_50ms.U3T81_f_moveable.phys = @sysvar::MsgU3T_Obj_81_50ms::SigU3T81_f_moveable;
   Msg_U3T_Obj_81_50ms.U3T81_f_stationary.phys = @sysvar::MsgU3T_Obj_81_50ms::SigU3T81_f_stationary;
   Msg_U3T_Obj_81_50ms.U3T81_FLcorner_lat.phys = @sysvar::MsgU3T_Obj_81_50ms::SigU3T81_FLcorner_lat;
   Msg_U3T_Obj_81_50ms.U3T81_object_class.phys = @sysvar::MsgU3T_Obj_81_50ms::SigU3T81_object_class;
   Msg_U3T_Obj_81_50ms.U3T81_FLcorner_long.phys = @sysvar::MsgU3T_Obj_81_50ms::SigU3T81_FLcorner_long;
   Msg_U3T_Obj_81_50ms.U3T81_status.phys = @sysvar::MsgU3T_Obj_81_50ms::SigU3T81_status;
   Msg_U3T_Obj_81_50ms.U3T81_FRcorner_lat.phys = @sysvar::MsgU3T_Obj_81_50ms::SigU3T81_FRcorner_lat;
   Msg_U3T_Obj_81_50ms.U3T81_FRcorner_long.phys = @sysvar::MsgU3T_Obj_81_50ms::SigU3T81_FRcorner_long;
   Msg_U3T_Obj_81_50ms.U3T81_heading_rate.phys = @sysvar::MsgU3T_Obj_81_50ms::SigU3T81_heading_rate;
   Msg_U3T_Obj_81_50ms.U3T81_id.phys = @sysvar::MsgU3T_Obj_81_50ms::SigU3T81_id;
   Msg_U3T_Obj_81_50ms.U3T81_length.phys = @sysvar::MsgU3T_Obj_81_50ms::SigU3T81_length;
   Msg_U3T_Obj_81_50ms.U3T81_RLcorner_lat.phys = @sysvar::MsgU3T_Obj_81_50ms::SigU3T81_RLcorner_lat;
   Msg_U3T_Obj_81_50ms.U3T81_RLcorner_long.phys = @sysvar::MsgU3T_Obj_81_50ms::SigU3T81_RLcorner_long;
   Msg_U3T_Obj_81_50ms.U3T81_RRcorner_lat.phys = @sysvar::MsgU3T_Obj_81_50ms::SigU3T81_RRcorner_lat;
   Msg_U3T_Obj_81_50ms.U3T81_RRcorner_long.phys = @sysvar::MsgU3T_Obj_81_50ms::SigU3T81_RRcorner_long;
   Msg_U3T_Obj_81_50ms.U3T81_speed.phys = @sysvar::MsgU3T_Obj_81_50ms::SigU3T81_speed;
   Msg_U3T_Obj_81_50ms.U3T81_width.phys = @sysvar::MsgU3T_Obj_81_50ms::SigU3T81_width;
   Msg_U3T_Obj_81_50ms.U3T81_fusion_source.phys = @sysvar::MsgU3T_Obj_81_50ms::SigU3T81_fusion_source;
   Msg_U3T_Obj_81_50ms.U3T81_vcs_heading.phys = @sysvar::MsgU3T_Obj_81_50ms::SigU3T81_vcs_heading;
   Msg_U3T_Obj_81_50ms.U3T81_vcs_lat_accel.phys = @sysvar::MsgU3T_Obj_81_50ms::SigU3T81_vcs_lat_accel;
   Msg_U3T_Obj_81_50ms.U3T81_vcs_lat_posn.phys = @sysvar::MsgU3T_Obj_81_50ms::SigU3T81_vcs_lat_posn;
   Msg_U3T_Obj_81_50ms.U3T81_vcs_lat_vel.phys = @sysvar::MsgU3T_Obj_81_50ms::SigU3T81_vcs_lat_vel;
   Msg_U3T_Obj_81_50ms.U3T81_vcs_long_accel.phys = @sysvar::MsgU3T_Obj_81_50ms::SigU3T81_vcs_long_accel;
   Msg_U3T_Obj_81_50ms.U3T81_vcs_long_posn.phys = @sysvar::MsgU3T_Obj_81_50ms::SigU3T81_vcs_long_posn;
   Msg_U3T_Obj_81_50ms.U3T81_vcs_long_vel.phys = @sysvar::MsgU3T_Obj_81_50ms::SigU3T81_vcs_long_vel;
   Msg_U3T_Obj_81_50ms.U3T81_conf_overall.phys = @sysvar::MsgU3T_Obj_81_50ms::SigU3T81_conf_overall;
   Msg_U3T_Obj_81_50ms.U3T81_f_oncoming.phys = @sysvar::MsgU3T_Obj_81_50ms::SigU3T81_f_oncoming;
   Msg_U3T_Obj_81_50ms.U3T81_f_receding.phys = @sysvar::MsgU3T_Obj_81_50ms::SigU3T81_f_receding;
   output(Msg_U3T_Obj_81_50ms);
   Msg_U3T_Obj_72_50ms.U3T72_age.phys = @sysvar::MsgU3T_Obj_72_50ms::SigU3T72_age;
   Msg_U3T_Obj_72_50ms.U3T72_f_moveable.phys = @sysvar::MsgU3T_Obj_72_50ms::SigU3T72_f_moveable;
   Msg_U3T_Obj_72_50ms.U3T72_f_stationary.phys = @sysvar::MsgU3T_Obj_72_50ms::SigU3T72_f_stationary;
   Msg_U3T_Obj_72_50ms.U3T72_FLcorner_lat.phys = @sysvar::MsgU3T_Obj_72_50ms::SigU3T72_FLcorner_lat;
   Msg_U3T_Obj_72_50ms.U3T72_object_class.phys = @sysvar::MsgU3T_Obj_72_50ms::SigU3T72_object_class;
   Msg_U3T_Obj_72_50ms.U3T72_FLcorner_long.phys = @sysvar::MsgU3T_Obj_72_50ms::SigU3T72_FLcorner_long;
   Msg_U3T_Obj_72_50ms.U3T72_status.phys = @sysvar::MsgU3T_Obj_72_50ms::SigU3T72_status;
   Msg_U3T_Obj_72_50ms.U3T72_FRcorner_lat.phys = @sysvar::MsgU3T_Obj_72_50ms::SigU3T72_FRcorner_lat;
   Msg_U3T_Obj_72_50ms.U3T72_FRcorner_long.phys = @sysvar::MsgU3T_Obj_72_50ms::SigU3T72_FRcorner_long;
   Msg_U3T_Obj_72_50ms.U3T72_heading_rate.phys = @sysvar::MsgU3T_Obj_72_50ms::SigU3T72_heading_rate;
   Msg_U3T_Obj_72_50ms.U3T72_id.phys = @sysvar::MsgU3T_Obj_72_50ms::SigU3T72_id;
   Msg_U3T_Obj_72_50ms.U3T72_length.phys = @sysvar::MsgU3T_Obj_72_50ms::SigU3T72_length;
   Msg_U3T_Obj_72_50ms.U3T72_RLcorner_lat.phys = @sysvar::MsgU3T_Obj_72_50ms::SigU3T72_RLcorner_lat;
   Msg_U3T_Obj_72_50ms.U3T72_RLcorner_long.phys = @sysvar::MsgU3T_Obj_72_50ms::SigU3T72_RLcorner_long;
   Msg_U3T_Obj_72_50ms.U3T72_RRcorner_lat.phys = @sysvar::MsgU3T_Obj_72_50ms::SigU3T72_RRcorner_lat;
   Msg_U3T_Obj_72_50ms.U3T72_RRcorner_long.phys = @sysvar::MsgU3T_Obj_72_50ms::SigU3T72_RRcorner_long;
   Msg_U3T_Obj_72_50ms.U3T72_speed.phys = @sysvar::MsgU3T_Obj_72_50ms::SigU3T72_speed;
   Msg_U3T_Obj_72_50ms.U3T72_width.phys = @sysvar::MsgU3T_Obj_72_50ms::SigU3T72_width;
   Msg_U3T_Obj_72_50ms.U3T72_fusion_source.phys = @sysvar::MsgU3T_Obj_72_50ms::SigU3T72_fusion_source;
   Msg_U3T_Obj_72_50ms.U3T72_vcs_heading.phys = @sysvar::MsgU3T_Obj_72_50ms::SigU3T72_vcs_heading;
   Msg_U3T_Obj_72_50ms.U3T72_vcs_lat_accel.phys = @sysvar::MsgU3T_Obj_72_50ms::SigU3T72_vcs_lat_accel;
   Msg_U3T_Obj_72_50ms.U3T72_vcs_lat_posn.phys = @sysvar::MsgU3T_Obj_72_50ms::SigU3T72_vcs_lat_posn;
   Msg_U3T_Obj_72_50ms.U3T72_vcs_lat_vel.phys = @sysvar::MsgU3T_Obj_72_50ms::SigU3T72_vcs_lat_vel;
   Msg_U3T_Obj_72_50ms.U3T72_vcs_long_accel.phys = @sysvar::MsgU3T_Obj_72_50ms::SigU3T72_vcs_long_accel;
   Msg_U3T_Obj_72_50ms.U3T72_vcs_long_posn.phys = @sysvar::MsgU3T_Obj_72_50ms::SigU3T72_vcs_long_posn;
   Msg_U3T_Obj_72_50ms.U3T72_vcs_long_vel.phys = @sysvar::MsgU3T_Obj_72_50ms::SigU3T72_vcs_long_vel;
   Msg_U3T_Obj_72_50ms.U3T72_conf_overall.phys = @sysvar::MsgU3T_Obj_72_50ms::SigU3T72_conf_overall;
   Msg_U3T_Obj_72_50ms.U3T72_f_oncoming.phys = @sysvar::MsgU3T_Obj_72_50ms::SigU3T72_f_oncoming;
   Msg_U3T_Obj_72_50ms.U3T72_f_receding.phys = @sysvar::MsgU3T_Obj_72_50ms::SigU3T72_f_receding;
   output(Msg_U3T_Obj_72_50ms);
   Msg_U3T_Obj_80_50ms.U3T80_age.phys = @sysvar::MsgU3T_Obj_80_50ms::SigU3T80_age;
   Msg_U3T_Obj_80_50ms.U3T80_f_moveable.phys = @sysvar::MsgU3T_Obj_80_50ms::SigU3T80_f_moveable;
   Msg_U3T_Obj_80_50ms.U3T80_f_stationary.phys = @sysvar::MsgU3T_Obj_80_50ms::SigU3T80_f_stationary;
   Msg_U3T_Obj_80_50ms.U3T80_FLcorner_lat.phys = @sysvar::MsgU3T_Obj_80_50ms::SigU3T80_FLcorner_lat;
   Msg_U3T_Obj_80_50ms.U3T80_object_class.phys = @sysvar::MsgU3T_Obj_80_50ms::SigU3T80_object_class;
   Msg_U3T_Obj_80_50ms.U3T80_FLcorner_long.phys = @sysvar::MsgU3T_Obj_80_50ms::SigU3T80_FLcorner_long;
   Msg_U3T_Obj_80_50ms.U3T80_status.phys = @sysvar::MsgU3T_Obj_80_50ms::SigU3T80_status;
   Msg_U3T_Obj_80_50ms.U3T80_FRcorner_lat.phys = @sysvar::MsgU3T_Obj_80_50ms::SigU3T80_FRcorner_lat;
   Msg_U3T_Obj_80_50ms.U3T80_FRcorner_long.phys = @sysvar::MsgU3T_Obj_80_50ms::SigU3T80_FRcorner_long;
   Msg_U3T_Obj_80_50ms.U3T80_heading_rate.phys = @sysvar::MsgU3T_Obj_80_50ms::SigU3T80_heading_rate;
   Msg_U3T_Obj_80_50ms.U3T80_id.phys = @sysvar::MsgU3T_Obj_80_50ms::SigU3T80_id;
   Msg_U3T_Obj_80_50ms.U3T80_length.phys = @sysvar::MsgU3T_Obj_80_50ms::SigU3T80_length;
   Msg_U3T_Obj_80_50ms.U3T80_RLcorner_lat.phys = @sysvar::MsgU3T_Obj_80_50ms::SigU3T80_RLcorner_lat;
   Msg_U3T_Obj_80_50ms.U3T80_RLcorner_long.phys = @sysvar::MsgU3T_Obj_80_50ms::SigU3T80_RLcorner_long;
   Msg_U3T_Obj_80_50ms.U3T80_RRcorner_lat.phys = @sysvar::MsgU3T_Obj_80_50ms::SigU3T80_RRcorner_lat;
   Msg_U3T_Obj_80_50ms.U3T80_RRcorner_long.phys = @sysvar::MsgU3T_Obj_80_50ms::SigU3T80_RRcorner_long;
   Msg_U3T_Obj_80_50ms.U3T80_speed.phys = @sysvar::MsgU3T_Obj_80_50ms::SigU3T80_speed;
   Msg_U3T_Obj_80_50ms.U3T80_width.phys = @sysvar::MsgU3T_Obj_80_50ms::SigU3T80_width;
   Msg_U3T_Obj_80_50ms.U3T80_fusion_source.phys = @sysvar::MsgU3T_Obj_80_50ms::SigU3T80_fusion_source;
   Msg_U3T_Obj_80_50ms.U3T80_vcs_heading.phys = @sysvar::MsgU3T_Obj_80_50ms::SigU3T80_vcs_heading;
   Msg_U3T_Obj_80_50ms.U3T80_vcs_lat_accel.phys = @sysvar::MsgU3T_Obj_80_50ms::SigU3T80_vcs_lat_accel;
   Msg_U3T_Obj_80_50ms.U3T80_vcs_lat_posn.phys = @sysvar::MsgU3T_Obj_80_50ms::SigU3T80_vcs_lat_posn;
   Msg_U3T_Obj_80_50ms.U3T80_vcs_lat_vel.phys = @sysvar::MsgU3T_Obj_80_50ms::SigU3T80_vcs_lat_vel;
   Msg_U3T_Obj_80_50ms.U3T80_vcs_long_accel.phys = @sysvar::MsgU3T_Obj_80_50ms::SigU3T80_vcs_long_accel;
   Msg_U3T_Obj_80_50ms.U3T80_vcs_long_posn.phys = @sysvar::MsgU3T_Obj_80_50ms::SigU3T80_vcs_long_posn;
   Msg_U3T_Obj_80_50ms.U3T80_vcs_long_vel.phys = @sysvar::MsgU3T_Obj_80_50ms::SigU3T80_vcs_long_vel;
   Msg_U3T_Obj_80_50ms.U3T80_conf_overall.phys = @sysvar::MsgU3T_Obj_80_50ms::SigU3T80_conf_overall;
   Msg_U3T_Obj_80_50ms.U3T80_f_oncoming.phys = @sysvar::MsgU3T_Obj_80_50ms::SigU3T80_f_oncoming;
   Msg_U3T_Obj_80_50ms.U3T80_f_receding.phys = @sysvar::MsgU3T_Obj_80_50ms::SigU3T80_f_receding;
   output(Msg_U3T_Obj_80_50ms);
   Msg_U3T_Obj_79_50ms.U3T79_age.phys = @sysvar::MsgU3T_Obj_79_50ms::SigU3T79_age;
   Msg_U3T_Obj_79_50ms.U3T79_f_moveable.phys = @sysvar::MsgU3T_Obj_79_50ms::SigU3T79_f_moveable;
   Msg_U3T_Obj_79_50ms.U3T79_f_stationary.phys = @sysvar::MsgU3T_Obj_79_50ms::SigU3T79_f_stationary;
   Msg_U3T_Obj_79_50ms.U3T79_FLcorner_lat.phys = @sysvar::MsgU3T_Obj_79_50ms::SigU3T79_FLcorner_lat;
   Msg_U3T_Obj_79_50ms.U3T79_object_class.phys = @sysvar::MsgU3T_Obj_79_50ms::SigU3T79_object_class;
   Msg_U3T_Obj_79_50ms.U3T79_FLcorner_long.phys = @sysvar::MsgU3T_Obj_79_50ms::SigU3T79_FLcorner_long;
   Msg_U3T_Obj_79_50ms.U3T79_status.phys = @sysvar::MsgU3T_Obj_79_50ms::SigU3T79_status;
   Msg_U3T_Obj_79_50ms.U3T79_FRcorner_lat.phys = @sysvar::MsgU3T_Obj_79_50ms::SigU3T79_FRcorner_lat;
   Msg_U3T_Obj_79_50ms.U3T79_FRcorner_long.phys = @sysvar::MsgU3T_Obj_79_50ms::SigU3T79_FRcorner_long;
   Msg_U3T_Obj_79_50ms.U3T79_heading_rate.phys = @sysvar::MsgU3T_Obj_79_50ms::SigU3T79_heading_rate;
   Msg_U3T_Obj_79_50ms.U3T79_id.phys = @sysvar::MsgU3T_Obj_79_50ms::SigU3T79_id;
   Msg_U3T_Obj_79_50ms.U3T79_length.phys = @sysvar::MsgU3T_Obj_79_50ms::SigU3T79_length;
   Msg_U3T_Obj_79_50ms.U3T79_RLcorner_lat.phys = @sysvar::MsgU3T_Obj_79_50ms::SigU3T79_RLcorner_lat;
   Msg_U3T_Obj_79_50ms.U3T79_RLcorner_long.phys = @sysvar::MsgU3T_Obj_79_50ms::SigU3T79_RLcorner_long;
   Msg_U3T_Obj_79_50ms.U3T79_RRcorner_lat.phys = @sysvar::MsgU3T_Obj_79_50ms::SigU3T79_RRcorner_lat;
   Msg_U3T_Obj_79_50ms.U3T79_RRcorner_long.phys = @sysvar::MsgU3T_Obj_79_50ms::SigU3T79_RRcorner_long;
   Msg_U3T_Obj_79_50ms.U3T79_speed.phys = @sysvar::MsgU3T_Obj_79_50ms::SigU3T79_speed;
   Msg_U3T_Obj_79_50ms.U3T79_width.phys = @sysvar::MsgU3T_Obj_79_50ms::SigU3T79_width;
   Msg_U3T_Obj_79_50ms.U3T79_fusion_source.phys = @sysvar::MsgU3T_Obj_79_50ms::SigU3T79_fusion_source;
   Msg_U3T_Obj_79_50ms.U3T79_vcs_heading.phys = @sysvar::MsgU3T_Obj_79_50ms::SigU3T79_vcs_heading;
   Msg_U3T_Obj_79_50ms.U3T79_vcs_lat_accel.phys = @sysvar::MsgU3T_Obj_79_50ms::SigU3T79_vcs_lat_accel;
   Msg_U3T_Obj_79_50ms.U3T79_vcs_lat_posn.phys = @sysvar::MsgU3T_Obj_79_50ms::SigU3T79_vcs_lat_posn;
   Msg_U3T_Obj_79_50ms.U3T79_vcs_lat_vel.phys = @sysvar::MsgU3T_Obj_79_50ms::SigU3T79_vcs_lat_vel;
   Msg_U3T_Obj_79_50ms.U3T79_vcs_long_accel.phys = @sysvar::MsgU3T_Obj_79_50ms::SigU3T79_vcs_long_accel;
   Msg_U3T_Obj_79_50ms.U3T79_vcs_long_posn.phys = @sysvar::MsgU3T_Obj_79_50ms::SigU3T79_vcs_long_posn;
   Msg_U3T_Obj_79_50ms.U3T79_vcs_long_vel.phys = @sysvar::MsgU3T_Obj_79_50ms::SigU3T79_vcs_long_vel;
   Msg_U3T_Obj_79_50ms.U3T79_conf_overall.phys = @sysvar::MsgU3T_Obj_79_50ms::SigU3T79_conf_overall;
   Msg_U3T_Obj_79_50ms.U3T79_f_oncoming.phys = @sysvar::MsgU3T_Obj_79_50ms::SigU3T79_f_oncoming;
   Msg_U3T_Obj_79_50ms.U3T79_f_receding.phys = @sysvar::MsgU3T_Obj_79_50ms::SigU3T79_f_receding;
   output(Msg_U3T_Obj_79_50ms);
   Msg_U3T_Obj_78_50ms.U3T78_age.phys = @sysvar::MsgU3T_Obj_78_50ms::SigU3T78_age;
   Msg_U3T_Obj_78_50ms.U3T78_f_moveable.phys = @sysvar::MsgU3T_Obj_78_50ms::SigU3T78_f_moveable;
   Msg_U3T_Obj_78_50ms.U3T78_f_stationary.phys = @sysvar::MsgU3T_Obj_78_50ms::SigU3T78_f_stationary;
   Msg_U3T_Obj_78_50ms.U3T78_FLcorner_lat.phys = @sysvar::MsgU3T_Obj_78_50ms::SigU3T78_FLcorner_lat;
   Msg_U3T_Obj_78_50ms.U3T78_object_class.phys = @sysvar::MsgU3T_Obj_78_50ms::SigU3T78_object_class;
   Msg_U3T_Obj_78_50ms.U3T78_FLcorner_long.phys = @sysvar::MsgU3T_Obj_78_50ms::SigU3T78_FLcorner_long;
   Msg_U3T_Obj_78_50ms.U3T78_status.phys = @sysvar::MsgU3T_Obj_78_50ms::SigU3T78_status;
   Msg_U3T_Obj_78_50ms.U3T78_FRcorner_lat.phys = @sysvar::MsgU3T_Obj_78_50ms::SigU3T78_FRcorner_lat;
   Msg_U3T_Obj_78_50ms.U3T78_FRcorner_long.phys = @sysvar::MsgU3T_Obj_78_50ms::SigU3T78_FRcorner_long;
   Msg_U3T_Obj_78_50ms.U3T78_heading_rate.phys = @sysvar::MsgU3T_Obj_78_50ms::SigU3T78_heading_rate;
   Msg_U3T_Obj_78_50ms.U3T78_id.phys = @sysvar::MsgU3T_Obj_78_50ms::SigU3T78_id;
   Msg_U3T_Obj_78_50ms.U3T78_length.phys = @sysvar::MsgU3T_Obj_78_50ms::SigU3T78_length;
   Msg_U3T_Obj_78_50ms.U3T78_RLcorner_lat.phys = @sysvar::MsgU3T_Obj_78_50ms::SigU3T78_RLcorner_lat;
   Msg_U3T_Obj_78_50ms.U3T78_RLcorner_long.phys = @sysvar::MsgU3T_Obj_78_50ms::SigU3T78_RLcorner_long;
   Msg_U3T_Obj_78_50ms.U3T78_RRcorner_lat.phys = @sysvar::MsgU3T_Obj_78_50ms::SigU3T78_RRcorner_lat;
   Msg_U3T_Obj_78_50ms.U3T78_RRcorner_long.phys = @sysvar::MsgU3T_Obj_78_50ms::SigU3T78_RRcorner_long;
   Msg_U3T_Obj_78_50ms.U3T78_speed.phys = @sysvar::MsgU3T_Obj_78_50ms::SigU3T78_speed;
   Msg_U3T_Obj_78_50ms.U3T78_width.phys = @sysvar::MsgU3T_Obj_78_50ms::SigU3T78_width;
   Msg_U3T_Obj_78_50ms.U3T78_fusion_source.phys = @sysvar::MsgU3T_Obj_78_50ms::SigU3T78_fusion_source;
   Msg_U3T_Obj_78_50ms.U3T78_vcs_heading.phys = @sysvar::MsgU3T_Obj_78_50ms::SigU3T78_vcs_heading;
   Msg_U3T_Obj_78_50ms.U3T78_vcs_lat_accel.phys = @sysvar::MsgU3T_Obj_78_50ms::SigU3T78_vcs_lat_accel;
   Msg_U3T_Obj_78_50ms.U3T78_vcs_lat_posn.phys = @sysvar::MsgU3T_Obj_78_50ms::SigU3T78_vcs_lat_posn;
   Msg_U3T_Obj_78_50ms.U3T78_vcs_lat_vel.phys = @sysvar::MsgU3T_Obj_78_50ms::SigU3T78_vcs_lat_vel;
   Msg_U3T_Obj_78_50ms.U3T78_vcs_long_accel.phys = @sysvar::MsgU3T_Obj_78_50ms::SigU3T78_vcs_long_accel;
   Msg_U3T_Obj_78_50ms.U3T78_vcs_long_posn.phys = @sysvar::MsgU3T_Obj_78_50ms::SigU3T78_vcs_long_posn;
   Msg_U3T_Obj_78_50ms.U3T78_vcs_long_vel.phys = @sysvar::MsgU3T_Obj_78_50ms::SigU3T78_vcs_long_vel;
   Msg_U3T_Obj_78_50ms.U3T78_conf_overall.phys = @sysvar::MsgU3T_Obj_78_50ms::SigU3T78_conf_overall;
   Msg_U3T_Obj_78_50ms.U3T78_f_oncoming.phys = @sysvar::MsgU3T_Obj_78_50ms::SigU3T78_f_oncoming;
   Msg_U3T_Obj_78_50ms.U3T78_f_receding.phys = @sysvar::MsgU3T_Obj_78_50ms::SigU3T78_f_receding;
   output(Msg_U3T_Obj_78_50ms);
   Msg_U3T_Obj_77_50ms.U3T77_age.phys = @sysvar::MsgU3T_Obj_77_50ms::SigU3T77_age;
   Msg_U3T_Obj_77_50ms.U3T77_f_moveable.phys = @sysvar::MsgU3T_Obj_77_50ms::SigU3T77_f_moveable;
   Msg_U3T_Obj_77_50ms.U3T77_f_stationary.phys = @sysvar::MsgU3T_Obj_77_50ms::SigU3T77_f_stationary;
   Msg_U3T_Obj_77_50ms.U3T77_FLcorner_lat.phys = @sysvar::MsgU3T_Obj_77_50ms::SigU3T77_FLcorner_lat;
   Msg_U3T_Obj_77_50ms.U3T77_object_class.phys = @sysvar::MsgU3T_Obj_77_50ms::SigU3T77_object_class;
   Msg_U3T_Obj_77_50ms.U3T77_FLcorner_long.phys = @sysvar::MsgU3T_Obj_77_50ms::SigU3T77_FLcorner_long;
   Msg_U3T_Obj_77_50ms.U3T77_status.phys = @sysvar::MsgU3T_Obj_77_50ms::SigU3T77_status;
   Msg_U3T_Obj_77_50ms.U3T77_FRcorner_lat.phys = @sysvar::MsgU3T_Obj_77_50ms::SigU3T77_FRcorner_lat;
   Msg_U3T_Obj_77_50ms.U3T77_FRcorner_long.phys = @sysvar::MsgU3T_Obj_77_50ms::SigU3T77_FRcorner_long;
   Msg_U3T_Obj_77_50ms.U3T77_heading_rate.phys = @sysvar::MsgU3T_Obj_77_50ms::SigU3T77_heading_rate;
   Msg_U3T_Obj_77_50ms.U3T77_id.phys = @sysvar::MsgU3T_Obj_77_50ms::SigU3T77_id;
   Msg_U3T_Obj_77_50ms.U3T77_length.phys = @sysvar::MsgU3T_Obj_77_50ms::SigU3T77_length;
   Msg_U3T_Obj_77_50ms.U3T77_RLcorner_lat.phys = @sysvar::MsgU3T_Obj_77_50ms::SigU3T77_RLcorner_lat;
   Msg_U3T_Obj_77_50ms.U3T77_RLcorner_long.phys = @sysvar::MsgU3T_Obj_77_50ms::SigU3T77_RLcorner_long;
   Msg_U3T_Obj_77_50ms.U3T77_RRcorner_lat.phys = @sysvar::MsgU3T_Obj_77_50ms::SigU3T77_RRcorner_lat;
   Msg_U3T_Obj_77_50ms.U3T77_RRcorner_long.phys = @sysvar::MsgU3T_Obj_77_50ms::SigU3T77_RRcorner_long;
   Msg_U3T_Obj_77_50ms.U3T77_speed.phys = @sysvar::MsgU3T_Obj_77_50ms::SigU3T77_speed;
   Msg_U3T_Obj_77_50ms.U3T77_width.phys = @sysvar::MsgU3T_Obj_77_50ms::SigU3T77_width;
   Msg_U3T_Obj_77_50ms.U3T77_fusion_source.phys = @sysvar::MsgU3T_Obj_77_50ms::SigU3T77_fusion_source;
   Msg_U3T_Obj_77_50ms.U3T77_vcs_heading.phys = @sysvar::MsgU3T_Obj_77_50ms::SigU3T77_vcs_heading;
   Msg_U3T_Obj_77_50ms.U3T77_vcs_lat_accel.phys = @sysvar::MsgU3T_Obj_77_50ms::SigU3T77_vcs_lat_accel;
   Msg_U3T_Obj_77_50ms.U3T77_vcs_lat_posn.phys = @sysvar::MsgU3T_Obj_77_50ms::SigU3T77_vcs_lat_posn;
   Msg_U3T_Obj_77_50ms.U3T77_vcs_lat_vel.phys = @sysvar::MsgU3T_Obj_77_50ms::SigU3T77_vcs_lat_vel;
   Msg_U3T_Obj_77_50ms.U3T77_vcs_long_accel.phys = @sysvar::MsgU3T_Obj_77_50ms::SigU3T77_vcs_long_accel;
   Msg_U3T_Obj_77_50ms.U3T77_vcs_long_posn.phys = @sysvar::MsgU3T_Obj_77_50ms::SigU3T77_vcs_long_posn;
   Msg_U3T_Obj_77_50ms.U3T77_vcs_long_vel.phys = @sysvar::MsgU3T_Obj_77_50ms::SigU3T77_vcs_long_vel;
   Msg_U3T_Obj_77_50ms.U3T77_conf_overall.phys = @sysvar::MsgU3T_Obj_77_50ms::SigU3T77_conf_overall;
   Msg_U3T_Obj_77_50ms.U3T77_f_oncoming.phys = @sysvar::MsgU3T_Obj_77_50ms::SigU3T77_f_oncoming;
   Msg_U3T_Obj_77_50ms.U3T77_f_receding.phys = @sysvar::MsgU3T_Obj_77_50ms::SigU3T77_f_receding;
   output(Msg_U3T_Obj_77_50ms);
   Msg_U3T_Obj_76_50ms.U3T76_age.phys = @sysvar::MsgU3T_Obj_76_50ms::SigU3T76_age;
   Msg_U3T_Obj_76_50ms.U3T76_f_moveable.phys = @sysvar::MsgU3T_Obj_76_50ms::SigU3T76_f_moveable;
   Msg_U3T_Obj_76_50ms.U3T76_f_stationary.phys = @sysvar::MsgU3T_Obj_76_50ms::SigU3T76_f_stationary;
   Msg_U3T_Obj_76_50ms.U3T76_FLcorner_lat.phys = @sysvar::MsgU3T_Obj_76_50ms::SigU3T76_FLcorner_lat;
   Msg_U3T_Obj_76_50ms.U3T76_object_class.phys = @sysvar::MsgU3T_Obj_76_50ms::SigU3T76_object_class;
   Msg_U3T_Obj_76_50ms.U3T76_FLcorner_long.phys = @sysvar::MsgU3T_Obj_76_50ms::SigU3T76_FLcorner_long;
   Msg_U3T_Obj_76_50ms.U3T76_status.phys = @sysvar::MsgU3T_Obj_76_50ms::SigU3T76_status;
   Msg_U3T_Obj_76_50ms.U3T76_FRcorner_lat.phys = @sysvar::MsgU3T_Obj_76_50ms::SigU3T76_FRcorner_lat;
   Msg_U3T_Obj_76_50ms.U3T76_FRcorner_long.phys = @sysvar::MsgU3T_Obj_76_50ms::SigU3T76_FRcorner_long;
   Msg_U3T_Obj_76_50ms.U3T76_heading_rate.phys = @sysvar::MsgU3T_Obj_76_50ms::SigU3T76_heading_rate;
   Msg_U3T_Obj_76_50ms.U3T76_id.phys = @sysvar::MsgU3T_Obj_76_50ms::SigU3T76_id;
   Msg_U3T_Obj_76_50ms.U3T76_length.phys = @sysvar::MsgU3T_Obj_76_50ms::SigU3T76_length;
   Msg_U3T_Obj_76_50ms.U3T76_RLcorner_lat.phys = @sysvar::MsgU3T_Obj_76_50ms::SigU3T76_RLcorner_lat;
   Msg_U3T_Obj_76_50ms.U3T76_RLcorner_long.phys = @sysvar::MsgU3T_Obj_76_50ms::SigU3T76_RLcorner_long;
   Msg_U3T_Obj_76_50ms.U3T76_RRcorner_lat.phys = @sysvar::MsgU3T_Obj_76_50ms::SigU3T76_RRcorner_lat;
   Msg_U3T_Obj_76_50ms.U3T76_RRcorner_long.phys = @sysvar::MsgU3T_Obj_76_50ms::SigU3T76_RRcorner_long;
   Msg_U3T_Obj_76_50ms.U3T76_speed.phys = @sysvar::MsgU3T_Obj_76_50ms::SigU3T76_speed;
   Msg_U3T_Obj_76_50ms.U3T76_width.phys = @sysvar::MsgU3T_Obj_76_50ms::SigU3T76_width;
   Msg_U3T_Obj_76_50ms.U3T76_fusion_source.phys = @sysvar::MsgU3T_Obj_76_50ms::SigU3T76_fusion_source;
   Msg_U3T_Obj_76_50ms.U3T76_vcs_heading.phys = @sysvar::MsgU3T_Obj_76_50ms::SigU3T76_vcs_heading;
   Msg_U3T_Obj_76_50ms.U3T76_vcs_lat_accel.phys = @sysvar::MsgU3T_Obj_76_50ms::SigU3T76_vcs_lat_accel;
   Msg_U3T_Obj_76_50ms.U3T76_vcs_lat_posn.phys = @sysvar::MsgU3T_Obj_76_50ms::SigU3T76_vcs_lat_posn;
   Msg_U3T_Obj_76_50ms.U3T76_vcs_lat_vel.phys = @sysvar::MsgU3T_Obj_76_50ms::SigU3T76_vcs_lat_vel;
   Msg_U3T_Obj_76_50ms.U3T76_vcs_long_accel.phys = @sysvar::MsgU3T_Obj_76_50ms::SigU3T76_vcs_long_accel;
   Msg_U3T_Obj_76_50ms.U3T76_vcs_long_posn.phys = @sysvar::MsgU3T_Obj_76_50ms::SigU3T76_vcs_long_posn;
   Msg_U3T_Obj_76_50ms.U3T76_vcs_long_vel.phys = @sysvar::MsgU3T_Obj_76_50ms::SigU3T76_vcs_long_vel;
   Msg_U3T_Obj_76_50ms.U3T76_conf_overall.phys = @sysvar::MsgU3T_Obj_76_50ms::SigU3T76_conf_overall;
   Msg_U3T_Obj_76_50ms.U3T76_f_oncoming.phys = @sysvar::MsgU3T_Obj_76_50ms::SigU3T76_f_oncoming;
   Msg_U3T_Obj_76_50ms.U3T76_f_receding.phys = @sysvar::MsgU3T_Obj_76_50ms::SigU3T76_f_receding;
   output(Msg_U3T_Obj_76_50ms);
   Msg_U3T_Obj_75_50ms.U3T75_age.phys = @sysvar::MsgU3T_Obj_75_50ms::SigU3T75_age;
   Msg_U3T_Obj_75_50ms.U3T75_f_moveable.phys = @sysvar::MsgU3T_Obj_75_50ms::SigU3T75_f_moveable;
   Msg_U3T_Obj_75_50ms.U3T75_f_stationary.phys = @sysvar::MsgU3T_Obj_75_50ms::SigU3T75_f_stationary;
   Msg_U3T_Obj_75_50ms.U3T75_FLcorner_lat.phys = @sysvar::MsgU3T_Obj_75_50ms::SigU3T75_FLcorner_lat;
   Msg_U3T_Obj_75_50ms.U3T75_object_class.phys = @sysvar::MsgU3T_Obj_75_50ms::SigU3T75_object_class;
   Msg_U3T_Obj_75_50ms.U3T75_FLcorner_long.phys = @sysvar::MsgU3T_Obj_75_50ms::SigU3T75_FLcorner_long;
   Msg_U3T_Obj_75_50ms.U3T75_status.phys = @sysvar::MsgU3T_Obj_75_50ms::SigU3T75_status;
   Msg_U3T_Obj_75_50ms.U3T75_FRcorner_lat.phys = @sysvar::MsgU3T_Obj_75_50ms::SigU3T75_FRcorner_lat;
   Msg_U3T_Obj_75_50ms.U3T75_FRcorner_long.phys = @sysvar::MsgU3T_Obj_75_50ms::SigU3T75_FRcorner_long;
   Msg_U3T_Obj_75_50ms.U3T75_heading_rate.phys = @sysvar::MsgU3T_Obj_75_50ms::SigU3T75_heading_rate;
   Msg_U3T_Obj_75_50ms.U3T75_id.phys = @sysvar::MsgU3T_Obj_75_50ms::SigU3T75_id;
   Msg_U3T_Obj_75_50ms.U3T75_length.phys = @sysvar::MsgU3T_Obj_75_50ms::SigU3T75_length;
   Msg_U3T_Obj_75_50ms.U3T75_RLcorner_lat.phys = @sysvar::MsgU3T_Obj_75_50ms::SigU3T75_RLcorner_lat;
   Msg_U3T_Obj_75_50ms.U3T75_RLcorner_long.phys = @sysvar::MsgU3T_Obj_75_50ms::SigU3T75_RLcorner_long;
   Msg_U3T_Obj_75_50ms.U3T75_RRcorner_lat.phys = @sysvar::MsgU3T_Obj_75_50ms::SigU3T75_RRcorner_lat;
   Msg_U3T_Obj_75_50ms.U3T75_RRcorner_long.phys = @sysvar::MsgU3T_Obj_75_50ms::SigU3T75_RRcorner_long;
   Msg_U3T_Obj_75_50ms.U3T75_speed.phys = @sysvar::MsgU3T_Obj_75_50ms::SigU3T75_speed;
   Msg_U3T_Obj_75_50ms.U3T75_width.phys = @sysvar::MsgU3T_Obj_75_50ms::SigU3T75_width;
   Msg_U3T_Obj_75_50ms.U3T75_fusion_source.phys = @sysvar::MsgU3T_Obj_75_50ms::SigU3T75_fusion_source;
   Msg_U3T_Obj_75_50ms.U3T75_vcs_heading.phys = @sysvar::MsgU3T_Obj_75_50ms::SigU3T75_vcs_heading;
   Msg_U3T_Obj_75_50ms.U3T75_vcs_lat_accel.phys = @sysvar::MsgU3T_Obj_75_50ms::SigU3T75_vcs_lat_accel;
   Msg_U3T_Obj_75_50ms.U3T75_vcs_lat_posn.phys = @sysvar::MsgU3T_Obj_75_50ms::SigU3T75_vcs_lat_posn;
   Msg_U3T_Obj_75_50ms.U3T75_vcs_lat_vel.phys = @sysvar::MsgU3T_Obj_75_50ms::SigU3T75_vcs_lat_vel;
   Msg_U3T_Obj_75_50ms.U3T75_vcs_long_accel.phys = @sysvar::MsgU3T_Obj_75_50ms::SigU3T75_vcs_long_accel;
   Msg_U3T_Obj_75_50ms.U3T75_vcs_long_posn.phys = @sysvar::MsgU3T_Obj_75_50ms::SigU3T75_vcs_long_posn;
   Msg_U3T_Obj_75_50ms.U3T75_vcs_long_vel.phys = @sysvar::MsgU3T_Obj_75_50ms::SigU3T75_vcs_long_vel;
   Msg_U3T_Obj_75_50ms.U3T75_conf_overall.phys = @sysvar::MsgU3T_Obj_75_50ms::SigU3T75_conf_overall;
   Msg_U3T_Obj_75_50ms.U3T75_f_oncoming.phys = @sysvar::MsgU3T_Obj_75_50ms::SigU3T75_f_oncoming;
   Msg_U3T_Obj_75_50ms.U3T75_f_receding.phys = @sysvar::MsgU3T_Obj_75_50ms::SigU3T75_f_receding;
   output(Msg_U3T_Obj_75_50ms);
   Msg_U3T_Obj_74_50ms.U3T74_age.phys = @sysvar::MsgU3T_Obj_74_50ms::SigU3T74_age;
   Msg_U3T_Obj_74_50ms.U3T74_f_moveable.phys = @sysvar::MsgU3T_Obj_74_50ms::SigU3T74_f_moveable;
   Msg_U3T_Obj_74_50ms.U3T74_f_stationary.phys = @sysvar::MsgU3T_Obj_74_50ms::SigU3T74_f_stationary;
   Msg_U3T_Obj_74_50ms.U3T74_FLcorner_lat.phys = @sysvar::MsgU3T_Obj_74_50ms::SigU3T74_FLcorner_lat;
   Msg_U3T_Obj_74_50ms.U3T74_object_class.phys = @sysvar::MsgU3T_Obj_74_50ms::SigU3T74_object_class;
   Msg_U3T_Obj_74_50ms.U3T74_FLcorner_long.phys = @sysvar::MsgU3T_Obj_74_50ms::SigU3T74_FLcorner_long;
   Msg_U3T_Obj_74_50ms.U3T74_status.phys = @sysvar::MsgU3T_Obj_74_50ms::SigU3T74_status;
   Msg_U3T_Obj_74_50ms.U3T74_FRcorner_lat.phys = @sysvar::MsgU3T_Obj_74_50ms::SigU3T74_FRcorner_lat;
   Msg_U3T_Obj_74_50ms.U3T74_FRcorner_long.phys = @sysvar::MsgU3T_Obj_74_50ms::SigU3T74_FRcorner_long;
   Msg_U3T_Obj_74_50ms.U3T74_heading_rate.phys = @sysvar::MsgU3T_Obj_74_50ms::SigU3T74_heading_rate;
   Msg_U3T_Obj_74_50ms.U3T74_id.phys = @sysvar::MsgU3T_Obj_74_50ms::SigU3T74_id;
   Msg_U3T_Obj_74_50ms.U3T74_length.phys = @sysvar::MsgU3T_Obj_74_50ms::SigU3T74_length;
   Msg_U3T_Obj_74_50ms.U3T74_RLcorner_lat.phys = @sysvar::MsgU3T_Obj_74_50ms::SigU3T74_RLcorner_lat;
   Msg_U3T_Obj_74_50ms.U3T74_RLcorner_long.phys = @sysvar::MsgU3T_Obj_74_50ms::SigU3T74_RLcorner_long;
   Msg_U3T_Obj_74_50ms.U3T74_RRcorner_lat.phys = @sysvar::MsgU3T_Obj_74_50ms::SigU3T74_RRcorner_lat;
   Msg_U3T_Obj_74_50ms.U3T74_RRcorner_long.phys = @sysvar::MsgU3T_Obj_74_50ms::SigU3T74_RRcorner_long;
   Msg_U3T_Obj_74_50ms.U3T74_speed.phys = @sysvar::MsgU3T_Obj_74_50ms::SigU3T74_speed;
   Msg_U3T_Obj_74_50ms.U3T74_width.phys = @sysvar::MsgU3T_Obj_74_50ms::SigU3T74_width;
   Msg_U3T_Obj_74_50ms.U3T74_fusion_source.phys = @sysvar::MsgU3T_Obj_74_50ms::SigU3T74_fusion_source;
   Msg_U3T_Obj_74_50ms.U3T74_vcs_heading.phys = @sysvar::MsgU3T_Obj_74_50ms::SigU3T74_vcs_heading;
   Msg_U3T_Obj_74_50ms.U3T74_vcs_lat_accel.phys = @sysvar::MsgU3T_Obj_74_50ms::SigU3T74_vcs_lat_accel;
   Msg_U3T_Obj_74_50ms.U3T74_vcs_lat_posn.phys = @sysvar::MsgU3T_Obj_74_50ms::SigU3T74_vcs_lat_posn;
   Msg_U3T_Obj_74_50ms.U3T74_vcs_lat_vel.phys = @sysvar::MsgU3T_Obj_74_50ms::SigU3T74_vcs_lat_vel;
   Msg_U3T_Obj_74_50ms.U3T74_vcs_long_accel.phys = @sysvar::MsgU3T_Obj_74_50ms::SigU3T74_vcs_long_accel;
   Msg_U3T_Obj_74_50ms.U3T74_vcs_long_posn.phys = @sysvar::MsgU3T_Obj_74_50ms::SigU3T74_vcs_long_posn;
   Msg_U3T_Obj_74_50ms.U3T74_vcs_long_vel.phys = @sysvar::MsgU3T_Obj_74_50ms::SigU3T74_vcs_long_vel;
   Msg_U3T_Obj_74_50ms.U3T74_conf_overall.phys = @sysvar::MsgU3T_Obj_74_50ms::SigU3T74_conf_overall;
   Msg_U3T_Obj_74_50ms.U3T74_f_oncoming.phys = @sysvar::MsgU3T_Obj_74_50ms::SigU3T74_f_oncoming;
   Msg_U3T_Obj_74_50ms.U3T74_f_receding.phys = @sysvar::MsgU3T_Obj_74_50ms::SigU3T74_f_receding;
   output(Msg_U3T_Obj_74_50ms);
   Msg_U3T_Obj_73_50ms.U3T73_age.phys = @sysvar::MsgU3T_Obj_73_50ms::SigU3T73_age;
   Msg_U3T_Obj_73_50ms.U3T73_f_moveable.phys = @sysvar::MsgU3T_Obj_73_50ms::SigU3T73_f_moveable;
   Msg_U3T_Obj_73_50ms.U3T73_f_stationary.phys = @sysvar::MsgU3T_Obj_73_50ms::SigU3T73_f_stationary;
   Msg_U3T_Obj_73_50ms.U3T73_FLcorner_lat.phys = @sysvar::MsgU3T_Obj_73_50ms::SigU3T73_FLcorner_lat;
   Msg_U3T_Obj_73_50ms.U3T73_object_class.phys = @sysvar::MsgU3T_Obj_73_50ms::SigU3T73_object_class;
   Msg_U3T_Obj_73_50ms.U3T73_FLcorner_long.phys = @sysvar::MsgU3T_Obj_73_50ms::SigU3T73_FLcorner_long;
   Msg_U3T_Obj_73_50ms.U3T73_status.phys = @sysvar::MsgU3T_Obj_73_50ms::SigU3T73_status;
   Msg_U3T_Obj_73_50ms.U3T73_FRcorner_lat.phys = @sysvar::MsgU3T_Obj_73_50ms::SigU3T73_FRcorner_lat;
   Msg_U3T_Obj_73_50ms.U3T73_FRcorner_long.phys = @sysvar::MsgU3T_Obj_73_50ms::SigU3T73_FRcorner_long;
   Msg_U3T_Obj_73_50ms.U3T73_heading_rate.phys = @sysvar::MsgU3T_Obj_73_50ms::SigU3T73_heading_rate;
   Msg_U3T_Obj_73_50ms.U3T73_id.phys = @sysvar::MsgU3T_Obj_73_50ms::SigU3T73_id;
   Msg_U3T_Obj_73_50ms.U3T73_length.phys = @sysvar::MsgU3T_Obj_73_50ms::SigU3T73_length;
   Msg_U3T_Obj_73_50ms.U3T73_RLcorner_lat.phys = @sysvar::MsgU3T_Obj_73_50ms::SigU3T73_RLcorner_lat;
   Msg_U3T_Obj_73_50ms.U3T73_RLcorner_long.phys = @sysvar::MsgU3T_Obj_73_50ms::SigU3T73_RLcorner_long;
   Msg_U3T_Obj_73_50ms.U3T73_RRcorner_lat.phys = @sysvar::MsgU3T_Obj_73_50ms::SigU3T73_RRcorner_lat;
   Msg_U3T_Obj_73_50ms.U3T73_RRcorner_long.phys = @sysvar::MsgU3T_Obj_73_50ms::SigU3T73_RRcorner_long;
   Msg_U3T_Obj_73_50ms.U3T73_speed.phys = @sysvar::MsgU3T_Obj_73_50ms::SigU3T73_speed;
   Msg_U3T_Obj_73_50ms.U3T73_width.phys = @sysvar::MsgU3T_Obj_73_50ms::SigU3T73_width;
   Msg_U3T_Obj_73_50ms.U3T73_fusion_source.phys = @sysvar::MsgU3T_Obj_73_50ms::SigU3T73_fusion_source;
   Msg_U3T_Obj_73_50ms.U3T73_vcs_heading.phys = @sysvar::MsgU3T_Obj_73_50ms::SigU3T73_vcs_heading;
   Msg_U3T_Obj_73_50ms.U3T73_vcs_lat_accel.phys = @sysvar::MsgU3T_Obj_73_50ms::SigU3T73_vcs_lat_accel;
   Msg_U3T_Obj_73_50ms.U3T73_vcs_lat_posn.phys = @sysvar::MsgU3T_Obj_73_50ms::SigU3T73_vcs_lat_posn;
   Msg_U3T_Obj_73_50ms.U3T73_vcs_lat_vel.phys = @sysvar::MsgU3T_Obj_73_50ms::SigU3T73_vcs_lat_vel;
   Msg_U3T_Obj_73_50ms.U3T73_vcs_long_accel.phys = @sysvar::MsgU3T_Obj_73_50ms::SigU3T73_vcs_long_accel;
   Msg_U3T_Obj_73_50ms.U3T73_vcs_long_posn.phys = @sysvar::MsgU3T_Obj_73_50ms::SigU3T73_vcs_long_posn;
   Msg_U3T_Obj_73_50ms.U3T73_vcs_long_vel.phys = @sysvar::MsgU3T_Obj_73_50ms::SigU3T73_vcs_long_vel;
   Msg_U3T_Obj_73_50ms.U3T73_conf_overall.phys = @sysvar::MsgU3T_Obj_73_50ms::SigU3T73_conf_overall;
   Msg_U3T_Obj_73_50ms.U3T73_f_oncoming.phys = @sysvar::MsgU3T_Obj_73_50ms::SigU3T73_f_oncoming;
   Msg_U3T_Obj_73_50ms.U3T73_f_receding.phys = @sysvar::MsgU3T_Obj_73_50ms::SigU3T73_f_receding;
   output(Msg_U3T_Obj_73_50ms);
   Msg_U3T_Obj_71_50ms.U3T71_age.phys = @sysvar::MsgU3T_Obj_71_50ms::SigU3T71_age;
   Msg_U3T_Obj_71_50ms.U3T71_f_moveable.phys = @sysvar::MsgU3T_Obj_71_50ms::SigU3T71_f_moveable;
   Msg_U3T_Obj_71_50ms.U3T71_f_stationary.phys = @sysvar::MsgU3T_Obj_71_50ms::SigU3T71_f_stationary;
   Msg_U3T_Obj_71_50ms.U3T71_FLcorner_lat.phys = @sysvar::MsgU3T_Obj_71_50ms::SigU3T71_FLcorner_lat;
   Msg_U3T_Obj_71_50ms.U3T71_object_class.phys = @sysvar::MsgU3T_Obj_71_50ms::SigU3T71_object_class;
   Msg_U3T_Obj_71_50ms.U3T71_FLcorner_long.phys = @sysvar::MsgU3T_Obj_71_50ms::SigU3T71_FLcorner_long;
   Msg_U3T_Obj_71_50ms.U3T71_status.phys = @sysvar::MsgU3T_Obj_71_50ms::SigU3T71_status;
   Msg_U3T_Obj_71_50ms.U3T71_FRcorner_lat.phys = @sysvar::MsgU3T_Obj_71_50ms::SigU3T71_FRcorner_lat;
   Msg_U3T_Obj_71_50ms.U3T71_FRcorner_long.phys = @sysvar::MsgU3T_Obj_71_50ms::SigU3T71_FRcorner_long;
   Msg_U3T_Obj_71_50ms.U3T71_heading_rate.phys = @sysvar::MsgU3T_Obj_71_50ms::SigU3T71_heading_rate;
   Msg_U3T_Obj_71_50ms.U3T71_id.phys = @sysvar::MsgU3T_Obj_71_50ms::SigU3T71_id;
   Msg_U3T_Obj_71_50ms.U3T71_length.phys = @sysvar::MsgU3T_Obj_71_50ms::SigU3T71_length;
   Msg_U3T_Obj_71_50ms.U3T71_RLcorner_lat.phys = @sysvar::MsgU3T_Obj_71_50ms::SigU3T71_RLcorner_lat;
   Msg_U3T_Obj_71_50ms.U3T71_RLcorner_long.phys = @sysvar::MsgU3T_Obj_71_50ms::SigU3T71_RLcorner_long;
   Msg_U3T_Obj_71_50ms.U3T71_RRcorner_lat.phys = @sysvar::MsgU3T_Obj_71_50ms::SigU3T71_RRcorner_lat;
   Msg_U3T_Obj_71_50ms.U3T71_RRcorner_long.phys = @sysvar::MsgU3T_Obj_71_50ms::SigU3T71_RRcorner_long;
   Msg_U3T_Obj_71_50ms.U3T71_speed.phys = @sysvar::MsgU3T_Obj_71_50ms::SigU3T71_speed;
   Msg_U3T_Obj_71_50ms.U3T71_width.phys = @sysvar::MsgU3T_Obj_71_50ms::SigU3T71_width;
   Msg_U3T_Obj_71_50ms.U3T71_fusion_source.phys = @sysvar::MsgU3T_Obj_71_50ms::SigU3T71_fusion_source;
   Msg_U3T_Obj_71_50ms.U3T71_vcs_heading.phys = @sysvar::MsgU3T_Obj_71_50ms::SigU3T71_vcs_heading;
   Msg_U3T_Obj_71_50ms.U3T71_vcs_lat_accel.phys = @sysvar::MsgU3T_Obj_71_50ms::SigU3T71_vcs_lat_accel;
   Msg_U3T_Obj_71_50ms.U3T71_vcs_lat_posn.phys = @sysvar::MsgU3T_Obj_71_50ms::SigU3T71_vcs_lat_posn;
   Msg_U3T_Obj_71_50ms.U3T71_vcs_lat_vel.phys = @sysvar::MsgU3T_Obj_71_50ms::SigU3T71_vcs_lat_vel;
   Msg_U3T_Obj_71_50ms.U3T71_vcs_long_accel.phys = @sysvar::MsgU3T_Obj_71_50ms::SigU3T71_vcs_long_accel;
   Msg_U3T_Obj_71_50ms.U3T71_vcs_long_posn.phys = @sysvar::MsgU3T_Obj_71_50ms::SigU3T71_vcs_long_posn;
   Msg_U3T_Obj_71_50ms.U3T71_vcs_long_vel.phys = @sysvar::MsgU3T_Obj_71_50ms::SigU3T71_vcs_long_vel;
   Msg_U3T_Obj_71_50ms.U3T71_conf_overall.phys = @sysvar::MsgU3T_Obj_71_50ms::SigU3T71_conf_overall;
   Msg_U3T_Obj_71_50ms.U3T71_f_oncoming.phys = @sysvar::MsgU3T_Obj_71_50ms::SigU3T71_f_oncoming;
   Msg_U3T_Obj_71_50ms.U3T71_f_receding.phys = @sysvar::MsgU3T_Obj_71_50ms::SigU3T71_f_receding;
   output(Msg_U3T_Obj_71_50ms);
   Msg_U3T_Obj_62_50ms.U3T62_age.phys = @sysvar::MsgU3T_Obj_62_50ms::SigU3T62_age;
   Msg_U3T_Obj_62_50ms.U3T62_f_moveable.phys = @sysvar::MsgU3T_Obj_62_50ms::SigU3T62_f_moveable;
   Msg_U3T_Obj_62_50ms.U3T62_f_stationary.phys = @sysvar::MsgU3T_Obj_62_50ms::SigU3T62_f_stationary;
   Msg_U3T_Obj_62_50ms.U3T62_FLcorner_lat.phys = @sysvar::MsgU3T_Obj_62_50ms::SigU3T62_FLcorner_lat;
   Msg_U3T_Obj_62_50ms.U3T62_object_class.phys = @sysvar::MsgU3T_Obj_62_50ms::SigU3T62_object_class;
   Msg_U3T_Obj_62_50ms.U3T62_FLcorner_long.phys = @sysvar::MsgU3T_Obj_62_50ms::SigU3T62_FLcorner_long;
   Msg_U3T_Obj_62_50ms.U3T62_status.phys = @sysvar::MsgU3T_Obj_62_50ms::SigU3T62_status;
   Msg_U3T_Obj_62_50ms.U3T62_FRcorner_lat.phys = @sysvar::MsgU3T_Obj_62_50ms::SigU3T62_FRcorner_lat;
   Msg_U3T_Obj_62_50ms.U3T62_FRcorner_long.phys = @sysvar::MsgU3T_Obj_62_50ms::SigU3T62_FRcorner_long;
   Msg_U3T_Obj_62_50ms.U3T62_heading_rate.phys = @sysvar::MsgU3T_Obj_62_50ms::SigU3T62_heading_rate;
   Msg_U3T_Obj_62_50ms.U3T62_id.phys = @sysvar::MsgU3T_Obj_62_50ms::SigU3T62_id;
   Msg_U3T_Obj_62_50ms.U3T62_length.phys = @sysvar::MsgU3T_Obj_62_50ms::SigU3T62_length;
   Msg_U3T_Obj_62_50ms.U3T62_RLcorner_lat.phys = @sysvar::MsgU3T_Obj_62_50ms::SigU3T62_RLcorner_lat;
   Msg_U3T_Obj_62_50ms.U3T62_RLcorner_long.phys = @sysvar::MsgU3T_Obj_62_50ms::SigU3T62_RLcorner_long;
   Msg_U3T_Obj_62_50ms.U3T62_RRcorner_lat.phys = @sysvar::MsgU3T_Obj_62_50ms::SigU3T62_RRcorner_lat;
   Msg_U3T_Obj_62_50ms.U3T62_RRcorner_long.phys = @sysvar::MsgU3T_Obj_62_50ms::SigU3T62_RRcorner_long;
   Msg_U3T_Obj_62_50ms.U3T62_speed.phys = @sysvar::MsgU3T_Obj_62_50ms::SigU3T62_speed;
   Msg_U3T_Obj_62_50ms.U3T62_width.phys = @sysvar::MsgU3T_Obj_62_50ms::SigU3T62_width;
   Msg_U3T_Obj_62_50ms.U3T62_fusion_source.phys = @sysvar::MsgU3T_Obj_62_50ms::SigU3T62_fusion_source;
   Msg_U3T_Obj_62_50ms.U3T62_vcs_heading.phys = @sysvar::MsgU3T_Obj_62_50ms::SigU3T62_vcs_heading;
   Msg_U3T_Obj_62_50ms.U3T62_vcs_lat_accel.phys = @sysvar::MsgU3T_Obj_62_50ms::SigU3T62_vcs_lat_accel;
   Msg_U3T_Obj_62_50ms.U3T62_vcs_lat_posn.phys = @sysvar::MsgU3T_Obj_62_50ms::SigU3T62_vcs_lat_posn;
   Msg_U3T_Obj_62_50ms.U3T62_vcs_lat_vel.phys = @sysvar::MsgU3T_Obj_62_50ms::SigU3T62_vcs_lat_vel;
   Msg_U3T_Obj_62_50ms.U3T62_vcs_long_accel.phys = @sysvar::MsgU3T_Obj_62_50ms::SigU3T62_vcs_long_accel;
   Msg_U3T_Obj_62_50ms.U3T62_vcs_long_posn.phys = @sysvar::MsgU3T_Obj_62_50ms::SigU3T62_vcs_long_posn;
   Msg_U3T_Obj_62_50ms.U3T62_vcs_long_vel.phys = @sysvar::MsgU3T_Obj_62_50ms::SigU3T62_vcs_long_vel;
   Msg_U3T_Obj_62_50ms.U3T62_conf_overall.phys = @sysvar::MsgU3T_Obj_62_50ms::SigU3T62_conf_overall;
   Msg_U3T_Obj_62_50ms.U3T62_f_oncoming.phys = @sysvar::MsgU3T_Obj_62_50ms::SigU3T62_f_oncoming;
   Msg_U3T_Obj_62_50ms.U3T62_f_receding.phys = @sysvar::MsgU3T_Obj_62_50ms::SigU3T62_f_receding;
   output(Msg_U3T_Obj_62_50ms);
   Msg_U3T_Obj_70_50ms.U3T70_age.phys = @sysvar::MsgU3T_Obj_70_50ms::SigU3T70_age;
   Msg_U3T_Obj_70_50ms.U3T70_f_moveable.phys = @sysvar::MsgU3T_Obj_70_50ms::SigU3T70_f_moveable;
   Msg_U3T_Obj_70_50ms.U3T70_f_stationary.phys = @sysvar::MsgU3T_Obj_70_50ms::SigU3T70_f_stationary;
   Msg_U3T_Obj_70_50ms.U3T70_FLcorner_lat.phys = @sysvar::MsgU3T_Obj_70_50ms::SigU3T70_FLcorner_lat;
   Msg_U3T_Obj_70_50ms.U3T70_object_class.phys = @sysvar::MsgU3T_Obj_70_50ms::SigU3T70_object_class;
   Msg_U3T_Obj_70_50ms.U3T70_FLcorner_long.phys = @sysvar::MsgU3T_Obj_70_50ms::SigU3T70_FLcorner_long;
   Msg_U3T_Obj_70_50ms.U3T70_status.phys = @sysvar::MsgU3T_Obj_70_50ms::SigU3T70_status;
   Msg_U3T_Obj_70_50ms.U3T70_FRcorner_lat.phys = @sysvar::MsgU3T_Obj_70_50ms::SigU3T70_FRcorner_lat;
   Msg_U3T_Obj_70_50ms.U3T70_FRcorner_long.phys = @sysvar::MsgU3T_Obj_70_50ms::SigU3T70_FRcorner_long;
   Msg_U3T_Obj_70_50ms.U3T70_heading_rate.phys = @sysvar::MsgU3T_Obj_70_50ms::SigU3T70_heading_rate;
   Msg_U3T_Obj_70_50ms.U3T70_id.phys = @sysvar::MsgU3T_Obj_70_50ms::SigU3T70_id;
   Msg_U3T_Obj_70_50ms.U3T70_length.phys = @sysvar::MsgU3T_Obj_70_50ms::SigU3T70_length;
   Msg_U3T_Obj_70_50ms.U3T70_RLcorner_lat.phys = @sysvar::MsgU3T_Obj_70_50ms::SigU3T70_RLcorner_lat;
   Msg_U3T_Obj_70_50ms.U3T70_RLcorner_long.phys = @sysvar::MsgU3T_Obj_70_50ms::SigU3T70_RLcorner_long;
   Msg_U3T_Obj_70_50ms.U3T70_RRcorner_lat.phys = @sysvar::MsgU3T_Obj_70_50ms::SigU3T70_RRcorner_lat;
   Msg_U3T_Obj_70_50ms.U3T70_RRcorner_long.phys = @sysvar::MsgU3T_Obj_70_50ms::SigU3T70_RRcorner_long;
   Msg_U3T_Obj_70_50ms.U3T70_speed.phys = @sysvar::MsgU3T_Obj_70_50ms::SigU3T70_speed;
   Msg_U3T_Obj_70_50ms.U3T70_width.phys = @sysvar::MsgU3T_Obj_70_50ms::SigU3T70_width;
   Msg_U3T_Obj_70_50ms.U3T70_fusion_source.phys = @sysvar::MsgU3T_Obj_70_50ms::SigU3T70_fusion_source;
   Msg_U3T_Obj_70_50ms.U3T70_vcs_heading.phys = @sysvar::MsgU3T_Obj_70_50ms::SigU3T70_vcs_heading;
   Msg_U3T_Obj_70_50ms.U3T70_vcs_lat_accel.phys = @sysvar::MsgU3T_Obj_70_50ms::SigU3T70_vcs_lat_accel;
   Msg_U3T_Obj_70_50ms.U3T70_vcs_lat_posn.phys = @sysvar::MsgU3T_Obj_70_50ms::SigU3T70_vcs_lat_posn;
   Msg_U3T_Obj_70_50ms.U3T70_vcs_lat_vel.phys = @sysvar::MsgU3T_Obj_70_50ms::SigU3T70_vcs_lat_vel;
   Msg_U3T_Obj_70_50ms.U3T70_vcs_long_accel.phys = @sysvar::MsgU3T_Obj_70_50ms::SigU3T70_vcs_long_accel;
   Msg_U3T_Obj_70_50ms.U3T70_vcs_long_posn.phys = @sysvar::MsgU3T_Obj_70_50ms::SigU3T70_vcs_long_posn;
   Msg_U3T_Obj_70_50ms.U3T70_vcs_long_vel.phys = @sysvar::MsgU3T_Obj_70_50ms::SigU3T70_vcs_long_vel;
   Msg_U3T_Obj_70_50ms.U3T70_conf_overall.phys = @sysvar::MsgU3T_Obj_70_50ms::SigU3T70_conf_overall;
   Msg_U3T_Obj_70_50ms.U3T70_f_oncoming.phys = @sysvar::MsgU3T_Obj_70_50ms::SigU3T70_f_oncoming;
   Msg_U3T_Obj_70_50ms.U3T70_f_receding.phys = @sysvar::MsgU3T_Obj_70_50ms::SigU3T70_f_receding;
   output(Msg_U3T_Obj_70_50ms);
   Msg_U3T_Obj_69_50ms.U3T69_age.phys = @sysvar::MsgU3T_Obj_69_50ms::SigU3T69_age;
   Msg_U3T_Obj_69_50ms.U3T69_f_moveable.phys = @sysvar::MsgU3T_Obj_69_50ms::SigU3T69_f_moveable;
   Msg_U3T_Obj_69_50ms.U3T69_f_stationary.phys = @sysvar::MsgU3T_Obj_69_50ms::SigU3T69_f_stationary;
   Msg_U3T_Obj_69_50ms.U3T69_FLcorner_lat.phys = @sysvar::MsgU3T_Obj_69_50ms::SigU3T69_FLcorner_lat;
   Msg_U3T_Obj_69_50ms.U3T69_object_class.phys = @sysvar::MsgU3T_Obj_69_50ms::SigU3T69_object_class;
   Msg_U3T_Obj_69_50ms.U3T69_FLcorner_long.phys = @sysvar::MsgU3T_Obj_69_50ms::SigU3T69_FLcorner_long;
   Msg_U3T_Obj_69_50ms.U3T69_status.phys = @sysvar::MsgU3T_Obj_69_50ms::SigU3T69_status;
   Msg_U3T_Obj_69_50ms.U3T69_FRcorner_lat.phys = @sysvar::MsgU3T_Obj_69_50ms::SigU3T69_FRcorner_lat;
   Msg_U3T_Obj_69_50ms.U3T69_FRcorner_long.phys = @sysvar::MsgU3T_Obj_69_50ms::SigU3T69_FRcorner_long;
   Msg_U3T_Obj_69_50ms.U3T69_heading_rate.phys = @sysvar::MsgU3T_Obj_69_50ms::SigU3T69_heading_rate;
   Msg_U3T_Obj_69_50ms.U3T69_id.phys = @sysvar::MsgU3T_Obj_69_50ms::SigU3T69_id;
   Msg_U3T_Obj_69_50ms.U3T69_length.phys = @sysvar::MsgU3T_Obj_69_50ms::SigU3T69_length;
   Msg_U3T_Obj_69_50ms.U3T69_RLcorner_lat.phys = @sysvar::MsgU3T_Obj_69_50ms::SigU3T69_RLcorner_lat;
   Msg_U3T_Obj_69_50ms.U3T69_RLcorner_long.phys = @sysvar::MsgU3T_Obj_69_50ms::SigU3T69_RLcorner_long;
   Msg_U3T_Obj_69_50ms.U3T69_RRcorner_lat.phys = @sysvar::MsgU3T_Obj_69_50ms::SigU3T69_RRcorner_lat;
   Msg_U3T_Obj_69_50ms.U3T69_RRcorner_long.phys = @sysvar::MsgU3T_Obj_69_50ms::SigU3T69_RRcorner_long;
   Msg_U3T_Obj_69_50ms.U3T69_speed.phys = @sysvar::MsgU3T_Obj_69_50ms::SigU3T69_speed;
   Msg_U3T_Obj_69_50ms.U3T69_width.phys = @sysvar::MsgU3T_Obj_69_50ms::SigU3T69_width;
   Msg_U3T_Obj_69_50ms.U3T69_fusion_source.phys = @sysvar::MsgU3T_Obj_69_50ms::SigU3T69_fusion_source;
   Msg_U3T_Obj_69_50ms.U3T69_vcs_heading.phys = @sysvar::MsgU3T_Obj_69_50ms::SigU3T69_vcs_heading;
   Msg_U3T_Obj_69_50ms.U3T69_vcs_lat_accel.phys = @sysvar::MsgU3T_Obj_69_50ms::SigU3T69_vcs_lat_accel;
   Msg_U3T_Obj_69_50ms.U3T69_vcs_lat_posn.phys = @sysvar::MsgU3T_Obj_69_50ms::SigU3T69_vcs_lat_posn;
   Msg_U3T_Obj_69_50ms.U3T69_vcs_lat_vel.phys = @sysvar::MsgU3T_Obj_69_50ms::SigU3T69_vcs_lat_vel;
   Msg_U3T_Obj_69_50ms.U3T69_vcs_long_accel.phys = @sysvar::MsgU3T_Obj_69_50ms::SigU3T69_vcs_long_accel;
   Msg_U3T_Obj_69_50ms.U3T69_vcs_long_posn.phys = @sysvar::MsgU3T_Obj_69_50ms::SigU3T69_vcs_long_posn;
   Msg_U3T_Obj_69_50ms.U3T69_vcs_long_vel.phys = @sysvar::MsgU3T_Obj_69_50ms::SigU3T69_vcs_long_vel;
   Msg_U3T_Obj_69_50ms.U3T69_conf_overall.phys = @sysvar::MsgU3T_Obj_69_50ms::SigU3T69_conf_overall;
   Msg_U3T_Obj_69_50ms.U3T69_f_oncoming.phys = @sysvar::MsgU3T_Obj_69_50ms::SigU3T69_f_oncoming;
   Msg_U3T_Obj_69_50ms.U3T69_f_receding.phys = @sysvar::MsgU3T_Obj_69_50ms::SigU3T69_f_receding;
   output(Msg_U3T_Obj_69_50ms);
   Msg_U3T_Obj_68_50ms.U3T68_age.phys = @sysvar::MsgU3T_Obj_68_50ms::SigU3T68_age;
   Msg_U3T_Obj_68_50ms.U3T68_f_moveable.phys = @sysvar::MsgU3T_Obj_68_50ms::SigU3T68_f_moveable;
   Msg_U3T_Obj_68_50ms.U3T68_f_stationary.phys = @sysvar::MsgU3T_Obj_68_50ms::SigU3T68_f_stationary;
   Msg_U3T_Obj_68_50ms.U3T68_FLcorner_lat.phys = @sysvar::MsgU3T_Obj_68_50ms::SigU3T68_FLcorner_lat;
   Msg_U3T_Obj_68_50ms.U3T68_object_class.phys = @sysvar::MsgU3T_Obj_68_50ms::SigU3T68_object_class;
   Msg_U3T_Obj_68_50ms.U3T68_FLcorner_long.phys = @sysvar::MsgU3T_Obj_68_50ms::SigU3T68_FLcorner_long;
   Msg_U3T_Obj_68_50ms.U3T68_status.phys = @sysvar::MsgU3T_Obj_68_50ms::SigU3T68_status;
   Msg_U3T_Obj_68_50ms.U3T68_FRcorner_lat.phys = @sysvar::MsgU3T_Obj_68_50ms::SigU3T68_FRcorner_lat;
   Msg_U3T_Obj_68_50ms.U3T68_FRcorner_long.phys = @sysvar::MsgU3T_Obj_68_50ms::SigU3T68_FRcorner_long;
   Msg_U3T_Obj_68_50ms.U3T68_heading_rate.phys = @sysvar::MsgU3T_Obj_68_50ms::SigU3T68_heading_rate;
   Msg_U3T_Obj_68_50ms.U3T68_id.phys = @sysvar::MsgU3T_Obj_68_50ms::SigU3T68_id;
   Msg_U3T_Obj_68_50ms.U3T68_length.phys = @sysvar::MsgU3T_Obj_68_50ms::SigU3T68_length;
   Msg_U3T_Obj_68_50ms.U3T68_RLcorner_lat.phys = @sysvar::MsgU3T_Obj_68_50ms::SigU3T68_RLcorner_lat;
   Msg_U3T_Obj_68_50ms.U3T68_RLcorner_long.phys = @sysvar::MsgU3T_Obj_68_50ms::SigU3T68_RLcorner_long;
   Msg_U3T_Obj_68_50ms.U3T68_RRcorner_lat.phys = @sysvar::MsgU3T_Obj_68_50ms::SigU3T68_RRcorner_lat;
   Msg_U3T_Obj_68_50ms.U3T68_RRcorner_long.phys = @sysvar::MsgU3T_Obj_68_50ms::SigU3T68_RRcorner_long;
   Msg_U3T_Obj_68_50ms.U3T68_speed.phys = @sysvar::MsgU3T_Obj_68_50ms::SigU3T68_speed;
   Msg_U3T_Obj_68_50ms.U3T68_width.phys = @sysvar::MsgU3T_Obj_68_50ms::SigU3T68_width;
   Msg_U3T_Obj_68_50ms.U3T68_fusion_source.phys = @sysvar::MsgU3T_Obj_68_50ms::SigU3T68_fusion_source;
   Msg_U3T_Obj_68_50ms.U3T68_vcs_heading.phys = @sysvar::MsgU3T_Obj_68_50ms::SigU3T68_vcs_heading;
   Msg_U3T_Obj_68_50ms.U3T68_vcs_lat_accel.phys = @sysvar::MsgU3T_Obj_68_50ms::SigU3T68_vcs_lat_accel;
   Msg_U3T_Obj_68_50ms.U3T68_vcs_lat_posn.phys = @sysvar::MsgU3T_Obj_68_50ms::SigU3T68_vcs_lat_posn;
   Msg_U3T_Obj_68_50ms.U3T68_vcs_lat_vel.phys = @sysvar::MsgU3T_Obj_68_50ms::SigU3T68_vcs_lat_vel;
   Msg_U3T_Obj_68_50ms.U3T68_vcs_long_accel.phys = @sysvar::MsgU3T_Obj_68_50ms::SigU3T68_vcs_long_accel;
   Msg_U3T_Obj_68_50ms.U3T68_vcs_long_posn.phys = @sysvar::MsgU3T_Obj_68_50ms::SigU3T68_vcs_long_posn;
   Msg_U3T_Obj_68_50ms.U3T68_vcs_long_vel.phys = @sysvar::MsgU3T_Obj_68_50ms::SigU3T68_vcs_long_vel;
   Msg_U3T_Obj_68_50ms.U3T68_conf_overall.phys = @sysvar::MsgU3T_Obj_68_50ms::SigU3T68_conf_overall;
   Msg_U3T_Obj_68_50ms.U3T68_f_oncoming.phys = @sysvar::MsgU3T_Obj_68_50ms::SigU3T68_f_oncoming;
   Msg_U3T_Obj_68_50ms.U3T68_f_receding.phys = @sysvar::MsgU3T_Obj_68_50ms::SigU3T68_f_receding;
   output(Msg_U3T_Obj_68_50ms);
   Msg_U3T_Obj_67_50ms.U3T67_age.phys = @sysvar::MsgU3T_Obj_67_50ms::SigU3T67_age;
   Msg_U3T_Obj_67_50ms.U3T67_f_moveable.phys = @sysvar::MsgU3T_Obj_67_50ms::SigU3T67_f_moveable;
   Msg_U3T_Obj_67_50ms.U3T67_f_stationary.phys = @sysvar::MsgU3T_Obj_67_50ms::SigU3T67_f_stationary;
   Msg_U3T_Obj_67_50ms.U3T67_FLcorner_lat.phys = @sysvar::MsgU3T_Obj_67_50ms::SigU3T67_FLcorner_lat;
   Msg_U3T_Obj_67_50ms.U3T67_object_class.phys = @sysvar::MsgU3T_Obj_67_50ms::SigU3T67_object_class;
   Msg_U3T_Obj_67_50ms.U3T67_FLcorner_long.phys = @sysvar::MsgU3T_Obj_67_50ms::SigU3T67_FLcorner_long;
   Msg_U3T_Obj_67_50ms.U3T67_status.phys = @sysvar::MsgU3T_Obj_67_50ms::SigU3T67_status;
   Msg_U3T_Obj_67_50ms.U3T67_FRcorner_lat.phys = @sysvar::MsgU3T_Obj_67_50ms::SigU3T67_FRcorner_lat;
   Msg_U3T_Obj_67_50ms.U3T67_FRcorner_long.phys = @sysvar::MsgU3T_Obj_67_50ms::SigU3T67_FRcorner_long;
   Msg_U3T_Obj_67_50ms.U3T67_heading_rate.phys = @sysvar::MsgU3T_Obj_67_50ms::SigU3T67_heading_rate;
   Msg_U3T_Obj_67_50ms.U3T67_id.phys = @sysvar::MsgU3T_Obj_67_50ms::SigU3T67_id;
   Msg_U3T_Obj_67_50ms.U3T67_length.phys = @sysvar::MsgU3T_Obj_67_50ms::SigU3T67_length;
   Msg_U3T_Obj_67_50ms.U3T67_RLcorner_lat.phys = @sysvar::MsgU3T_Obj_67_50ms::SigU3T67_RLcorner_lat;
   Msg_U3T_Obj_67_50ms.U3T67_RLcorner_long.phys = @sysvar::MsgU3T_Obj_67_50ms::SigU3T67_RLcorner_long;
   Msg_U3T_Obj_67_50ms.U3T67_RRcorner_lat.phys = @sysvar::MsgU3T_Obj_67_50ms::SigU3T67_RRcorner_lat;
   Msg_U3T_Obj_67_50ms.U3T67_RRcorner_long.phys = @sysvar::MsgU3T_Obj_67_50ms::SigU3T67_RRcorner_long;
   Msg_U3T_Obj_67_50ms.U3T67_speed.phys = @sysvar::MsgU3T_Obj_67_50ms::SigU3T67_speed;
   Msg_U3T_Obj_67_50ms.U3T67_width.phys = @sysvar::MsgU3T_Obj_67_50ms::SigU3T67_width;
   Msg_U3T_Obj_67_50ms.U3T67_fusion_source.phys = @sysvar::MsgU3T_Obj_67_50ms::SigU3T67_fusion_source;
   Msg_U3T_Obj_67_50ms.U3T67_vcs_heading.phys = @sysvar::MsgU3T_Obj_67_50ms::SigU3T67_vcs_heading;
   Msg_U3T_Obj_67_50ms.U3T67_vcs_lat_accel.phys = @sysvar::MsgU3T_Obj_67_50ms::SigU3T67_vcs_lat_accel;
   Msg_U3T_Obj_67_50ms.U3T67_vcs_lat_posn.phys = @sysvar::MsgU3T_Obj_67_50ms::SigU3T67_vcs_lat_posn;
   Msg_U3T_Obj_67_50ms.U3T67_vcs_lat_vel.phys = @sysvar::MsgU3T_Obj_67_50ms::SigU3T67_vcs_lat_vel;
   Msg_U3T_Obj_67_50ms.U3T67_vcs_long_accel.phys = @sysvar::MsgU3T_Obj_67_50ms::SigU3T67_vcs_long_accel;
   Msg_U3T_Obj_67_50ms.U3T67_vcs_long_posn.phys = @sysvar::MsgU3T_Obj_67_50ms::SigU3T67_vcs_long_posn;
   Msg_U3T_Obj_67_50ms.U3T67_vcs_long_vel.phys = @sysvar::MsgU3T_Obj_67_50ms::SigU3T67_vcs_long_vel;
   Msg_U3T_Obj_67_50ms.U3T67_conf_overall.phys = @sysvar::MsgU3T_Obj_67_50ms::SigU3T67_conf_overall;
   Msg_U3T_Obj_67_50ms.U3T67_f_oncoming.phys = @sysvar::MsgU3T_Obj_67_50ms::SigU3T67_f_oncoming;
   Msg_U3T_Obj_67_50ms.U3T67_f_receding.phys = @sysvar::MsgU3T_Obj_67_50ms::SigU3T67_f_receding;
   output(Msg_U3T_Obj_67_50ms);
   Msg_U3T_Obj_66_50ms.U3T66_age.phys = @sysvar::MsgU3T_Obj_66_50ms::SigU3T66_age;
   Msg_U3T_Obj_66_50ms.U3T66_f_moveable.phys = @sysvar::MsgU3T_Obj_66_50ms::SigU3T66_f_moveable;
   Msg_U3T_Obj_66_50ms.U3T66_f_stationary.phys = @sysvar::MsgU3T_Obj_66_50ms::SigU3T66_f_stationary;
   Msg_U3T_Obj_66_50ms.U3T66_FLcorner_lat.phys = @sysvar::MsgU3T_Obj_66_50ms::SigU3T66_FLcorner_lat;
   Msg_U3T_Obj_66_50ms.U3T66_object_class.phys = @sysvar::MsgU3T_Obj_66_50ms::SigU3T66_object_class;
   Msg_U3T_Obj_66_50ms.U3T66_FLcorner_long.phys = @sysvar::MsgU3T_Obj_66_50ms::SigU3T66_FLcorner_long;
   Msg_U3T_Obj_66_50ms.U3T66_status.phys = @sysvar::MsgU3T_Obj_66_50ms::SigU3T66_status;
   Msg_U3T_Obj_66_50ms.U3T66_FRcorner_lat.phys = @sysvar::MsgU3T_Obj_66_50ms::SigU3T66_FRcorner_lat;
   Msg_U3T_Obj_66_50ms.U3T66_FRcorner_long.phys = @sysvar::MsgU3T_Obj_66_50ms::SigU3T66_FRcorner_long;
   Msg_U3T_Obj_66_50ms.U3T66_heading_rate.phys = @sysvar::MsgU3T_Obj_66_50ms::SigU3T66_heading_rate;
   Msg_U3T_Obj_66_50ms.U3T66_id.phys = @sysvar::MsgU3T_Obj_66_50ms::SigU3T66_id;
   Msg_U3T_Obj_66_50ms.U3T66_length.phys = @sysvar::MsgU3T_Obj_66_50ms::SigU3T66_length;
   Msg_U3T_Obj_66_50ms.U3T66_RLcorner_lat.phys = @sysvar::MsgU3T_Obj_66_50ms::SigU3T66_RLcorner_lat;
   Msg_U3T_Obj_66_50ms.U3T66_RLcorner_long.phys = @sysvar::MsgU3T_Obj_66_50ms::SigU3T66_RLcorner_long;
   Msg_U3T_Obj_66_50ms.U3T66_RRcorner_lat.phys = @sysvar::MsgU3T_Obj_66_50ms::SigU3T66_RRcorner_lat;
   Msg_U3T_Obj_66_50ms.U3T66_RRcorner_long.phys = @sysvar::MsgU3T_Obj_66_50ms::SigU3T66_RRcorner_long;
   Msg_U3T_Obj_66_50ms.U3T66_speed.phys = @sysvar::MsgU3T_Obj_66_50ms::SigU3T66_speed;
   Msg_U3T_Obj_66_50ms.U3T66_width.phys = @sysvar::MsgU3T_Obj_66_50ms::SigU3T66_width;
   Msg_U3T_Obj_66_50ms.U3T66_fusion_source.phys = @sysvar::MsgU3T_Obj_66_50ms::SigU3T66_fusion_source;
   Msg_U3T_Obj_66_50ms.U3T66_vcs_heading.phys = @sysvar::MsgU3T_Obj_66_50ms::SigU3T66_vcs_heading;
   Msg_U3T_Obj_66_50ms.U3T66_vcs_lat_accel.phys = @sysvar::MsgU3T_Obj_66_50ms::SigU3T66_vcs_lat_accel;
   Msg_U3T_Obj_66_50ms.U3T66_vcs_lat_posn.phys = @sysvar::MsgU3T_Obj_66_50ms::SigU3T66_vcs_lat_posn;
   Msg_U3T_Obj_66_50ms.U3T66_vcs_lat_vel.phys = @sysvar::MsgU3T_Obj_66_50ms::SigU3T66_vcs_lat_vel;
   Msg_U3T_Obj_66_50ms.U3T66_vcs_long_accel.phys = @sysvar::MsgU3T_Obj_66_50ms::SigU3T66_vcs_long_accel;
   Msg_U3T_Obj_66_50ms.U3T66_vcs_long_posn.phys = @sysvar::MsgU3T_Obj_66_50ms::SigU3T66_vcs_long_posn;
   Msg_U3T_Obj_66_50ms.U3T66_vcs_long_vel.phys = @sysvar::MsgU3T_Obj_66_50ms::SigU3T66_vcs_long_vel;
   Msg_U3T_Obj_66_50ms.U3T66_conf_overall.phys = @sysvar::MsgU3T_Obj_66_50ms::SigU3T66_conf_overall;
   Msg_U3T_Obj_66_50ms.U3T66_f_oncoming.phys = @sysvar::MsgU3T_Obj_66_50ms::SigU3T66_f_oncoming;
   Msg_U3T_Obj_66_50ms.U3T66_f_receding.phys = @sysvar::MsgU3T_Obj_66_50ms::SigU3T66_f_receding;
   output(Msg_U3T_Obj_66_50ms);
   Msg_U3T_Obj_65_50ms.U3T65_age.phys = @sysvar::MsgU3T_Obj_65_50ms::SigU3T65_age;
   Msg_U3T_Obj_65_50ms.U3T65_f_moveable.phys = @sysvar::MsgU3T_Obj_65_50ms::SigU3T65_f_moveable;
   Msg_U3T_Obj_65_50ms.U3T65_f_stationary.phys = @sysvar::MsgU3T_Obj_65_50ms::SigU3T65_f_stationary;
   Msg_U3T_Obj_65_50ms.U3T65_FLcorner_lat.phys = @sysvar::MsgU3T_Obj_65_50ms::SigU3T65_FLcorner_lat;
   Msg_U3T_Obj_65_50ms.U3T65_object_class.phys = @sysvar::MsgU3T_Obj_65_50ms::SigU3T65_object_class;
   Msg_U3T_Obj_65_50ms.U3T65_FLcorner_long.phys = @sysvar::MsgU3T_Obj_65_50ms::SigU3T65_FLcorner_long;
   Msg_U3T_Obj_65_50ms.U3T65_status.phys = @sysvar::MsgU3T_Obj_65_50ms::SigU3T65_status;
   Msg_U3T_Obj_65_50ms.U3T65_FRcorner_lat.phys = @sysvar::MsgU3T_Obj_65_50ms::SigU3T65_FRcorner_lat;
   Msg_U3T_Obj_65_50ms.U3T65_FRcorner_long.phys = @sysvar::MsgU3T_Obj_65_50ms::SigU3T65_FRcorner_long;
   Msg_U3T_Obj_65_50ms.U3T65_heading_rate.phys = @sysvar::MsgU3T_Obj_65_50ms::SigU3T65_heading_rate;
   Msg_U3T_Obj_65_50ms.U3T65_id.phys = @sysvar::MsgU3T_Obj_65_50ms::SigU3T65_id;
   Msg_U3T_Obj_65_50ms.U3T65_length.phys = @sysvar::MsgU3T_Obj_65_50ms::SigU3T65_length;
   Msg_U3T_Obj_65_50ms.U3T65_RLcorner_lat.phys = @sysvar::MsgU3T_Obj_65_50ms::SigU3T65_RLcorner_lat;
   Msg_U3T_Obj_65_50ms.U3T65_RLcorner_long.phys = @sysvar::MsgU3T_Obj_65_50ms::SigU3T65_RLcorner_long;
   Msg_U3T_Obj_65_50ms.U3T65_RRcorner_lat.phys = @sysvar::MsgU3T_Obj_65_50ms::SigU3T65_RRcorner_lat;
   Msg_U3T_Obj_65_50ms.U3T65_RRcorner_long.phys = @sysvar::MsgU3T_Obj_65_50ms::SigU3T65_RRcorner_long;
   Msg_U3T_Obj_65_50ms.U3T65_speed.phys = @sysvar::MsgU3T_Obj_65_50ms::SigU3T65_speed;
   Msg_U3T_Obj_65_50ms.U3T65_width.phys = @sysvar::MsgU3T_Obj_65_50ms::SigU3T65_width;
   Msg_U3T_Obj_65_50ms.U3T65_fusion_source.phys = @sysvar::MsgU3T_Obj_65_50ms::SigU3T65_fusion_source;
   Msg_U3T_Obj_65_50ms.U3T65_vcs_heading.phys = @sysvar::MsgU3T_Obj_65_50ms::SigU3T65_vcs_heading;
   Msg_U3T_Obj_65_50ms.U3T65_vcs_lat_accel.phys = @sysvar::MsgU3T_Obj_65_50ms::SigU3T65_vcs_lat_accel;
   Msg_U3T_Obj_65_50ms.U3T65_vcs_lat_posn.phys = @sysvar::MsgU3T_Obj_65_50ms::SigU3T65_vcs_lat_posn;
   Msg_U3T_Obj_65_50ms.U3T65_vcs_lat_vel.phys = @sysvar::MsgU3T_Obj_65_50ms::SigU3T65_vcs_lat_vel;
   Msg_U3T_Obj_65_50ms.U3T65_vcs_long_accel.phys = @sysvar::MsgU3T_Obj_65_50ms::SigU3T65_vcs_long_accel;
   Msg_U3T_Obj_65_50ms.U3T65_vcs_long_posn.phys = @sysvar::MsgU3T_Obj_65_50ms::SigU3T65_vcs_long_posn;
   Msg_U3T_Obj_65_50ms.U3T65_vcs_long_vel.phys = @sysvar::MsgU3T_Obj_65_50ms::SigU3T65_vcs_long_vel;
   Msg_U3T_Obj_65_50ms.U3T65_conf_overall.phys = @sysvar::MsgU3T_Obj_65_50ms::SigU3T65_conf_overall;
   Msg_U3T_Obj_65_50ms.U3T65_f_oncoming.phys = @sysvar::MsgU3T_Obj_65_50ms::SigU3T65_f_oncoming;
   Msg_U3T_Obj_65_50ms.U3T65_f_receding.phys = @sysvar::MsgU3T_Obj_65_50ms::SigU3T65_f_receding;
   output(Msg_U3T_Obj_65_50ms);
   Msg_U3T_Obj_64_50ms.U3T64_age.phys = @sysvar::MsgU3T_Obj_64_50ms::SigU3T64_age;
   Msg_U3T_Obj_64_50ms.U3T64_f_moveable.phys = @sysvar::MsgU3T_Obj_64_50ms::SigU3T64_f_moveable;
   Msg_U3T_Obj_64_50ms.U3T64_f_stationary.phys = @sysvar::MsgU3T_Obj_64_50ms::SigU3T64_f_stationary;
   Msg_U3T_Obj_64_50ms.U3T64_FLcorner_lat.phys = @sysvar::MsgU3T_Obj_64_50ms::SigU3T64_FLcorner_lat;
   Msg_U3T_Obj_64_50ms.U3T64_object_class.phys = @sysvar::MsgU3T_Obj_64_50ms::SigU3T64_object_class;
   Msg_U3T_Obj_64_50ms.U3T64_FLcorner_long.phys = @sysvar::MsgU3T_Obj_64_50ms::SigU3T64_FLcorner_long;
   Msg_U3T_Obj_64_50ms.U3T64_status.phys = @sysvar::MsgU3T_Obj_64_50ms::SigU3T64_status;
   Msg_U3T_Obj_64_50ms.U3T64_FRcorner_lat.phys = @sysvar::MsgU3T_Obj_64_50ms::SigU3T64_FRcorner_lat;
   Msg_U3T_Obj_64_50ms.U3T64_FRcorner_long.phys = @sysvar::MsgU3T_Obj_64_50ms::SigU3T64_FRcorner_long;
   Msg_U3T_Obj_64_50ms.U3T64_heading_rate.phys = @sysvar::MsgU3T_Obj_64_50ms::SigU3T64_heading_rate;
   Msg_U3T_Obj_64_50ms.U3T64_id.phys = @sysvar::MsgU3T_Obj_64_50ms::SigU3T64_id;
   Msg_U3T_Obj_64_50ms.U3T64_length.phys = @sysvar::MsgU3T_Obj_64_50ms::SigU3T64_length;
   Msg_U3T_Obj_64_50ms.U3T64_RLcorner_lat.phys = @sysvar::MsgU3T_Obj_64_50ms::SigU3T64_RLcorner_lat;
   Msg_U3T_Obj_64_50ms.U3T64_RLcorner_long.phys = @sysvar::MsgU3T_Obj_64_50ms::SigU3T64_RLcorner_long;
   Msg_U3T_Obj_64_50ms.U3T64_RRcorner_lat.phys = @sysvar::MsgU3T_Obj_64_50ms::SigU3T64_RRcorner_lat;
   Msg_U3T_Obj_64_50ms.U3T64_RRcorner_long.phys = @sysvar::MsgU3T_Obj_64_50ms::SigU3T64_RRcorner_long;
   Msg_U3T_Obj_64_50ms.U3T64_speed.phys = @sysvar::MsgU3T_Obj_64_50ms::SigU3T64_speed;
   Msg_U3T_Obj_64_50ms.U3T64_width.phys = @sysvar::MsgU3T_Obj_64_50ms::SigU3T64_width;
   Msg_U3T_Obj_64_50ms.U3T64_fusion_source.phys = @sysvar::MsgU3T_Obj_64_50ms::SigU3T64_fusion_source;
   Msg_U3T_Obj_64_50ms.U3T64_vcs_heading.phys = @sysvar::MsgU3T_Obj_64_50ms::SigU3T64_vcs_heading;
   Msg_U3T_Obj_64_50ms.U3T64_vcs_lat_accel.phys = @sysvar::MsgU3T_Obj_64_50ms::SigU3T64_vcs_lat_accel;
   Msg_U3T_Obj_64_50ms.U3T64_vcs_lat_posn.phys = @sysvar::MsgU3T_Obj_64_50ms::SigU3T64_vcs_lat_posn;
   Msg_U3T_Obj_64_50ms.U3T64_vcs_lat_vel.phys = @sysvar::MsgU3T_Obj_64_50ms::SigU3T64_vcs_lat_vel;
   Msg_U3T_Obj_64_50ms.U3T64_vcs_long_accel.phys = @sysvar::MsgU3T_Obj_64_50ms::SigU3T64_vcs_long_accel;
   Msg_U3T_Obj_64_50ms.U3T64_vcs_long_posn.phys = @sysvar::MsgU3T_Obj_64_50ms::SigU3T64_vcs_long_posn;
   Msg_U3T_Obj_64_50ms.U3T64_vcs_long_vel.phys = @sysvar::MsgU3T_Obj_64_50ms::SigU3T64_vcs_long_vel;
   Msg_U3T_Obj_64_50ms.U3T64_conf_overall.phys = @sysvar::MsgU3T_Obj_64_50ms::SigU3T64_conf_overall;
   Msg_U3T_Obj_64_50ms.U3T64_f_oncoming.phys = @sysvar::MsgU3T_Obj_64_50ms::SigU3T64_f_oncoming;
   Msg_U3T_Obj_64_50ms.U3T64_f_receding.phys = @sysvar::MsgU3T_Obj_64_50ms::SigU3T64_f_receding;
   output(Msg_U3T_Obj_64_50ms);
   Msg_U3T_Obj_63_50ms.U3T63_age.phys = @sysvar::MsgU3T_Obj_63_50ms::SigU3T63_age;
   Msg_U3T_Obj_63_50ms.U3T63_f_moveable.phys = @sysvar::MsgU3T_Obj_63_50ms::SigU3T63_f_moveable;
   Msg_U3T_Obj_63_50ms.U3T63_f_stationary.phys = @sysvar::MsgU3T_Obj_63_50ms::SigU3T63_f_stationary;
   Msg_U3T_Obj_63_50ms.U3T63_FLcorner_lat.phys = @sysvar::MsgU3T_Obj_63_50ms::SigU3T63_FLcorner_lat;
   Msg_U3T_Obj_63_50ms.U3T63_object_class.phys = @sysvar::MsgU3T_Obj_63_50ms::SigU3T63_object_class;
   Msg_U3T_Obj_63_50ms.U3T63_FLcorner_long.phys = @sysvar::MsgU3T_Obj_63_50ms::SigU3T63_FLcorner_long;
   Msg_U3T_Obj_63_50ms.U3T63_status.phys = @sysvar::MsgU3T_Obj_63_50ms::SigU3T63_status;
   Msg_U3T_Obj_63_50ms.U3T63_FRcorner_lat.phys = @sysvar::MsgU3T_Obj_63_50ms::SigU3T63_FRcorner_lat;
   Msg_U3T_Obj_63_50ms.U3T63_FRcorner_long.phys = @sysvar::MsgU3T_Obj_63_50ms::SigU3T63_FRcorner_long;
   Msg_U3T_Obj_63_50ms.U3T63_heading_rate.phys = @sysvar::MsgU3T_Obj_63_50ms::SigU3T63_heading_rate;
   Msg_U3T_Obj_63_50ms.U3T63_id.phys = @sysvar::MsgU3T_Obj_63_50ms::SigU3T63_id;
   Msg_U3T_Obj_63_50ms.U3T63_length.phys = @sysvar::MsgU3T_Obj_63_50ms::SigU3T63_length;
   Msg_U3T_Obj_63_50ms.U3T63_RLcorner_lat.phys = @sysvar::MsgU3T_Obj_63_50ms::SigU3T63_RLcorner_lat;
   Msg_U3T_Obj_63_50ms.U3T63_RLcorner_long.phys = @sysvar::MsgU3T_Obj_63_50ms::SigU3T63_RLcorner_long;
   Msg_U3T_Obj_63_50ms.U3T63_RRcorner_lat.phys = @sysvar::MsgU3T_Obj_63_50ms::SigU3T63_RRcorner_lat;
   Msg_U3T_Obj_63_50ms.U3T63_RRcorner_long.phys = @sysvar::MsgU3T_Obj_63_50ms::SigU3T63_RRcorner_long;
   Msg_U3T_Obj_63_50ms.U3T63_speed.phys = @sysvar::MsgU3T_Obj_63_50ms::SigU3T63_speed;
   Msg_U3T_Obj_63_50ms.U3T63_width.phys = @sysvar::MsgU3T_Obj_63_50ms::SigU3T63_width;
   Msg_U3T_Obj_63_50ms.U3T63_fusion_source.phys = @sysvar::MsgU3T_Obj_63_50ms::SigU3T63_fusion_source;
   Msg_U3T_Obj_63_50ms.U3T63_vcs_heading.phys = @sysvar::MsgU3T_Obj_63_50ms::SigU3T63_vcs_heading;
   Msg_U3T_Obj_63_50ms.U3T63_vcs_lat_accel.phys = @sysvar::MsgU3T_Obj_63_50ms::SigU3T63_vcs_lat_accel;
   Msg_U3T_Obj_63_50ms.U3T63_vcs_lat_posn.phys = @sysvar::MsgU3T_Obj_63_50ms::SigU3T63_vcs_lat_posn;
   Msg_U3T_Obj_63_50ms.U3T63_vcs_lat_vel.phys = @sysvar::MsgU3T_Obj_63_50ms::SigU3T63_vcs_lat_vel;
   Msg_U3T_Obj_63_50ms.U3T63_vcs_long_accel.phys = @sysvar::MsgU3T_Obj_63_50ms::SigU3T63_vcs_long_accel;
   Msg_U3T_Obj_63_50ms.U3T63_vcs_long_posn.phys = @sysvar::MsgU3T_Obj_63_50ms::SigU3T63_vcs_long_posn;
   Msg_U3T_Obj_63_50ms.U3T63_vcs_long_vel.phys = @sysvar::MsgU3T_Obj_63_50ms::SigU3T63_vcs_long_vel;
   Msg_U3T_Obj_63_50ms.U3T63_conf_overall.phys = @sysvar::MsgU3T_Obj_63_50ms::SigU3T63_conf_overall;
   Msg_U3T_Obj_63_50ms.U3T63_f_oncoming.phys = @sysvar::MsgU3T_Obj_63_50ms::SigU3T63_f_oncoming;
   Msg_U3T_Obj_63_50ms.U3T63_f_receding.phys = @sysvar::MsgU3T_Obj_63_50ms::SigU3T63_f_receding;
   output(Msg_U3T_Obj_63_50ms);
   Msg_U3T_Obj_61_50ms.U3T61_age.phys = @sysvar::MsgU3T_Obj_61_50ms::SigU3T61_age;
   Msg_U3T_Obj_61_50ms.U3T61_f_moveable.phys = @sysvar::MsgU3T_Obj_61_50ms::SigU3T61_f_moveable;
   Msg_U3T_Obj_61_50ms.U3T61_f_stationary.phys = @sysvar::MsgU3T_Obj_61_50ms::SigU3T61_f_stationary;
   Msg_U3T_Obj_61_50ms.U3T61_FLcorner_lat.phys = @sysvar::MsgU3T_Obj_61_50ms::SigU3T61_FLcorner_lat;
   Msg_U3T_Obj_61_50ms.U3T61_object_class.phys = @sysvar::MsgU3T_Obj_61_50ms::SigU3T61_object_class;
   Msg_U3T_Obj_61_50ms.U3T61_FLcorner_long.phys = @sysvar::MsgU3T_Obj_61_50ms::SigU3T61_FLcorner_long;
   Msg_U3T_Obj_61_50ms.U3T61_status.phys = @sysvar::MsgU3T_Obj_61_50ms::SigU3T61_status;
   Msg_U3T_Obj_61_50ms.U3T61_FRcorner_lat.phys = @sysvar::MsgU3T_Obj_61_50ms::SigU3T61_FRcorner_lat;
   Msg_U3T_Obj_61_50ms.U3T61_FRcorner_long.phys = @sysvar::MsgU3T_Obj_61_50ms::SigU3T61_FRcorner_long;
   Msg_U3T_Obj_61_50ms.U3T61_heading_rate.phys = @sysvar::MsgU3T_Obj_61_50ms::SigU3T61_heading_rate;
   Msg_U3T_Obj_61_50ms.U3T61_id.phys = @sysvar::MsgU3T_Obj_61_50ms::SigU3T61_id;
   Msg_U3T_Obj_61_50ms.U3T61_length.phys = @sysvar::MsgU3T_Obj_61_50ms::SigU3T61_length;
   Msg_U3T_Obj_61_50ms.U3T61_RLcorner_lat.phys = @sysvar::MsgU3T_Obj_61_50ms::SigU3T61_RLcorner_lat;
   Msg_U3T_Obj_61_50ms.U3T61_RLcorner_long.phys = @sysvar::MsgU3T_Obj_61_50ms::SigU3T61_RLcorner_long;
   Msg_U3T_Obj_61_50ms.U3T61_RRcorner_lat.phys = @sysvar::MsgU3T_Obj_61_50ms::SigU3T61_RRcorner_lat;
   Msg_U3T_Obj_61_50ms.U3T61_RRcorner_long.phys = @sysvar::MsgU3T_Obj_61_50ms::SigU3T61_RRcorner_long;
   Msg_U3T_Obj_61_50ms.U3T61_speed.phys = @sysvar::MsgU3T_Obj_61_50ms::SigU3T61_speed;
   Msg_U3T_Obj_61_50ms.U3T61_width.phys = @sysvar::MsgU3T_Obj_61_50ms::SigU3T61_width;
   Msg_U3T_Obj_61_50ms.U3T61_fusion_source.phys = @sysvar::MsgU3T_Obj_61_50ms::SigU3T61_fusion_source;
   Msg_U3T_Obj_61_50ms.U3T61_vcs_heading.phys = @sysvar::MsgU3T_Obj_61_50ms::SigU3T61_vcs_heading;
   Msg_U3T_Obj_61_50ms.U3T61_vcs_lat_accel.phys = @sysvar::MsgU3T_Obj_61_50ms::SigU3T61_vcs_lat_accel;
   Msg_U3T_Obj_61_50ms.U3T61_vcs_lat_posn.phys = @sysvar::MsgU3T_Obj_61_50ms::SigU3T61_vcs_lat_posn;
   Msg_U3T_Obj_61_50ms.U3T61_vcs_lat_vel.phys = @sysvar::MsgU3T_Obj_61_50ms::SigU3T61_vcs_lat_vel;
   Msg_U3T_Obj_61_50ms.U3T61_vcs_long_accel.phys = @sysvar::MsgU3T_Obj_61_50ms::SigU3T61_vcs_long_accel;
   Msg_U3T_Obj_61_50ms.U3T61_vcs_long_posn.phys = @sysvar::MsgU3T_Obj_61_50ms::SigU3T61_vcs_long_posn;
   Msg_U3T_Obj_61_50ms.U3T61_vcs_long_vel.phys = @sysvar::MsgU3T_Obj_61_50ms::SigU3T61_vcs_long_vel;
   Msg_U3T_Obj_61_50ms.U3T61_conf_overall.phys = @sysvar::MsgU3T_Obj_61_50ms::SigU3T61_conf_overall;
   Msg_U3T_Obj_61_50ms.U3T61_f_oncoming.phys = @sysvar::MsgU3T_Obj_61_50ms::SigU3T61_f_oncoming;
   Msg_U3T_Obj_61_50ms.U3T61_f_receding.phys = @sysvar::MsgU3T_Obj_61_50ms::SigU3T61_f_receding;
   output(Msg_U3T_Obj_61_50ms);
   Msg_U3T_Obj_52_50ms.U3T52_age.phys = @sysvar::MsgU3T_Obj_52_50ms::SigU3T52_age;
   Msg_U3T_Obj_52_50ms.U3T52_f_moveable.phys = @sysvar::MsgU3T_Obj_52_50ms::SigU3T52_f_moveable;
   Msg_U3T_Obj_52_50ms.U3T52_f_stationary.phys = @sysvar::MsgU3T_Obj_52_50ms::SigU3T52_f_stationary;
   Msg_U3T_Obj_52_50ms.U3T52_FLcorner_lat.phys = @sysvar::MsgU3T_Obj_52_50ms::SigU3T52_FLcorner_lat;
   Msg_U3T_Obj_52_50ms.U3T52_object_class.phys = @sysvar::MsgU3T_Obj_52_50ms::SigU3T52_object_class;
   Msg_U3T_Obj_52_50ms.U3T52_FLcorner_long.phys = @sysvar::MsgU3T_Obj_52_50ms::SigU3T52_FLcorner_long;
   Msg_U3T_Obj_52_50ms.U3T52_status.phys = @sysvar::MsgU3T_Obj_52_50ms::SigU3T52_status;
   Msg_U3T_Obj_52_50ms.U3T52_FRcorner_lat.phys = @sysvar::MsgU3T_Obj_52_50ms::SigU3T52_FRcorner_lat;
   Msg_U3T_Obj_52_50ms.U3T52_FRcorner_long.phys = @sysvar::MsgU3T_Obj_52_50ms::SigU3T52_FRcorner_long;
   Msg_U3T_Obj_52_50ms.U3T52_heading_rate.phys = @sysvar::MsgU3T_Obj_52_50ms::SigU3T52_heading_rate;
   Msg_U3T_Obj_52_50ms.U3T52_id.phys = @sysvar::MsgU3T_Obj_52_50ms::SigU3T52_id;
   Msg_U3T_Obj_52_50ms.U3T52_length.phys = @sysvar::MsgU3T_Obj_52_50ms::SigU3T52_length;
   Msg_U3T_Obj_52_50ms.U3T52_RLcorner_lat.phys = @sysvar::MsgU3T_Obj_52_50ms::SigU3T52_RLcorner_lat;
   Msg_U3T_Obj_52_50ms.U3T52_RLcorner_long.phys = @sysvar::MsgU3T_Obj_52_50ms::SigU3T52_RLcorner_long;
   Msg_U3T_Obj_52_50ms.U3T52_RRcorner_lat.phys = @sysvar::MsgU3T_Obj_52_50ms::SigU3T52_RRcorner_lat;
   Msg_U3T_Obj_52_50ms.U3T52_RRcorner_long.phys = @sysvar::MsgU3T_Obj_52_50ms::SigU3T52_RRcorner_long;
   Msg_U3T_Obj_52_50ms.U3T52_speed.phys = @sysvar::MsgU3T_Obj_52_50ms::SigU3T52_speed;
   Msg_U3T_Obj_52_50ms.U3T52_width.phys = @sysvar::MsgU3T_Obj_52_50ms::SigU3T52_width;
   Msg_U3T_Obj_52_50ms.U3T52_fusion_source.phys = @sysvar::MsgU3T_Obj_52_50ms::SigU3T52_fusion_source;
   Msg_U3T_Obj_52_50ms.U3T52_vcs_heading.phys = @sysvar::MsgU3T_Obj_52_50ms::SigU3T52_vcs_heading;
   Msg_U3T_Obj_52_50ms.U3T52_vcs_lat_accel.phys = @sysvar::MsgU3T_Obj_52_50ms::SigU3T52_vcs_lat_accel;
   Msg_U3T_Obj_52_50ms.U3T52_vcs_lat_posn.phys = @sysvar::MsgU3T_Obj_52_50ms::SigU3T52_vcs_lat_posn;
   Msg_U3T_Obj_52_50ms.U3T52_vcs_lat_vel.phys = @sysvar::MsgU3T_Obj_52_50ms::SigU3T52_vcs_lat_vel;
   Msg_U3T_Obj_52_50ms.U3T52_vcs_long_accel.phys = @sysvar::MsgU3T_Obj_52_50ms::SigU3T52_vcs_long_accel;
   Msg_U3T_Obj_52_50ms.U3T52_vcs_long_posn.phys = @sysvar::MsgU3T_Obj_52_50ms::SigU3T52_vcs_long_posn;
   Msg_U3T_Obj_52_50ms.U3T52_vcs_long_vel.phys = @sysvar::MsgU3T_Obj_52_50ms::SigU3T52_vcs_long_vel;
   Msg_U3T_Obj_52_50ms.U3T52_conf_overall.phys = @sysvar::MsgU3T_Obj_52_50ms::SigU3T52_conf_overall;
   Msg_U3T_Obj_52_50ms.U3T52_f_oncoming.phys = @sysvar::MsgU3T_Obj_52_50ms::SigU3T52_f_oncoming;
   Msg_U3T_Obj_52_50ms.U3T52_f_receding.phys = @sysvar::MsgU3T_Obj_52_50ms::SigU3T52_f_receding;
   output(Msg_U3T_Obj_52_50ms);
   Msg_U3T_Obj_60_50ms.U3T60_age.phys = @sysvar::MsgU3T_Obj_60_50ms::SigU3T60_age;
   Msg_U3T_Obj_60_50ms.U3T60_f_moveable.phys = @sysvar::MsgU3T_Obj_60_50ms::SigU3T60_f_moveable;
   Msg_U3T_Obj_60_50ms.U3T60_f_stationary.phys = @sysvar::MsgU3T_Obj_60_50ms::SigU3T60_f_stationary;
   Msg_U3T_Obj_60_50ms.U3T60_FLcorner_lat.phys = @sysvar::MsgU3T_Obj_60_50ms::SigU3T60_FLcorner_lat;
   Msg_U3T_Obj_60_50ms.U3T60_object_class.phys = @sysvar::MsgU3T_Obj_60_50ms::SigU3T60_object_class;
   Msg_U3T_Obj_60_50ms.U3T60_FLcorner_long.phys = @sysvar::MsgU3T_Obj_60_50ms::SigU3T60_FLcorner_long;
   Msg_U3T_Obj_60_50ms.U3T60_status.phys = @sysvar::MsgU3T_Obj_60_50ms::SigU3T60_status;
   Msg_U3T_Obj_60_50ms.U3T60_FRcorner_lat.phys = @sysvar::MsgU3T_Obj_60_50ms::SigU3T60_FRcorner_lat;
   Msg_U3T_Obj_60_50ms.U3T60_FRcorner_long.phys = @sysvar::MsgU3T_Obj_60_50ms::SigU3T60_FRcorner_long;
   Msg_U3T_Obj_60_50ms.U3T60_heading_rate.phys = @sysvar::MsgU3T_Obj_60_50ms::SigU3T60_heading_rate;
   Msg_U3T_Obj_60_50ms.U3T60_id.phys = @sysvar::MsgU3T_Obj_60_50ms::SigU3T60_id;
   Msg_U3T_Obj_60_50ms.U3T60_length.phys = @sysvar::MsgU3T_Obj_60_50ms::SigU3T60_length;
   Msg_U3T_Obj_60_50ms.U3T60_RLcorner_lat.phys = @sysvar::MsgU3T_Obj_60_50ms::SigU3T60_RLcorner_lat;
   Msg_U3T_Obj_60_50ms.U3T60_RLcorner_long.phys = @sysvar::MsgU3T_Obj_60_50ms::SigU3T60_RLcorner_long;
   Msg_U3T_Obj_60_50ms.U3T60_RRcorner_lat.phys = @sysvar::MsgU3T_Obj_60_50ms::SigU3T60_RRcorner_lat;
   Msg_U3T_Obj_60_50ms.U3T60_RRcorner_long.phys = @sysvar::MsgU3T_Obj_60_50ms::SigU3T60_RRcorner_long;
   Msg_U3T_Obj_60_50ms.U3T60_speed.phys = @sysvar::MsgU3T_Obj_60_50ms::SigU3T60_speed;
   Msg_U3T_Obj_60_50ms.U3T60_width.phys = @sysvar::MsgU3T_Obj_60_50ms::SigU3T60_width;
   Msg_U3T_Obj_60_50ms.U3T60_fusion_source.phys = @sysvar::MsgU3T_Obj_60_50ms::SigU3T60_fusion_source;
   Msg_U3T_Obj_60_50ms.U3T60_vcs_heading.phys = @sysvar::MsgU3T_Obj_60_50ms::SigU3T60_vcs_heading;
   Msg_U3T_Obj_60_50ms.U3T60_vcs_lat_accel.phys = @sysvar::MsgU3T_Obj_60_50ms::SigU3T60_vcs_lat_accel;
   Msg_U3T_Obj_60_50ms.U3T60_vcs_lat_posn.phys = @sysvar::MsgU3T_Obj_60_50ms::SigU3T60_vcs_lat_posn;
   Msg_U3T_Obj_60_50ms.U3T60_vcs_lat_vel.phys = @sysvar::MsgU3T_Obj_60_50ms::SigU3T60_vcs_lat_vel;
   Msg_U3T_Obj_60_50ms.U3T60_vcs_long_accel.phys = @sysvar::MsgU3T_Obj_60_50ms::SigU3T60_vcs_long_accel;
   Msg_U3T_Obj_60_50ms.U3T60_vcs_long_posn.phys = @sysvar::MsgU3T_Obj_60_50ms::SigU3T60_vcs_long_posn;
   Msg_U3T_Obj_60_50ms.U3T60_vcs_long_vel.phys = @sysvar::MsgU3T_Obj_60_50ms::SigU3T60_vcs_long_vel;
   Msg_U3T_Obj_60_50ms.U3T60_conf_overall.phys = @sysvar::MsgU3T_Obj_60_50ms::SigU3T60_conf_overall;
   Msg_U3T_Obj_60_50ms.U3T60_f_oncoming.phys = @sysvar::MsgU3T_Obj_60_50ms::SigU3T60_f_oncoming;
   Msg_U3T_Obj_60_50ms.U3T60_f_receding.phys = @sysvar::MsgU3T_Obj_60_50ms::SigU3T60_f_receding;
   output(Msg_U3T_Obj_60_50ms);
   Msg_U3T_Obj_59_50ms.U3T59_age.phys = @sysvar::MsgU3T_Obj_59_50ms::SigU3T59_age;
   Msg_U3T_Obj_59_50ms.U3T59_f_moveable.phys = @sysvar::MsgU3T_Obj_59_50ms::SigU3T59_f_moveable;
   Msg_U3T_Obj_59_50ms.U3T59_f_stationary.phys = @sysvar::MsgU3T_Obj_59_50ms::SigU3T59_f_stationary;
   Msg_U3T_Obj_59_50ms.U3T59_FLcorner_lat.phys = @sysvar::MsgU3T_Obj_59_50ms::SigU3T59_FLcorner_lat;
   Msg_U3T_Obj_59_50ms.U3T59_object_class.phys = @sysvar::MsgU3T_Obj_59_50ms::SigU3T59_object_class;
   Msg_U3T_Obj_59_50ms.U3T59_FLcorner_long.phys = @sysvar::MsgU3T_Obj_59_50ms::SigU3T59_FLcorner_long;
   Msg_U3T_Obj_59_50ms.U3T59_status.phys = @sysvar::MsgU3T_Obj_59_50ms::SigU3T59_status;
   Msg_U3T_Obj_59_50ms.U3T59_FRcorner_lat.phys = @sysvar::MsgU3T_Obj_59_50ms::SigU3T59_FRcorner_lat;
   Msg_U3T_Obj_59_50ms.U3T59_FRcorner_long.phys = @sysvar::MsgU3T_Obj_59_50ms::SigU3T59_FRcorner_long;
   Msg_U3T_Obj_59_50ms.U3T59_heading_rate.phys = @sysvar::MsgU3T_Obj_59_50ms::SigU3T59_heading_rate;
   Msg_U3T_Obj_59_50ms.U3T59_id.phys = @sysvar::MsgU3T_Obj_59_50ms::SigU3T59_id;
   Msg_U3T_Obj_59_50ms.U3T59_length.phys = @sysvar::MsgU3T_Obj_59_50ms::SigU3T59_length;
   Msg_U3T_Obj_59_50ms.U3T59_RLcorner_lat.phys = @sysvar::MsgU3T_Obj_59_50ms::SigU3T59_RLcorner_lat;
   Msg_U3T_Obj_59_50ms.U3T59_RLcorner_long.phys = @sysvar::MsgU3T_Obj_59_50ms::SigU3T59_RLcorner_long;
   Msg_U3T_Obj_59_50ms.U3T59_RRcorner_lat.phys = @sysvar::MsgU3T_Obj_59_50ms::SigU3T59_RRcorner_lat;
   Msg_U3T_Obj_59_50ms.U3T59_RRcorner_long.phys = @sysvar::MsgU3T_Obj_59_50ms::SigU3T59_RRcorner_long;
   Msg_U3T_Obj_59_50ms.U3T59_speed.phys = @sysvar::MsgU3T_Obj_59_50ms::SigU3T59_speed;
   Msg_U3T_Obj_59_50ms.U3T59_width.phys = @sysvar::MsgU3T_Obj_59_50ms::SigU3T59_width;
   Msg_U3T_Obj_59_50ms.U3T59_fusion_source.phys = @sysvar::MsgU3T_Obj_59_50ms::SigU3T59_fusion_source;
   Msg_U3T_Obj_59_50ms.U3T59_vcs_heading.phys = @sysvar::MsgU3T_Obj_59_50ms::SigU3T59_vcs_heading;
   Msg_U3T_Obj_59_50ms.U3T59_vcs_lat_accel.phys = @sysvar::MsgU3T_Obj_59_50ms::SigU3T59_vcs_lat_accel;
   Msg_U3T_Obj_59_50ms.U3T59_vcs_lat_posn.phys = @sysvar::MsgU3T_Obj_59_50ms::SigU3T59_vcs_lat_posn;
   Msg_U3T_Obj_59_50ms.U3T59_vcs_lat_vel.phys = @sysvar::MsgU3T_Obj_59_50ms::SigU3T59_vcs_lat_vel;
   Msg_U3T_Obj_59_50ms.U3T59_vcs_long_accel.phys = @sysvar::MsgU3T_Obj_59_50ms::SigU3T59_vcs_long_accel;
   Msg_U3T_Obj_59_50ms.U3T59_vcs_long_posn.phys = @sysvar::MsgU3T_Obj_59_50ms::SigU3T59_vcs_long_posn;
   Msg_U3T_Obj_59_50ms.U3T59_vcs_long_vel.phys = @sysvar::MsgU3T_Obj_59_50ms::SigU3T59_vcs_long_vel;
   Msg_U3T_Obj_59_50ms.U3T59_conf_overall.phys = @sysvar::MsgU3T_Obj_59_50ms::SigU3T59_conf_overall;
   Msg_U3T_Obj_59_50ms.U3T59_f_oncoming.phys = @sysvar::MsgU3T_Obj_59_50ms::SigU3T59_f_oncoming;
   Msg_U3T_Obj_59_50ms.U3T59_f_receding.phys = @sysvar::MsgU3T_Obj_59_50ms::SigU3T59_f_receding;
   output(Msg_U3T_Obj_59_50ms);
   Msg_U3T_Obj_58_50ms.U3T58_age.phys = @sysvar::MsgU3T_Obj_58_50ms::SigU3T58_age;
   Msg_U3T_Obj_58_50ms.U3T58_f_moveable.phys = @sysvar::MsgU3T_Obj_58_50ms::SigU3T58_f_moveable;
   Msg_U3T_Obj_58_50ms.U3T58_f_stationary.phys = @sysvar::MsgU3T_Obj_58_50ms::SigU3T58_f_stationary;
   Msg_U3T_Obj_58_50ms.U3T58_FLcorner_lat.phys = @sysvar::MsgU3T_Obj_58_50ms::SigU3T58_FLcorner_lat;
   Msg_U3T_Obj_58_50ms.U3T58_object_class.phys = @sysvar::MsgU3T_Obj_58_50ms::SigU3T58_object_class;
   Msg_U3T_Obj_58_50ms.U3T58_FLcorner_long.phys = @sysvar::MsgU3T_Obj_58_50ms::SigU3T58_FLcorner_long;
   Msg_U3T_Obj_58_50ms.U3T58_status.phys = @sysvar::MsgU3T_Obj_58_50ms::SigU3T58_status;
   Msg_U3T_Obj_58_50ms.U3T58_FRcorner_lat.phys = @sysvar::MsgU3T_Obj_58_50ms::SigU3T58_FRcorner_lat;
   Msg_U3T_Obj_58_50ms.U3T58_FRcorner_long.phys = @sysvar::MsgU3T_Obj_58_50ms::SigU3T58_FRcorner_long;
   Msg_U3T_Obj_58_50ms.U3T58_heading_rate.phys = @sysvar::MsgU3T_Obj_58_50ms::SigU3T58_heading_rate;
   Msg_U3T_Obj_58_50ms.U3T58_id.phys = @sysvar::MsgU3T_Obj_58_50ms::SigU3T58_id;
   Msg_U3T_Obj_58_50ms.U3T58_length.phys = @sysvar::MsgU3T_Obj_58_50ms::SigU3T58_length;
   Msg_U3T_Obj_58_50ms.U3T58_RLcorner_lat.phys = @sysvar::MsgU3T_Obj_58_50ms::SigU3T58_RLcorner_lat;
   Msg_U3T_Obj_58_50ms.U3T58_RLcorner_long.phys = @sysvar::MsgU3T_Obj_58_50ms::SigU3T58_RLcorner_long;
   Msg_U3T_Obj_58_50ms.U3T58_RRcorner_lat.phys = @sysvar::MsgU3T_Obj_58_50ms::SigU3T58_RRcorner_lat;
   Msg_U3T_Obj_58_50ms.U3T58_RRcorner_long.phys = @sysvar::MsgU3T_Obj_58_50ms::SigU3T58_RRcorner_long;
   Msg_U3T_Obj_58_50ms.U3T58_speed.phys = @sysvar::MsgU3T_Obj_58_50ms::SigU3T58_speed;
   Msg_U3T_Obj_58_50ms.U3T58_width.phys = @sysvar::MsgU3T_Obj_58_50ms::SigU3T58_width;
   Msg_U3T_Obj_58_50ms.U3T58_fusion_source.phys = @sysvar::MsgU3T_Obj_58_50ms::SigU3T58_fusion_source;
   Msg_U3T_Obj_58_50ms.U3T58_vcs_heading.phys = @sysvar::MsgU3T_Obj_58_50ms::SigU3T58_vcs_heading;
   Msg_U3T_Obj_58_50ms.U3T58_vcs_lat_accel.phys = @sysvar::MsgU3T_Obj_58_50ms::SigU3T58_vcs_lat_accel;
   Msg_U3T_Obj_58_50ms.U3T58_vcs_lat_posn.phys = @sysvar::MsgU3T_Obj_58_50ms::SigU3T58_vcs_lat_posn;
   Msg_U3T_Obj_58_50ms.U3T58_vcs_lat_vel.phys = @sysvar::MsgU3T_Obj_58_50ms::SigU3T58_vcs_lat_vel;
   Msg_U3T_Obj_58_50ms.U3T58_vcs_long_accel.phys = @sysvar::MsgU3T_Obj_58_50ms::SigU3T58_vcs_long_accel;
   Msg_U3T_Obj_58_50ms.U3T58_vcs_long_posn.phys = @sysvar::MsgU3T_Obj_58_50ms::SigU3T58_vcs_long_posn;
   Msg_U3T_Obj_58_50ms.U3T58_vcs_long_vel.phys = @sysvar::MsgU3T_Obj_58_50ms::SigU3T58_vcs_long_vel;
   Msg_U3T_Obj_58_50ms.U3T58_conf_overall.phys = @sysvar::MsgU3T_Obj_58_50ms::SigU3T58_conf_overall;
   Msg_U3T_Obj_58_50ms.U3T58_f_oncoming.phys = @sysvar::MsgU3T_Obj_58_50ms::SigU3T58_f_oncoming;
   Msg_U3T_Obj_58_50ms.U3T58_f_receding.phys = @sysvar::MsgU3T_Obj_58_50ms::SigU3T58_f_receding;
   output(Msg_U3T_Obj_58_50ms);
   Msg_U3T_Obj_57_50ms.U3T57_age.phys = @sysvar::MsgU3T_Obj_57_50ms::SigU3T57_age;
   Msg_U3T_Obj_57_50ms.U3T57_f_moveable.phys = @sysvar::MsgU3T_Obj_57_50ms::SigU3T57_f_moveable;
   Msg_U3T_Obj_57_50ms.U3T57_f_stationary.phys = @sysvar::MsgU3T_Obj_57_50ms::SigU3T57_f_stationary;
   Msg_U3T_Obj_57_50ms.U3T57_FLcorner_lat.phys = @sysvar::MsgU3T_Obj_57_50ms::SigU3T57_FLcorner_lat;
   Msg_U3T_Obj_57_50ms.U3T57_object_class.phys = @sysvar::MsgU3T_Obj_57_50ms::SigU3T57_object_class;
   Msg_U3T_Obj_57_50ms.U3T57_FLcorner_long.phys = @sysvar::MsgU3T_Obj_57_50ms::SigU3T57_FLcorner_long;
   Msg_U3T_Obj_57_50ms.U3T57_status.phys = @sysvar::MsgU3T_Obj_57_50ms::SigU3T57_status;
   Msg_U3T_Obj_57_50ms.U3T57_FRcorner_lat.phys = @sysvar::MsgU3T_Obj_57_50ms::SigU3T57_FRcorner_lat;
   Msg_U3T_Obj_57_50ms.U3T57_FRcorner_long.phys = @sysvar::MsgU3T_Obj_57_50ms::SigU3T57_FRcorner_long;
   Msg_U3T_Obj_57_50ms.U3T57_heading_rate.phys = @sysvar::MsgU3T_Obj_57_50ms::SigU3T57_heading_rate;
   Msg_U3T_Obj_57_50ms.U3T57_id.phys = @sysvar::MsgU3T_Obj_57_50ms::SigU3T57_id;
   Msg_U3T_Obj_57_50ms.U3T57_length.phys = @sysvar::MsgU3T_Obj_57_50ms::SigU3T57_length;
   Msg_U3T_Obj_57_50ms.U3T57_RLcorner_lat.phys = @sysvar::MsgU3T_Obj_57_50ms::SigU3T57_RLcorner_lat;
   Msg_U3T_Obj_57_50ms.U3T57_RLcorner_long.phys = @sysvar::MsgU3T_Obj_57_50ms::SigU3T57_RLcorner_long;
   Msg_U3T_Obj_57_50ms.U3T57_RRcorner_lat.phys = @sysvar::MsgU3T_Obj_57_50ms::SigU3T57_RRcorner_lat;
   Msg_U3T_Obj_57_50ms.U3T57_RRcorner_long.phys = @sysvar::MsgU3T_Obj_57_50ms::SigU3T57_RRcorner_long;
   Msg_U3T_Obj_57_50ms.U3T57_speed.phys = @sysvar::MsgU3T_Obj_57_50ms::SigU3T57_speed;
   Msg_U3T_Obj_57_50ms.U3T57_width.phys = @sysvar::MsgU3T_Obj_57_50ms::SigU3T57_width;
   Msg_U3T_Obj_57_50ms.U3T57_fusion_source.phys = @sysvar::MsgU3T_Obj_57_50ms::SigU3T57_fusion_source;
   Msg_U3T_Obj_57_50ms.U3T57_vcs_heading.phys = @sysvar::MsgU3T_Obj_57_50ms::SigU3T57_vcs_heading;
   Msg_U3T_Obj_57_50ms.U3T57_vcs_lat_accel.phys = @sysvar::MsgU3T_Obj_57_50ms::SigU3T57_vcs_lat_accel;
   Msg_U3T_Obj_57_50ms.U3T57_vcs_lat_posn.phys = @sysvar::MsgU3T_Obj_57_50ms::SigU3T57_vcs_lat_posn;
   Msg_U3T_Obj_57_50ms.U3T57_vcs_lat_vel.phys = @sysvar::MsgU3T_Obj_57_50ms::SigU3T57_vcs_lat_vel;
   Msg_U3T_Obj_57_50ms.U3T57_vcs_long_accel.phys = @sysvar::MsgU3T_Obj_57_50ms::SigU3T57_vcs_long_accel;
   Msg_U3T_Obj_57_50ms.U3T57_vcs_long_posn.phys = @sysvar::MsgU3T_Obj_57_50ms::SigU3T57_vcs_long_posn;
   Msg_U3T_Obj_57_50ms.U3T57_vcs_long_vel.phys = @sysvar::MsgU3T_Obj_57_50ms::SigU3T57_vcs_long_vel;
   Msg_U3T_Obj_57_50ms.U3T57_conf_overall.phys = @sysvar::MsgU3T_Obj_57_50ms::SigU3T57_conf_overall;
   Msg_U3T_Obj_57_50ms.U3T57_f_oncoming.phys = @sysvar::MsgU3T_Obj_57_50ms::SigU3T57_f_oncoming;
   Msg_U3T_Obj_57_50ms.U3T57_f_receding.phys = @sysvar::MsgU3T_Obj_57_50ms::SigU3T57_f_receding;
   output(Msg_U3T_Obj_57_50ms);
   Msg_U3T_Obj_56_50ms.U3T56_age.phys = @sysvar::MsgU3T_Obj_56_50ms::SigU3T56_age;
   Msg_U3T_Obj_56_50ms.U3T56_f_moveable.phys = @sysvar::MsgU3T_Obj_56_50ms::SigU3T56_f_moveable;
   Msg_U3T_Obj_56_50ms.U3T56_f_stationary.phys = @sysvar::MsgU3T_Obj_56_50ms::SigU3T56_f_stationary;
   Msg_U3T_Obj_56_50ms.U3T56_FLcorner_lat.phys = @sysvar::MsgU3T_Obj_56_50ms::SigU3T56_FLcorner_lat;
   Msg_U3T_Obj_56_50ms.U3T56_object_class.phys = @sysvar::MsgU3T_Obj_56_50ms::SigU3T56_object_class;
   Msg_U3T_Obj_56_50ms.U3T56_FLcorner_long.phys = @sysvar::MsgU3T_Obj_56_50ms::SigU3T56_FLcorner_long;
   Msg_U3T_Obj_56_50ms.U3T56_status.phys = @sysvar::MsgU3T_Obj_56_50ms::SigU3T56_status;
   Msg_U3T_Obj_56_50ms.U3T56_FRcorner_lat.phys = @sysvar::MsgU3T_Obj_56_50ms::SigU3T56_FRcorner_lat;
   Msg_U3T_Obj_56_50ms.U3T56_FRcorner_long.phys = @sysvar::MsgU3T_Obj_56_50ms::SigU3T56_FRcorner_long;
   Msg_U3T_Obj_56_50ms.U3T56_heading_rate.phys = @sysvar::MsgU3T_Obj_56_50ms::SigU3T56_heading_rate;
   Msg_U3T_Obj_56_50ms.U3T56_id.phys = @sysvar::MsgU3T_Obj_56_50ms::SigU3T56_id;
   Msg_U3T_Obj_56_50ms.U3T56_length.phys = @sysvar::MsgU3T_Obj_56_50ms::SigU3T56_length;
   Msg_U3T_Obj_56_50ms.U3T56_RLcorner_lat.phys = @sysvar::MsgU3T_Obj_56_50ms::SigU3T56_RLcorner_lat;
   Msg_U3T_Obj_56_50ms.U3T56_RLcorner_long.phys = @sysvar::MsgU3T_Obj_56_50ms::SigU3T56_RLcorner_long;
   Msg_U3T_Obj_56_50ms.U3T56_RRcorner_lat.phys = @sysvar::MsgU3T_Obj_56_50ms::SigU3T56_RRcorner_lat;
   Msg_U3T_Obj_56_50ms.U3T56_RRcorner_long.phys = @sysvar::MsgU3T_Obj_56_50ms::SigU3T56_RRcorner_long;
   Msg_U3T_Obj_56_50ms.U3T56_speed.phys = @sysvar::MsgU3T_Obj_56_50ms::SigU3T56_speed;
   Msg_U3T_Obj_56_50ms.U3T56_width.phys = @sysvar::MsgU3T_Obj_56_50ms::SigU3T56_width;
   Msg_U3T_Obj_56_50ms.U3T56_fusion_source.phys = @sysvar::MsgU3T_Obj_56_50ms::SigU3T56_fusion_source;
   Msg_U3T_Obj_56_50ms.U3T56_vcs_heading.phys = @sysvar::MsgU3T_Obj_56_50ms::SigU3T56_vcs_heading;
   Msg_U3T_Obj_56_50ms.U3T56_vcs_lat_accel.phys = @sysvar::MsgU3T_Obj_56_50ms::SigU3T56_vcs_lat_accel;
   Msg_U3T_Obj_56_50ms.U3T56_vcs_lat_posn.phys = @sysvar::MsgU3T_Obj_56_50ms::SigU3T56_vcs_lat_posn;
   Msg_U3T_Obj_56_50ms.U3T56_vcs_lat_vel.phys = @sysvar::MsgU3T_Obj_56_50ms::SigU3T56_vcs_lat_vel;
   Msg_U3T_Obj_56_50ms.U3T56_vcs_long_accel.phys = @sysvar::MsgU3T_Obj_56_50ms::SigU3T56_vcs_long_accel;
   Msg_U3T_Obj_56_50ms.U3T56_vcs_long_posn.phys = @sysvar::MsgU3T_Obj_56_50ms::SigU3T56_vcs_long_posn;
   Msg_U3T_Obj_56_50ms.U3T56_vcs_long_vel.phys = @sysvar::MsgU3T_Obj_56_50ms::SigU3T56_vcs_long_vel;
   Msg_U3T_Obj_56_50ms.U3T56_conf_overall.phys = @sysvar::MsgU3T_Obj_56_50ms::SigU3T56_conf_overall;
   Msg_U3T_Obj_56_50ms.U3T56_f_oncoming.phys = @sysvar::MsgU3T_Obj_56_50ms::SigU3T56_f_oncoming;
   Msg_U3T_Obj_56_50ms.U3T56_f_receding.phys = @sysvar::MsgU3T_Obj_56_50ms::SigU3T56_f_receding;
   output(Msg_U3T_Obj_56_50ms);
   Msg_U3T_Obj_55_50ms.U3T55_age.phys = @sysvar::MsgU3T_Obj_55_50ms::SigU3T55_age;
   Msg_U3T_Obj_55_50ms.U3T55_f_moveable.phys = @sysvar::MsgU3T_Obj_55_50ms::SigU3T55_f_moveable;
   Msg_U3T_Obj_55_50ms.U3T55_f_stationary.phys = @sysvar::MsgU3T_Obj_55_50ms::SigU3T55_f_stationary;
   Msg_U3T_Obj_55_50ms.U3T55_FLcorner_lat.phys = @sysvar::MsgU3T_Obj_55_50ms::SigU3T55_FLcorner_lat;
   Msg_U3T_Obj_55_50ms.U3T55_object_class.phys = @sysvar::MsgU3T_Obj_55_50ms::SigU3T55_object_class;
   Msg_U3T_Obj_55_50ms.U3T55_FLcorner_long.phys = @sysvar::MsgU3T_Obj_55_50ms::SigU3T55_FLcorner_long;
   Msg_U3T_Obj_55_50ms.U3T55_status.phys = @sysvar::MsgU3T_Obj_55_50ms::SigU3T55_status;
   Msg_U3T_Obj_55_50ms.U3T55_FRcorner_lat.phys = @sysvar::MsgU3T_Obj_55_50ms::SigU3T55_FRcorner_lat;
   Msg_U3T_Obj_55_50ms.U3T55_FRcorner_long.phys = @sysvar::MsgU3T_Obj_55_50ms::SigU3T55_FRcorner_long;
   Msg_U3T_Obj_55_50ms.U3T55_heading_rate.phys = @sysvar::MsgU3T_Obj_55_50ms::SigU3T55_heading_rate;
   Msg_U3T_Obj_55_50ms.U3T55_id.phys = @sysvar::MsgU3T_Obj_55_50ms::SigU3T55_id;
   Msg_U3T_Obj_55_50ms.U3T55_length.phys = @sysvar::MsgU3T_Obj_55_50ms::SigU3T55_length;
   Msg_U3T_Obj_55_50ms.U3T55_RLcorner_lat.phys = @sysvar::MsgU3T_Obj_55_50ms::SigU3T55_RLcorner_lat;
   Msg_U3T_Obj_55_50ms.U3T55_RLcorner_long.phys = @sysvar::MsgU3T_Obj_55_50ms::SigU3T55_RLcorner_long;
   Msg_U3T_Obj_55_50ms.U3T55_RRcorner_lat.phys = @sysvar::MsgU3T_Obj_55_50ms::SigU3T55_RRcorner_lat;
   Msg_U3T_Obj_55_50ms.U3T55_RRcorner_long.phys = @sysvar::MsgU3T_Obj_55_50ms::SigU3T55_RRcorner_long;
   Msg_U3T_Obj_55_50ms.U3T55_speed.phys = @sysvar::MsgU3T_Obj_55_50ms::SigU3T55_speed;
   Msg_U3T_Obj_55_50ms.U3T55_width.phys = @sysvar::MsgU3T_Obj_55_50ms::SigU3T55_width;
   Msg_U3T_Obj_55_50ms.U3T55_fusion_source.phys = @sysvar::MsgU3T_Obj_55_50ms::SigU3T55_fusion_source;
   Msg_U3T_Obj_55_50ms.U3T55_vcs_heading.phys = @sysvar::MsgU3T_Obj_55_50ms::SigU3T55_vcs_heading;
   Msg_U3T_Obj_55_50ms.U3T55_vcs_lat_accel.phys = @sysvar::MsgU3T_Obj_55_50ms::SigU3T55_vcs_lat_accel;
   Msg_U3T_Obj_55_50ms.U3T55_vcs_lat_posn.phys = @sysvar::MsgU3T_Obj_55_50ms::SigU3T55_vcs_lat_posn;
   Msg_U3T_Obj_55_50ms.U3T55_vcs_lat_vel.phys = @sysvar::MsgU3T_Obj_55_50ms::SigU3T55_vcs_lat_vel;
   Msg_U3T_Obj_55_50ms.U3T55_vcs_long_accel.phys = @sysvar::MsgU3T_Obj_55_50ms::SigU3T55_vcs_long_accel;
   Msg_U3T_Obj_55_50ms.U3T55_vcs_long_posn.phys = @sysvar::MsgU3T_Obj_55_50ms::SigU3T55_vcs_long_posn;
   Msg_U3T_Obj_55_50ms.U3T55_vcs_long_vel.phys = @sysvar::MsgU3T_Obj_55_50ms::SigU3T55_vcs_long_vel;
   Msg_U3T_Obj_55_50ms.U3T55_conf_overall.phys = @sysvar::MsgU3T_Obj_55_50ms::SigU3T55_conf_overall;
   Msg_U3T_Obj_55_50ms.U3T55_f_oncoming.phys = @sysvar::MsgU3T_Obj_55_50ms::SigU3T55_f_oncoming;
   Msg_U3T_Obj_55_50ms.U3T55_f_receding.phys = @sysvar::MsgU3T_Obj_55_50ms::SigU3T55_f_receding;
   output(Msg_U3T_Obj_55_50ms);
   Msg_U3T_Obj_54_50ms.U3T54_age.phys = @sysvar::MsgU3T_Obj_54_50ms::SigU3T54_age;
   Msg_U3T_Obj_54_50ms.U3T54_f_moveable.phys = @sysvar::MsgU3T_Obj_54_50ms::SigU3T54_f_moveable;
   Msg_U3T_Obj_54_50ms.U3T54_f_stationary.phys = @sysvar::MsgU3T_Obj_54_50ms::SigU3T54_f_stationary;
   Msg_U3T_Obj_54_50ms.U3T54_FLcorner_lat.phys = @sysvar::MsgU3T_Obj_54_50ms::SigU3T54_FLcorner_lat;
   Msg_U3T_Obj_54_50ms.U3T54_object_class.phys = @sysvar::MsgU3T_Obj_54_50ms::SigU3T54_object_class;
   Msg_U3T_Obj_54_50ms.U3T54_FLcorner_long.phys = @sysvar::MsgU3T_Obj_54_50ms::SigU3T54_FLcorner_long;
   Msg_U3T_Obj_54_50ms.U3T54_status.phys = @sysvar::MsgU3T_Obj_54_50ms::SigU3T54_status;
   Msg_U3T_Obj_54_50ms.U3T54_FRcorner_lat.phys = @sysvar::MsgU3T_Obj_54_50ms::SigU3T54_FRcorner_lat;
   Msg_U3T_Obj_54_50ms.U3T54_FRcorner_long.phys = @sysvar::MsgU3T_Obj_54_50ms::SigU3T54_FRcorner_long;
   Msg_U3T_Obj_54_50ms.U3T54_heading_rate.phys = @sysvar::MsgU3T_Obj_54_50ms::SigU3T54_heading_rate;
   Msg_U3T_Obj_54_50ms.U3T54_id.phys = @sysvar::MsgU3T_Obj_54_50ms::SigU3T54_id;
   Msg_U3T_Obj_54_50ms.U3T54_length.phys = @sysvar::MsgU3T_Obj_54_50ms::SigU3T54_length;
   Msg_U3T_Obj_54_50ms.U3T54_RLcorner_lat.phys = @sysvar::MsgU3T_Obj_54_50ms::SigU3T54_RLcorner_lat;
   Msg_U3T_Obj_54_50ms.U3T54_RLcorner_long.phys = @sysvar::MsgU3T_Obj_54_50ms::SigU3T54_RLcorner_long;
   Msg_U3T_Obj_54_50ms.U3T54_RRcorner_lat.phys = @sysvar::MsgU3T_Obj_54_50ms::SigU3T54_RRcorner_lat;
   Msg_U3T_Obj_54_50ms.U3T54_RRcorner_long.phys = @sysvar::MsgU3T_Obj_54_50ms::SigU3T54_RRcorner_long;
   Msg_U3T_Obj_54_50ms.U3T54_speed.phys = @sysvar::MsgU3T_Obj_54_50ms::SigU3T54_speed;
   Msg_U3T_Obj_54_50ms.U3T54_width.phys = @sysvar::MsgU3T_Obj_54_50ms::SigU3T54_width;
   Msg_U3T_Obj_54_50ms.U3T54_fusion_source.phys = @sysvar::MsgU3T_Obj_54_50ms::SigU3T54_fusion_source;
   Msg_U3T_Obj_54_50ms.U3T54_vcs_heading.phys = @sysvar::MsgU3T_Obj_54_50ms::SigU3T54_vcs_heading;
   Msg_U3T_Obj_54_50ms.U3T54_vcs_lat_accel.phys = @sysvar::MsgU3T_Obj_54_50ms::SigU3T54_vcs_lat_accel;
   Msg_U3T_Obj_54_50ms.U3T54_vcs_lat_posn.phys = @sysvar::MsgU3T_Obj_54_50ms::SigU3T54_vcs_lat_posn;
   Msg_U3T_Obj_54_50ms.U3T54_vcs_lat_vel.phys = @sysvar::MsgU3T_Obj_54_50ms::SigU3T54_vcs_lat_vel;
   Msg_U3T_Obj_54_50ms.U3T54_vcs_long_accel.phys = @sysvar::MsgU3T_Obj_54_50ms::SigU3T54_vcs_long_accel;
   Msg_U3T_Obj_54_50ms.U3T54_vcs_long_posn.phys = @sysvar::MsgU3T_Obj_54_50ms::SigU3T54_vcs_long_posn;
   Msg_U3T_Obj_54_50ms.U3T54_vcs_long_vel.phys = @sysvar::MsgU3T_Obj_54_50ms::SigU3T54_vcs_long_vel;
   Msg_U3T_Obj_54_50ms.U3T54_conf_overall.phys = @sysvar::MsgU3T_Obj_54_50ms::SigU3T54_conf_overall;
   Msg_U3T_Obj_54_50ms.U3T54_f_oncoming.phys = @sysvar::MsgU3T_Obj_54_50ms::SigU3T54_f_oncoming;
   Msg_U3T_Obj_54_50ms.U3T54_f_receding.phys = @sysvar::MsgU3T_Obj_54_50ms::SigU3T54_f_receding;
   output(Msg_U3T_Obj_54_50ms);
   Msg_U3T_Obj_53_50ms.U3T53_age.phys = @sysvar::MsgU3T_Obj_53_50ms::SigU3T53_age;
   Msg_U3T_Obj_53_50ms.U3T53_f_moveable.phys = @sysvar::MsgU3T_Obj_53_50ms::SigU3T53_f_moveable;
   Msg_U3T_Obj_53_50ms.U3T53_f_stationary.phys = @sysvar::MsgU3T_Obj_53_50ms::SigU3T53_f_stationary;
   Msg_U3T_Obj_53_50ms.U3T53_FLcorner_lat.phys = @sysvar::MsgU3T_Obj_53_50ms::SigU3T53_FLcorner_lat;
   Msg_U3T_Obj_53_50ms.U3T53_object_class.phys = @sysvar::MsgU3T_Obj_53_50ms::SigU3T53_object_class;
   Msg_U3T_Obj_53_50ms.U3T53_FLcorner_long.phys = @sysvar::MsgU3T_Obj_53_50ms::SigU3T53_FLcorner_long;
   Msg_U3T_Obj_53_50ms.U3T53_status.phys = @sysvar::MsgU3T_Obj_53_50ms::SigU3T53_status;
   Msg_U3T_Obj_53_50ms.U3T53_FRcorner_lat.phys = @sysvar::MsgU3T_Obj_53_50ms::SigU3T53_FRcorner_lat;
   Msg_U3T_Obj_53_50ms.U3T53_FRcorner_long.phys = @sysvar::MsgU3T_Obj_53_50ms::SigU3T53_FRcorner_long;
   Msg_U3T_Obj_53_50ms.U3T53_heading_rate.phys = @sysvar::MsgU3T_Obj_53_50ms::SigU3T53_heading_rate;
   Msg_U3T_Obj_53_50ms.U3T53_id.phys = @sysvar::MsgU3T_Obj_53_50ms::SigU3T53_id;
   Msg_U3T_Obj_53_50ms.U3T53_length.phys = @sysvar::MsgU3T_Obj_53_50ms::SigU3T53_length;
   Msg_U3T_Obj_53_50ms.U3T53_RLcorner_lat.phys = @sysvar::MsgU3T_Obj_53_50ms::SigU3T53_RLcorner_lat;
   Msg_U3T_Obj_53_50ms.U3T53_RLcorner_long.phys = @sysvar::MsgU3T_Obj_53_50ms::SigU3T53_RLcorner_long;
   Msg_U3T_Obj_53_50ms.U3T53_RRcorner_lat.phys = @sysvar::MsgU3T_Obj_53_50ms::SigU3T53_RRcorner_lat;
   Msg_U3T_Obj_53_50ms.U3T53_RRcorner_long.phys = @sysvar::MsgU3T_Obj_53_50ms::SigU3T53_RRcorner_long;
   Msg_U3T_Obj_53_50ms.U3T53_speed.phys = @sysvar::MsgU3T_Obj_53_50ms::SigU3T53_speed;
   Msg_U3T_Obj_53_50ms.U3T53_width.phys = @sysvar::MsgU3T_Obj_53_50ms::SigU3T53_width;
   Msg_U3T_Obj_53_50ms.U3T53_fusion_source.phys = @sysvar::MsgU3T_Obj_53_50ms::SigU3T53_fusion_source;
   Msg_U3T_Obj_53_50ms.U3T53_vcs_heading.phys = @sysvar::MsgU3T_Obj_53_50ms::SigU3T53_vcs_heading;
   Msg_U3T_Obj_53_50ms.U3T53_vcs_lat_accel.phys = @sysvar::MsgU3T_Obj_53_50ms::SigU3T53_vcs_lat_accel;
   Msg_U3T_Obj_53_50ms.U3T53_vcs_lat_posn.phys = @sysvar::MsgU3T_Obj_53_50ms::SigU3T53_vcs_lat_posn;
   Msg_U3T_Obj_53_50ms.U3T53_vcs_lat_vel.phys = @sysvar::MsgU3T_Obj_53_50ms::SigU3T53_vcs_lat_vel;
   Msg_U3T_Obj_53_50ms.U3T53_vcs_long_accel.phys = @sysvar::MsgU3T_Obj_53_50ms::SigU3T53_vcs_long_accel;
   Msg_U3T_Obj_53_50ms.U3T53_vcs_long_posn.phys = @sysvar::MsgU3T_Obj_53_50ms::SigU3T53_vcs_long_posn;
   Msg_U3T_Obj_53_50ms.U3T53_vcs_long_vel.phys = @sysvar::MsgU3T_Obj_53_50ms::SigU3T53_vcs_long_vel;
   Msg_U3T_Obj_53_50ms.U3T53_conf_overall.phys = @sysvar::MsgU3T_Obj_53_50ms::SigU3T53_conf_overall;
   Msg_U3T_Obj_53_50ms.U3T53_f_oncoming.phys = @sysvar::MsgU3T_Obj_53_50ms::SigU3T53_f_oncoming;
   Msg_U3T_Obj_53_50ms.U3T53_f_receding.phys = @sysvar::MsgU3T_Obj_53_50ms::SigU3T53_f_receding;
   output(Msg_U3T_Obj_53_50ms);
   Msg_U3T_Obj_51_50ms.U3T51_age.phys = @sysvar::MsgU3T_Obj_51_50ms::SigU3T51_age;
   Msg_U3T_Obj_51_50ms.U3T51_f_moveable.phys = @sysvar::MsgU3T_Obj_51_50ms::SigU3T51_f_moveable;
   Msg_U3T_Obj_51_50ms.U3T51_f_stationary.phys = @sysvar::MsgU3T_Obj_51_50ms::SigU3T51_f_stationary;
   Msg_U3T_Obj_51_50ms.U3T51_FLcorner_lat.phys = @sysvar::MsgU3T_Obj_51_50ms::SigU3T51_FLcorner_lat;
   Msg_U3T_Obj_51_50ms.U3T51_object_class.phys = @sysvar::MsgU3T_Obj_51_50ms::SigU3T51_object_class;
   Msg_U3T_Obj_51_50ms.U3T51_FLcorner_long.phys = @sysvar::MsgU3T_Obj_51_50ms::SigU3T51_FLcorner_long;
   Msg_U3T_Obj_51_50ms.U3T51_status.phys = @sysvar::MsgU3T_Obj_51_50ms::SigU3T51_status;
   Msg_U3T_Obj_51_50ms.U3T51_FRcorner_lat.phys = @sysvar::MsgU3T_Obj_51_50ms::SigU3T51_FRcorner_lat;
   Msg_U3T_Obj_51_50ms.U3T51_FRcorner_long.phys = @sysvar::MsgU3T_Obj_51_50ms::SigU3T51_FRcorner_long;
   Msg_U3T_Obj_51_50ms.U3T51_heading_rate.phys = @sysvar::MsgU3T_Obj_51_50ms::SigU3T51_heading_rate;
   Msg_U3T_Obj_51_50ms.U3T51_id.phys = @sysvar::MsgU3T_Obj_51_50ms::SigU3T51_id;
   Msg_U3T_Obj_51_50ms.U3T51_length.phys = @sysvar::MsgU3T_Obj_51_50ms::SigU3T51_length;
   Msg_U3T_Obj_51_50ms.U3T51_RLcorner_lat.phys = @sysvar::MsgU3T_Obj_51_50ms::SigU3T51_RLcorner_lat;
   Msg_U3T_Obj_51_50ms.U3T51_RLcorner_long.phys = @sysvar::MsgU3T_Obj_51_50ms::SigU3T51_RLcorner_long;
   Msg_U3T_Obj_51_50ms.U3T51_RRcorner_lat.phys = @sysvar::MsgU3T_Obj_51_50ms::SigU3T51_RRcorner_lat;
   Msg_U3T_Obj_51_50ms.U3T51_RRcorner_long.phys = @sysvar::MsgU3T_Obj_51_50ms::SigU3T51_RRcorner_long;
   Msg_U3T_Obj_51_50ms.U3T51_speed.phys = @sysvar::MsgU3T_Obj_51_50ms::SigU3T51_speed;
   Msg_U3T_Obj_51_50ms.U3T51_width.phys = @sysvar::MsgU3T_Obj_51_50ms::SigU3T51_width;
   Msg_U3T_Obj_51_50ms.U3T51_fusion_source.phys = @sysvar::MsgU3T_Obj_51_50ms::SigU3T51_fusion_source;
   Msg_U3T_Obj_51_50ms.U3T51_vcs_heading.phys = @sysvar::MsgU3T_Obj_51_50ms::SigU3T51_vcs_heading;
   Msg_U3T_Obj_51_50ms.U3T51_vcs_lat_accel.phys = @sysvar::MsgU3T_Obj_51_50ms::SigU3T51_vcs_lat_accel;
   Msg_U3T_Obj_51_50ms.U3T51_vcs_lat_posn.phys = @sysvar::MsgU3T_Obj_51_50ms::SigU3T51_vcs_lat_posn;
   Msg_U3T_Obj_51_50ms.U3T51_vcs_lat_vel.phys = @sysvar::MsgU3T_Obj_51_50ms::SigU3T51_vcs_lat_vel;
   Msg_U3T_Obj_51_50ms.U3T51_vcs_long_accel.phys = @sysvar::MsgU3T_Obj_51_50ms::SigU3T51_vcs_long_accel;
   Msg_U3T_Obj_51_50ms.U3T51_vcs_long_posn.phys = @sysvar::MsgU3T_Obj_51_50ms::SigU3T51_vcs_long_posn;
   Msg_U3T_Obj_51_50ms.U3T51_vcs_long_vel.phys = @sysvar::MsgU3T_Obj_51_50ms::SigU3T51_vcs_long_vel;
   Msg_U3T_Obj_51_50ms.U3T51_conf_overall.phys = @sysvar::MsgU3T_Obj_51_50ms::SigU3T51_conf_overall;
   Msg_U3T_Obj_51_50ms.U3T51_f_oncoming.phys = @sysvar::MsgU3T_Obj_51_50ms::SigU3T51_f_oncoming;
   Msg_U3T_Obj_51_50ms.U3T51_f_receding.phys = @sysvar::MsgU3T_Obj_51_50ms::SigU3T51_f_receding;
   output(Msg_U3T_Obj_51_50ms);
   Msg_U3T_Obj_42_50ms.U3T42_age.phys = @sysvar::MsgU3T_Obj_42_50ms::SigU3T42_age;
   Msg_U3T_Obj_42_50ms.U3T42_f_moveable.phys = @sysvar::MsgU3T_Obj_42_50ms::SigU3T42_f_moveable;
   Msg_U3T_Obj_42_50ms.U3T42_f_stationary.phys = @sysvar::MsgU3T_Obj_42_50ms::SigU3T42_f_stationary;
   Msg_U3T_Obj_42_50ms.U3T42_FLcorner_lat.phys = @sysvar::MsgU3T_Obj_42_50ms::SigU3T42_FLcorner_lat;
   Msg_U3T_Obj_42_50ms.U3T42_object_class.phys = @sysvar::MsgU3T_Obj_42_50ms::SigU3T42_object_class;
   Msg_U3T_Obj_42_50ms.U3T42_FLcorner_long.phys = @sysvar::MsgU3T_Obj_42_50ms::SigU3T42_FLcorner_long;
   Msg_U3T_Obj_42_50ms.U3T42_status.phys = @sysvar::MsgU3T_Obj_42_50ms::SigU3T42_status;
   Msg_U3T_Obj_42_50ms.U3T42_FRcorner_lat.phys = @sysvar::MsgU3T_Obj_42_50ms::SigU3T42_FRcorner_lat;
   Msg_U3T_Obj_42_50ms.U3T42_FRcorner_long.phys = @sysvar::MsgU3T_Obj_42_50ms::SigU3T42_FRcorner_long;
   Msg_U3T_Obj_42_50ms.U3T42_heading_rate.phys = @sysvar::MsgU3T_Obj_42_50ms::SigU3T42_heading_rate;
   Msg_U3T_Obj_42_50ms.U3T42_id.phys = @sysvar::MsgU3T_Obj_42_50ms::SigU3T42_id;
   Msg_U3T_Obj_42_50ms.U3T42_length.phys = @sysvar::MsgU3T_Obj_42_50ms::SigU3T42_length;
   Msg_U3T_Obj_42_50ms.U3T42_RLcorner_lat.phys = @sysvar::MsgU3T_Obj_42_50ms::SigU3T42_RLcorner_lat;
   Msg_U3T_Obj_42_50ms.U3T42_RLcorner_long.phys = @sysvar::MsgU3T_Obj_42_50ms::SigU3T42_RLcorner_long;
   Msg_U3T_Obj_42_50ms.U3T42_RRcorner_lat.phys = @sysvar::MsgU3T_Obj_42_50ms::SigU3T42_RRcorner_lat;
   Msg_U3T_Obj_42_50ms.U3T42_RRcorner_long.phys = @sysvar::MsgU3T_Obj_42_50ms::SigU3T42_RRcorner_long;
   Msg_U3T_Obj_42_50ms.U3T42_speed.phys = @sysvar::MsgU3T_Obj_42_50ms::SigU3T42_speed;
   Msg_U3T_Obj_42_50ms.U3T42_width.phys = @sysvar::MsgU3T_Obj_42_50ms::SigU3T42_width;
   Msg_U3T_Obj_42_50ms.U3T42_fusion_source.phys = @sysvar::MsgU3T_Obj_42_50ms::SigU3T42_fusion_source;
   Msg_U3T_Obj_42_50ms.U3T42_vcs_heading.phys = @sysvar::MsgU3T_Obj_42_50ms::SigU3T42_vcs_heading;
   Msg_U3T_Obj_42_50ms.U3T42_vcs_lat_accel.phys = @sysvar::MsgU3T_Obj_42_50ms::SigU3T42_vcs_lat_accel;
   Msg_U3T_Obj_42_50ms.U3T42_vcs_lat_posn.phys = @sysvar::MsgU3T_Obj_42_50ms::SigU3T42_vcs_lat_posn;
   Msg_U3T_Obj_42_50ms.U3T42_vcs_lat_vel.phys = @sysvar::MsgU3T_Obj_42_50ms::SigU3T42_vcs_lat_vel;
   Msg_U3T_Obj_42_50ms.U3T42_vcs_long_accel.phys = @sysvar::MsgU3T_Obj_42_50ms::SigU3T42_vcs_long_accel;
   Msg_U3T_Obj_42_50ms.U3T42_vcs_long_posn.phys = @sysvar::MsgU3T_Obj_42_50ms::SigU3T42_vcs_long_posn;
   Msg_U3T_Obj_42_50ms.U3T42_vcs_long_vel.phys = @sysvar::MsgU3T_Obj_42_50ms::SigU3T42_vcs_long_vel;
   Msg_U3T_Obj_42_50ms.U3T42_conf_overall.phys = @sysvar::MsgU3T_Obj_42_50ms::SigU3T42_conf_overall;
   Msg_U3T_Obj_42_50ms.U3T42_f_oncoming.phys = @sysvar::MsgU3T_Obj_42_50ms::SigU3T42_f_oncoming;
   Msg_U3T_Obj_42_50ms.U3T42_f_receding.phys = @sysvar::MsgU3T_Obj_42_50ms::SigU3T42_f_receding;
   output(Msg_U3T_Obj_42_50ms);
   Msg_U3T_Obj_50_50ms.U3T50_age.phys = @sysvar::MsgU3T_Obj_50_50ms::SigU3T50_age;
   Msg_U3T_Obj_50_50ms.U3T50_f_moveable.phys = @sysvar::MsgU3T_Obj_50_50ms::SigU3T50_f_moveable;
   Msg_U3T_Obj_50_50ms.U3T50_f_stationary.phys = @sysvar::MsgU3T_Obj_50_50ms::SigU3T50_f_stationary;
   Msg_U3T_Obj_50_50ms.U3T50_FLcorner_lat.phys = @sysvar::MsgU3T_Obj_50_50ms::SigU3T50_FLcorner_lat;
   Msg_U3T_Obj_50_50ms.U3T50_object_class.phys = @sysvar::MsgU3T_Obj_50_50ms::SigU3T50_object_class;
   Msg_U3T_Obj_50_50ms.U3T50_FLcorner_long.phys = @sysvar::MsgU3T_Obj_50_50ms::SigU3T50_FLcorner_long;
   Msg_U3T_Obj_50_50ms.U3T50_status.phys = @sysvar::MsgU3T_Obj_50_50ms::SigU3T50_status;
   Msg_U3T_Obj_50_50ms.U3T50_FRcorner_lat.phys = @sysvar::MsgU3T_Obj_50_50ms::SigU3T50_FRcorner_lat;
   Msg_U3T_Obj_50_50ms.U3T50_FRcorner_long.phys = @sysvar::MsgU3T_Obj_50_50ms::SigU3T50_FRcorner_long;
   Msg_U3T_Obj_50_50ms.U3T50_heading_rate.phys = @sysvar::MsgU3T_Obj_50_50ms::SigU3T50_heading_rate;
   Msg_U3T_Obj_50_50ms.U3T50_id.phys = @sysvar::MsgU3T_Obj_50_50ms::SigU3T50_id;
   Msg_U3T_Obj_50_50ms.U3T50_length.phys = @sysvar::MsgU3T_Obj_50_50ms::SigU3T50_length;
   Msg_U3T_Obj_50_50ms.U3T50_RLcorner_lat.phys = @sysvar::MsgU3T_Obj_50_50ms::SigU3T50_RLcorner_lat;
   Msg_U3T_Obj_50_50ms.U3T50_RLcorner_long.phys = @sysvar::MsgU3T_Obj_50_50ms::SigU3T50_RLcorner_long;
   Msg_U3T_Obj_50_50ms.U3T50_RRcorner_lat.phys = @sysvar::MsgU3T_Obj_50_50ms::SigU3T50_RRcorner_lat;
   Msg_U3T_Obj_50_50ms.U3T50_RRcorner_long.phys = @sysvar::MsgU3T_Obj_50_50ms::SigU3T50_RRcorner_long;
   Msg_U3T_Obj_50_50ms.U3T50_speed.phys = @sysvar::MsgU3T_Obj_50_50ms::SigU3T50_speed;
   Msg_U3T_Obj_50_50ms.U3T50_width.phys = @sysvar::MsgU3T_Obj_50_50ms::SigU3T50_width;
   Msg_U3T_Obj_50_50ms.U3T50_fusion_source.phys = @sysvar::MsgU3T_Obj_50_50ms::SigU3T50_fusion_source;
   Msg_U3T_Obj_50_50ms.U3T50_vcs_heading.phys = @sysvar::MsgU3T_Obj_50_50ms::SigU3T50_vcs_heading;
   Msg_U3T_Obj_50_50ms.U3T50_vcs_lat_accel.phys = @sysvar::MsgU3T_Obj_50_50ms::SigU3T50_vcs_lat_accel;
   Msg_U3T_Obj_50_50ms.U3T50_vcs_lat_posn.phys = @sysvar::MsgU3T_Obj_50_50ms::SigU3T50_vcs_lat_posn;
   Msg_U3T_Obj_50_50ms.U3T50_vcs_lat_vel.phys = @sysvar::MsgU3T_Obj_50_50ms::SigU3T50_vcs_lat_vel;
   Msg_U3T_Obj_50_50ms.U3T50_vcs_long_accel.phys = @sysvar::MsgU3T_Obj_50_50ms::SigU3T50_vcs_long_accel;
   Msg_U3T_Obj_50_50ms.U3T50_vcs_long_posn.phys = @sysvar::MsgU3T_Obj_50_50ms::SigU3T50_vcs_long_posn;
   Msg_U3T_Obj_50_50ms.U3T50_vcs_long_vel.phys = @sysvar::MsgU3T_Obj_50_50ms::SigU3T50_vcs_long_vel;
   Msg_U3T_Obj_50_50ms.U3T50_conf_overall.phys = @sysvar::MsgU3T_Obj_50_50ms::SigU3T50_conf_overall;
   Msg_U3T_Obj_50_50ms.U3T50_f_oncoming.phys = @sysvar::MsgU3T_Obj_50_50ms::SigU3T50_f_oncoming;
   Msg_U3T_Obj_50_50ms.U3T50_f_receding.phys = @sysvar::MsgU3T_Obj_50_50ms::SigU3T50_f_receding;
   output(Msg_U3T_Obj_50_50ms);
   Msg_U3T_Obj_49_50ms.U3T49_age.phys = @sysvar::MsgU3T_Obj_49_50ms::SigU3T49_age;
   Msg_U3T_Obj_49_50ms.U3T49_f_moveable.phys = @sysvar::MsgU3T_Obj_49_50ms::SigU3T49_f_moveable;
   Msg_U3T_Obj_49_50ms.U3T49_f_stationary.phys = @sysvar::MsgU3T_Obj_49_50ms::SigU3T49_f_stationary;
   Msg_U3T_Obj_49_50ms.U3T49_FLcorner_lat.phys = @sysvar::MsgU3T_Obj_49_50ms::SigU3T49_FLcorner_lat;
   Msg_U3T_Obj_49_50ms.U3T49_object_class.phys = @sysvar::MsgU3T_Obj_49_50ms::SigU3T49_object_class;
   Msg_U3T_Obj_49_50ms.U3T49_FLcorner_long.phys = @sysvar::MsgU3T_Obj_49_50ms::SigU3T49_FLcorner_long;
   Msg_U3T_Obj_49_50ms.U3T49_status.phys = @sysvar::MsgU3T_Obj_49_50ms::SigU3T49_status;
   Msg_U3T_Obj_49_50ms.U3T49_FRcorner_lat.phys = @sysvar::MsgU3T_Obj_49_50ms::SigU3T49_FRcorner_lat;
   Msg_U3T_Obj_49_50ms.U3T49_FRcorner_long.phys = @sysvar::MsgU3T_Obj_49_50ms::SigU3T49_FRcorner_long;
   Msg_U3T_Obj_49_50ms.U3T49_heading_rate.phys = @sysvar::MsgU3T_Obj_49_50ms::SigU3T49_heading_rate;
   Msg_U3T_Obj_49_50ms.U3T49_id.phys = @sysvar::MsgU3T_Obj_49_50ms::SigU3T49_id;
   Msg_U3T_Obj_49_50ms.U3T49_length.phys = @sysvar::MsgU3T_Obj_49_50ms::SigU3T49_length;
   Msg_U3T_Obj_49_50ms.U3T49_RLcorner_lat.phys = @sysvar::MsgU3T_Obj_49_50ms::SigU3T49_RLcorner_lat;
   Msg_U3T_Obj_49_50ms.U3T49_RLcorner_long.phys = @sysvar::MsgU3T_Obj_49_50ms::SigU3T49_RLcorner_long;
   Msg_U3T_Obj_49_50ms.U3T49_RRcorner_lat.phys = @sysvar::MsgU3T_Obj_49_50ms::SigU3T49_RRcorner_lat;
   Msg_U3T_Obj_49_50ms.U3T49_RRcorner_long.phys = @sysvar::MsgU3T_Obj_49_50ms::SigU3T49_RRcorner_long;
   Msg_U3T_Obj_49_50ms.U3T49_speed.phys = @sysvar::MsgU3T_Obj_49_50ms::SigU3T49_speed;
   Msg_U3T_Obj_49_50ms.U3T49_width.phys = @sysvar::MsgU3T_Obj_49_50ms::SigU3T49_width;
   Msg_U3T_Obj_49_50ms.U3T49_fusion_source.phys = @sysvar::MsgU3T_Obj_49_50ms::SigU3T49_fusion_source;
   Msg_U3T_Obj_49_50ms.U3T49_vcs_heading.phys = @sysvar::MsgU3T_Obj_49_50ms::SigU3T49_vcs_heading;
   Msg_U3T_Obj_49_50ms.U3T49_vcs_lat_accel.phys = @sysvar::MsgU3T_Obj_49_50ms::SigU3T49_vcs_lat_accel;
   Msg_U3T_Obj_49_50ms.U3T49_vcs_lat_posn.phys = @sysvar::MsgU3T_Obj_49_50ms::SigU3T49_vcs_lat_posn;
   Msg_U3T_Obj_49_50ms.U3T49_vcs_lat_vel.phys = @sysvar::MsgU3T_Obj_49_50ms::SigU3T49_vcs_lat_vel;
   Msg_U3T_Obj_49_50ms.U3T49_vcs_long_accel.phys = @sysvar::MsgU3T_Obj_49_50ms::SigU3T49_vcs_long_accel;
   Msg_U3T_Obj_49_50ms.U3T49_vcs_long_posn.phys = @sysvar::MsgU3T_Obj_49_50ms::SigU3T49_vcs_long_posn;
   Msg_U3T_Obj_49_50ms.U3T49_vcs_long_vel.phys = @sysvar::MsgU3T_Obj_49_50ms::SigU3T49_vcs_long_vel;
   Msg_U3T_Obj_49_50ms.U3T49_conf_overall.phys = @sysvar::MsgU3T_Obj_49_50ms::SigU3T49_conf_overall;
   Msg_U3T_Obj_49_50ms.U3T49_f_oncoming.phys = @sysvar::MsgU3T_Obj_49_50ms::SigU3T49_f_oncoming;
   Msg_U3T_Obj_49_50ms.U3T49_f_receding.phys = @sysvar::MsgU3T_Obj_49_50ms::SigU3T49_f_receding;
   output(Msg_U3T_Obj_49_50ms);
   Msg_U3T_Obj_48_50ms.U3T48_age.phys = @sysvar::MsgU3T_Obj_48_50ms::SigU3T48_age;
   Msg_U3T_Obj_48_50ms.U3T48_f_moveable.phys = @sysvar::MsgU3T_Obj_48_50ms::SigU3T48_f_moveable;
   Msg_U3T_Obj_48_50ms.U3T48_f_stationary.phys = @sysvar::MsgU3T_Obj_48_50ms::SigU3T48_f_stationary;
   Msg_U3T_Obj_48_50ms.U3T48_FLcorner_lat.phys = @sysvar::MsgU3T_Obj_48_50ms::SigU3T48_FLcorner_lat;
   Msg_U3T_Obj_48_50ms.U3T48_object_class.phys = @sysvar::MsgU3T_Obj_48_50ms::SigU3T48_object_class;
   Msg_U3T_Obj_48_50ms.U3T48_FLcorner_long.phys = @sysvar::MsgU3T_Obj_48_50ms::SigU3T48_FLcorner_long;
   Msg_U3T_Obj_48_50ms.U3T48_status.phys = @sysvar::MsgU3T_Obj_48_50ms::SigU3T48_status;
   Msg_U3T_Obj_48_50ms.U3T48_FRcorner_lat.phys = @sysvar::MsgU3T_Obj_48_50ms::SigU3T48_FRcorner_lat;
   Msg_U3T_Obj_48_50ms.U3T48_FRcorner_long.phys = @sysvar::MsgU3T_Obj_48_50ms::SigU3T48_FRcorner_long;
   Msg_U3T_Obj_48_50ms.U3T48_heading_rate.phys = @sysvar::MsgU3T_Obj_48_50ms::SigU3T48_heading_rate;
   Msg_U3T_Obj_48_50ms.U3T48_id.phys = @sysvar::MsgU3T_Obj_48_50ms::SigU3T48_id;
   Msg_U3T_Obj_48_50ms.U3T48_length.phys = @sysvar::MsgU3T_Obj_48_50ms::SigU3T48_length;
   Msg_U3T_Obj_48_50ms.U3T48_RLcorner_lat.phys = @sysvar::MsgU3T_Obj_48_50ms::SigU3T48_RLcorner_lat;
   Msg_U3T_Obj_48_50ms.U3T48_RLcorner_long.phys = @sysvar::MsgU3T_Obj_48_50ms::SigU3T48_RLcorner_long;
   Msg_U3T_Obj_48_50ms.U3T48_RRcorner_lat.phys = @sysvar::MsgU3T_Obj_48_50ms::SigU3T48_RRcorner_lat;
   Msg_U3T_Obj_48_50ms.U3T48_RRcorner_long.phys = @sysvar::MsgU3T_Obj_48_50ms::SigU3T48_RRcorner_long;
   Msg_U3T_Obj_48_50ms.U3T48_speed.phys = @sysvar::MsgU3T_Obj_48_50ms::SigU3T48_speed;
   Msg_U3T_Obj_48_50ms.U3T48_width.phys = @sysvar::MsgU3T_Obj_48_50ms::SigU3T48_width;
   Msg_U3T_Obj_48_50ms.U3T48_fusion_source.phys = @sysvar::MsgU3T_Obj_48_50ms::SigU3T48_fusion_source;
   Msg_U3T_Obj_48_50ms.U3T48_vcs_heading.phys = @sysvar::MsgU3T_Obj_48_50ms::SigU3T48_vcs_heading;
   Msg_U3T_Obj_48_50ms.U3T48_vcs_lat_accel.phys = @sysvar::MsgU3T_Obj_48_50ms::SigU3T48_vcs_lat_accel;
   Msg_U3T_Obj_48_50ms.U3T48_vcs_lat_posn.phys = @sysvar::MsgU3T_Obj_48_50ms::SigU3T48_vcs_lat_posn;
   Msg_U3T_Obj_48_50ms.U3T48_vcs_lat_vel.phys = @sysvar::MsgU3T_Obj_48_50ms::SigU3T48_vcs_lat_vel;
   Msg_U3T_Obj_48_50ms.U3T48_vcs_long_accel.phys = @sysvar::MsgU3T_Obj_48_50ms::SigU3T48_vcs_long_accel;
   Msg_U3T_Obj_48_50ms.U3T48_vcs_long_posn.phys = @sysvar::MsgU3T_Obj_48_50ms::SigU3T48_vcs_long_posn;
   Msg_U3T_Obj_48_50ms.U3T48_vcs_long_vel.phys = @sysvar::MsgU3T_Obj_48_50ms::SigU3T48_vcs_long_vel;
   Msg_U3T_Obj_48_50ms.U3T48_conf_overall.phys = @sysvar::MsgU3T_Obj_48_50ms::SigU3T48_conf_overall;
   Msg_U3T_Obj_48_50ms.U3T48_f_oncoming.phys = @sysvar::MsgU3T_Obj_48_50ms::SigU3T48_f_oncoming;
   Msg_U3T_Obj_48_50ms.U3T48_f_receding.phys = @sysvar::MsgU3T_Obj_48_50ms::SigU3T48_f_receding;
   output(Msg_U3T_Obj_48_50ms);
   Msg_U3T_Obj_47_50ms.U3T47_age.phys = @sysvar::MsgU3T_Obj_47_50ms::SigU3T47_age;
   Msg_U3T_Obj_47_50ms.U3T47_f_moveable.phys = @sysvar::MsgU3T_Obj_47_50ms::SigU3T47_f_moveable;
   Msg_U3T_Obj_47_50ms.U3T47_f_stationary.phys = @sysvar::MsgU3T_Obj_47_50ms::SigU3T47_f_stationary;
   Msg_U3T_Obj_47_50ms.U3T47_FLcorner_lat.phys = @sysvar::MsgU3T_Obj_47_50ms::SigU3T47_FLcorner_lat;
   Msg_U3T_Obj_47_50ms.U3T47_object_class.phys = @sysvar::MsgU3T_Obj_47_50ms::SigU3T47_object_class;
   Msg_U3T_Obj_47_50ms.U3T47_FLcorner_long.phys = @sysvar::MsgU3T_Obj_47_50ms::SigU3T47_FLcorner_long;
   Msg_U3T_Obj_47_50ms.U3T47_status.phys = @sysvar::MsgU3T_Obj_47_50ms::SigU3T47_status;
   Msg_U3T_Obj_47_50ms.U3T47_FRcorner_lat.phys = @sysvar::MsgU3T_Obj_47_50ms::SigU3T47_FRcorner_lat;
   Msg_U3T_Obj_47_50ms.U3T47_FRcorner_long.phys = @sysvar::MsgU3T_Obj_47_50ms::SigU3T47_FRcorner_long;
   Msg_U3T_Obj_47_50ms.U3T47_heading_rate.phys = @sysvar::MsgU3T_Obj_47_50ms::SigU3T47_heading_rate;
   Msg_U3T_Obj_47_50ms.U3T47_id.phys = @sysvar::MsgU3T_Obj_47_50ms::SigU3T47_id;
   Msg_U3T_Obj_47_50ms.U3T47_length.phys = @sysvar::MsgU3T_Obj_47_50ms::SigU3T47_length;
   Msg_U3T_Obj_47_50ms.U3T47_RLcorner_lat.phys = @sysvar::MsgU3T_Obj_47_50ms::SigU3T47_RLcorner_lat;
   Msg_U3T_Obj_47_50ms.U3T47_RLcorner_long.phys = @sysvar::MsgU3T_Obj_47_50ms::SigU3T47_RLcorner_long;
   Msg_U3T_Obj_47_50ms.U3T47_RRcorner_lat.phys = @sysvar::MsgU3T_Obj_47_50ms::SigU3T47_RRcorner_lat;
   Msg_U3T_Obj_47_50ms.U3T47_RRcorner_long.phys = @sysvar::MsgU3T_Obj_47_50ms::SigU3T47_RRcorner_long;
   Msg_U3T_Obj_47_50ms.U3T47_speed.phys = @sysvar::MsgU3T_Obj_47_50ms::SigU3T47_speed;
   Msg_U3T_Obj_47_50ms.U3T47_width.phys = @sysvar::MsgU3T_Obj_47_50ms::SigU3T47_width;
   Msg_U3T_Obj_47_50ms.U3T47_fusion_source.phys = @sysvar::MsgU3T_Obj_47_50ms::SigU3T47_fusion_source;
   Msg_U3T_Obj_47_50ms.U3T47_vcs_heading.phys = @sysvar::MsgU3T_Obj_47_50ms::SigU3T47_vcs_heading;
   Msg_U3T_Obj_47_50ms.U3T47_vcs_lat_accel.phys = @sysvar::MsgU3T_Obj_47_50ms::SigU3T47_vcs_lat_accel;
   Msg_U3T_Obj_47_50ms.U3T47_vcs_lat_posn.phys = @sysvar::MsgU3T_Obj_47_50ms::SigU3T47_vcs_lat_posn;
   Msg_U3T_Obj_47_50ms.U3T47_vcs_lat_vel.phys = @sysvar::MsgU3T_Obj_47_50ms::SigU3T47_vcs_lat_vel;
   Msg_U3T_Obj_47_50ms.U3T47_vcs_long_accel.phys = @sysvar::MsgU3T_Obj_47_50ms::SigU3T47_vcs_long_accel;
   Msg_U3T_Obj_47_50ms.U3T47_vcs_long_posn.phys = @sysvar::MsgU3T_Obj_47_50ms::SigU3T47_vcs_long_posn;
   Msg_U3T_Obj_47_50ms.U3T47_vcs_long_vel.phys = @sysvar::MsgU3T_Obj_47_50ms::SigU3T47_vcs_long_vel;
   Msg_U3T_Obj_47_50ms.U3T47_conf_overall.phys = @sysvar::MsgU3T_Obj_47_50ms::SigU3T47_conf_overall;
   Msg_U3T_Obj_47_50ms.U3T47_f_oncoming.phys = @sysvar::MsgU3T_Obj_47_50ms::SigU3T47_f_oncoming;
   Msg_U3T_Obj_47_50ms.U3T47_f_receding.phys = @sysvar::MsgU3T_Obj_47_50ms::SigU3T47_f_receding;
   output(Msg_U3T_Obj_47_50ms);
   Msg_U3T_Obj_46_50ms.U3T46_age.phys = @sysvar::MsgU3T_Obj_46_50ms::SigU3T46_age;
   Msg_U3T_Obj_46_50ms.U3T46_f_moveable.phys = @sysvar::MsgU3T_Obj_46_50ms::SigU3T46_f_moveable;
   Msg_U3T_Obj_46_50ms.U3T46_f_stationary.phys = @sysvar::MsgU3T_Obj_46_50ms::SigU3T46_f_stationary;
   Msg_U3T_Obj_46_50ms.U3T46_FLcorner_lat.phys = @sysvar::MsgU3T_Obj_46_50ms::SigU3T46_FLcorner_lat;
   Msg_U3T_Obj_46_50ms.U3T46_object_class.phys = @sysvar::MsgU3T_Obj_46_50ms::SigU3T46_object_class;
   Msg_U3T_Obj_46_50ms.U3T46_FLcorner_long.phys = @sysvar::MsgU3T_Obj_46_50ms::SigU3T46_FLcorner_long;
   Msg_U3T_Obj_46_50ms.U3T46_status.phys = @sysvar::MsgU3T_Obj_46_50ms::SigU3T46_status;
   Msg_U3T_Obj_46_50ms.U3T46_FRcorner_lat.phys = @sysvar::MsgU3T_Obj_46_50ms::SigU3T46_FRcorner_lat;
   Msg_U3T_Obj_46_50ms.U3T46_FRcorner_long.phys = @sysvar::MsgU3T_Obj_46_50ms::SigU3T46_FRcorner_long;
   Msg_U3T_Obj_46_50ms.U3T46_heading_rate.phys = @sysvar::MsgU3T_Obj_46_50ms::SigU3T46_heading_rate;
   Msg_U3T_Obj_46_50ms.U3T46_id.phys = @sysvar::MsgU3T_Obj_46_50ms::SigU3T46_id;
   Msg_U3T_Obj_46_50ms.U3T46_length.phys = @sysvar::MsgU3T_Obj_46_50ms::SigU3T46_length;
   Msg_U3T_Obj_46_50ms.U3T46_RLcorner_lat.phys = @sysvar::MsgU3T_Obj_46_50ms::SigU3T46_RLcorner_lat;
   Msg_U3T_Obj_46_50ms.U3T46_RLcorner_long.phys = @sysvar::MsgU3T_Obj_46_50ms::SigU3T46_RLcorner_long;
   Msg_U3T_Obj_46_50ms.U3T46_RRcorner_lat.phys = @sysvar::MsgU3T_Obj_46_50ms::SigU3T46_RRcorner_lat;
   Msg_U3T_Obj_46_50ms.U3T46_RRcorner_long.phys = @sysvar::MsgU3T_Obj_46_50ms::SigU3T46_RRcorner_long;
   Msg_U3T_Obj_46_50ms.U3T46_speed.phys = @sysvar::MsgU3T_Obj_46_50ms::SigU3T46_speed;
   Msg_U3T_Obj_46_50ms.U3T46_width.phys = @sysvar::MsgU3T_Obj_46_50ms::SigU3T46_width;
   Msg_U3T_Obj_46_50ms.U3T46_fusion_source.phys = @sysvar::MsgU3T_Obj_46_50ms::SigU3T46_fusion_source;
   Msg_U3T_Obj_46_50ms.U3T46_vcs_heading.phys = @sysvar::MsgU3T_Obj_46_50ms::SigU3T46_vcs_heading;
   Msg_U3T_Obj_46_50ms.U3T46_vcs_lat_accel.phys = @sysvar::MsgU3T_Obj_46_50ms::SigU3T46_vcs_lat_accel;
   Msg_U3T_Obj_46_50ms.U3T46_vcs_lat_posn.phys = @sysvar::MsgU3T_Obj_46_50ms::SigU3T46_vcs_lat_posn;
   Msg_U3T_Obj_46_50ms.U3T46_vcs_lat_vel.phys = @sysvar::MsgU3T_Obj_46_50ms::SigU3T46_vcs_lat_vel;
   Msg_U3T_Obj_46_50ms.U3T46_vcs_long_accel.phys = @sysvar::MsgU3T_Obj_46_50ms::SigU3T46_vcs_long_accel;
   Msg_U3T_Obj_46_50ms.U3T46_vcs_long_posn.phys = @sysvar::MsgU3T_Obj_46_50ms::SigU3T46_vcs_long_posn;
   Msg_U3T_Obj_46_50ms.U3T46_vcs_long_vel.phys = @sysvar::MsgU3T_Obj_46_50ms::SigU3T46_vcs_long_vel;
   Msg_U3T_Obj_46_50ms.U3T46_conf_overall.phys = @sysvar::MsgU3T_Obj_46_50ms::SigU3T46_conf_overall;
   Msg_U3T_Obj_46_50ms.U3T46_f_oncoming.phys = @sysvar::MsgU3T_Obj_46_50ms::SigU3T46_f_oncoming;
   Msg_U3T_Obj_46_50ms.U3T46_f_receding.phys = @sysvar::MsgU3T_Obj_46_50ms::SigU3T46_f_receding;
   output(Msg_U3T_Obj_46_50ms);
   Msg_U3T_Obj_45_50ms.U3T45_age.phys = @sysvar::MsgU3T_Obj_45_50ms::SigU3T45_age;
   Msg_U3T_Obj_45_50ms.U3T45_f_moveable.phys = @sysvar::MsgU3T_Obj_45_50ms::SigU3T45_f_moveable;
   Msg_U3T_Obj_45_50ms.U3T45_f_stationary.phys = @sysvar::MsgU3T_Obj_45_50ms::SigU3T45_f_stationary;
   Msg_U3T_Obj_45_50ms.U3T45_FLcorner_lat.phys = @sysvar::MsgU3T_Obj_45_50ms::SigU3T45_FLcorner_lat;
   Msg_U3T_Obj_45_50ms.U3T45_object_class.phys = @sysvar::MsgU3T_Obj_45_50ms::SigU3T45_object_class;
   Msg_U3T_Obj_45_50ms.U3T45_FLcorner_long.phys = @sysvar::MsgU3T_Obj_45_50ms::SigU3T45_FLcorner_long;
   Msg_U3T_Obj_45_50ms.U3T45_status.phys = @sysvar::MsgU3T_Obj_45_50ms::SigU3T45_status;
   Msg_U3T_Obj_45_50ms.U3T45_FRcorner_lat.phys = @sysvar::MsgU3T_Obj_45_50ms::SigU3T45_FRcorner_lat;
   Msg_U3T_Obj_45_50ms.U3T45_FRcorner_long.phys = @sysvar::MsgU3T_Obj_45_50ms::SigU3T45_FRcorner_long;
   Msg_U3T_Obj_45_50ms.U3T45_heading_rate.phys = @sysvar::MsgU3T_Obj_45_50ms::SigU3T45_heading_rate;
   Msg_U3T_Obj_45_50ms.U3T45_id.phys = @sysvar::MsgU3T_Obj_45_50ms::SigU3T45_id;
   Msg_U3T_Obj_45_50ms.U3T45_length.phys = @sysvar::MsgU3T_Obj_45_50ms::SigU3T45_length;
   Msg_U3T_Obj_45_50ms.U3T45_RLcorner_lat.phys = @sysvar::MsgU3T_Obj_45_50ms::SigU3T45_RLcorner_lat;
   Msg_U3T_Obj_45_50ms.U3T45_RLcorner_long.phys = @sysvar::MsgU3T_Obj_45_50ms::SigU3T45_RLcorner_long;
   Msg_U3T_Obj_45_50ms.U3T45_RRcorner_lat.phys = @sysvar::MsgU3T_Obj_45_50ms::SigU3T45_RRcorner_lat;
   Msg_U3T_Obj_45_50ms.U3T45_RRcorner_long.phys = @sysvar::MsgU3T_Obj_45_50ms::SigU3T45_RRcorner_long;
   Msg_U3T_Obj_45_50ms.U3T45_speed.phys = @sysvar::MsgU3T_Obj_45_50ms::SigU3T45_speed;
   Msg_U3T_Obj_45_50ms.U3T45_width.phys = @sysvar::MsgU3T_Obj_45_50ms::SigU3T45_width;
   Msg_U3T_Obj_45_50ms.U3T45_fusion_source.phys = @sysvar::MsgU3T_Obj_45_50ms::SigU3T45_fusion_source;
   Msg_U3T_Obj_45_50ms.U3T45_vcs_heading.phys = @sysvar::MsgU3T_Obj_45_50ms::SigU3T45_vcs_heading;
   Msg_U3T_Obj_45_50ms.U3T45_vcs_lat_accel.phys = @sysvar::MsgU3T_Obj_45_50ms::SigU3T45_vcs_lat_accel;
   Msg_U3T_Obj_45_50ms.U3T45_vcs_lat_posn.phys = @sysvar::MsgU3T_Obj_45_50ms::SigU3T45_vcs_lat_posn;
   Msg_U3T_Obj_45_50ms.U3T45_vcs_lat_vel.phys = @sysvar::MsgU3T_Obj_45_50ms::SigU3T45_vcs_lat_vel;
   Msg_U3T_Obj_45_50ms.U3T45_vcs_long_accel.phys = @sysvar::MsgU3T_Obj_45_50ms::SigU3T45_vcs_long_accel;
   Msg_U3T_Obj_45_50ms.U3T45_vcs_long_posn.phys = @sysvar::MsgU3T_Obj_45_50ms::SigU3T45_vcs_long_posn;
   Msg_U3T_Obj_45_50ms.U3T45_vcs_long_vel.phys = @sysvar::MsgU3T_Obj_45_50ms::SigU3T45_vcs_long_vel;
   Msg_U3T_Obj_45_50ms.U3T45_conf_overall.phys = @sysvar::MsgU3T_Obj_45_50ms::SigU3T45_conf_overall;
   Msg_U3T_Obj_45_50ms.U3T45_f_oncoming.phys = @sysvar::MsgU3T_Obj_45_50ms::SigU3T45_f_oncoming;
   Msg_U3T_Obj_45_50ms.U3T45_f_receding.phys = @sysvar::MsgU3T_Obj_45_50ms::SigU3T45_f_receding;
   output(Msg_U3T_Obj_45_50ms);
   Msg_U3T_Obj_44_50ms.U3T44_age.phys = @sysvar::MsgU3T_Obj_44_50ms::SigU3T44_age;
   Msg_U3T_Obj_44_50ms.U3T44_f_moveable.phys = @sysvar::MsgU3T_Obj_44_50ms::SigU3T44_f_moveable;
   Msg_U3T_Obj_44_50ms.U3T44_f_stationary.phys = @sysvar::MsgU3T_Obj_44_50ms::SigU3T44_f_stationary;
   Msg_U3T_Obj_44_50ms.U3T44_FLcorner_lat.phys = @sysvar::MsgU3T_Obj_44_50ms::SigU3T44_FLcorner_lat;
   Msg_U3T_Obj_44_50ms.U3T44_object_class.phys = @sysvar::MsgU3T_Obj_44_50ms::SigU3T44_object_class;
   Msg_U3T_Obj_44_50ms.U3T44_FLcorner_long.phys = @sysvar::MsgU3T_Obj_44_50ms::SigU3T44_FLcorner_long;
   Msg_U3T_Obj_44_50ms.U3T44_status.phys = @sysvar::MsgU3T_Obj_44_50ms::SigU3T44_status;
   Msg_U3T_Obj_44_50ms.U3T44_FRcorner_lat.phys = @sysvar::MsgU3T_Obj_44_50ms::SigU3T44_FRcorner_lat;
   Msg_U3T_Obj_44_50ms.U3T44_FRcorner_long.phys = @sysvar::MsgU3T_Obj_44_50ms::SigU3T44_FRcorner_long;
   Msg_U3T_Obj_44_50ms.U3T44_heading_rate.phys = @sysvar::MsgU3T_Obj_44_50ms::SigU3T44_heading_rate;
   Msg_U3T_Obj_44_50ms.U3T44_id.phys = @sysvar::MsgU3T_Obj_44_50ms::SigU3T44_id;
   Msg_U3T_Obj_44_50ms.U3T44_length.phys = @sysvar::MsgU3T_Obj_44_50ms::SigU3T44_length;
   Msg_U3T_Obj_44_50ms.U3T44_RLcorner_lat.phys = @sysvar::MsgU3T_Obj_44_50ms::SigU3T44_RLcorner_lat;
   Msg_U3T_Obj_44_50ms.U3T44_RLcorner_long.phys = @sysvar::MsgU3T_Obj_44_50ms::SigU3T44_RLcorner_long;
   Msg_U3T_Obj_44_50ms.U3T44_RRcorner_lat.phys = @sysvar::MsgU3T_Obj_44_50ms::SigU3T44_RRcorner_lat;
   Msg_U3T_Obj_44_50ms.U3T44_RRcorner_long.phys = @sysvar::MsgU3T_Obj_44_50ms::SigU3T44_RRcorner_long;
   Msg_U3T_Obj_44_50ms.U3T44_speed.phys = @sysvar::MsgU3T_Obj_44_50ms::SigU3T44_speed;
   Msg_U3T_Obj_44_50ms.U3T44_width.phys = @sysvar::MsgU3T_Obj_44_50ms::SigU3T44_width;
   Msg_U3T_Obj_44_50ms.U3T44_fusion_source.phys = @sysvar::MsgU3T_Obj_44_50ms::SigU3T44_fusion_source;
   Msg_U3T_Obj_44_50ms.U3T44_vcs_heading.phys = @sysvar::MsgU3T_Obj_44_50ms::SigU3T44_vcs_heading;
   Msg_U3T_Obj_44_50ms.U3T44_vcs_lat_accel.phys = @sysvar::MsgU3T_Obj_44_50ms::SigU3T44_vcs_lat_accel;
   Msg_U3T_Obj_44_50ms.U3T44_vcs_lat_posn.phys = @sysvar::MsgU3T_Obj_44_50ms::SigU3T44_vcs_lat_posn;
   Msg_U3T_Obj_44_50ms.U3T44_vcs_lat_vel.phys = @sysvar::MsgU3T_Obj_44_50ms::SigU3T44_vcs_lat_vel;
   Msg_U3T_Obj_44_50ms.U3T44_vcs_long_accel.phys = @sysvar::MsgU3T_Obj_44_50ms::SigU3T44_vcs_long_accel;
   Msg_U3T_Obj_44_50ms.U3T44_vcs_long_posn.phys = @sysvar::MsgU3T_Obj_44_50ms::SigU3T44_vcs_long_posn;
   Msg_U3T_Obj_44_50ms.U3T44_vcs_long_vel.phys = @sysvar::MsgU3T_Obj_44_50ms::SigU3T44_vcs_long_vel;
   Msg_U3T_Obj_44_50ms.U3T44_conf_overall.phys = @sysvar::MsgU3T_Obj_44_50ms::SigU3T44_conf_overall;
   Msg_U3T_Obj_44_50ms.U3T44_f_oncoming.phys = @sysvar::MsgU3T_Obj_44_50ms::SigU3T44_f_oncoming;
   Msg_U3T_Obj_44_50ms.U3T44_f_receding.phys = @sysvar::MsgU3T_Obj_44_50ms::SigU3T44_f_receding;
   output(Msg_U3T_Obj_44_50ms);
   Msg_U3T_Obj_43_50ms.U3T43_age.phys = @sysvar::MsgU3T_Obj_43_50ms::SigU3T43_age;
   Msg_U3T_Obj_43_50ms.U3T43_f_moveable.phys = @sysvar::MsgU3T_Obj_43_50ms::SigU3T43_f_moveable;
   Msg_U3T_Obj_43_50ms.U3T43_f_stationary.phys = @sysvar::MsgU3T_Obj_43_50ms::SigU3T43_f_stationary;
   Msg_U3T_Obj_43_50ms.U3T43_FLcorner_lat.phys = @sysvar::MsgU3T_Obj_43_50ms::SigU3T43_FLcorner_lat;
   Msg_U3T_Obj_43_50ms.U3T43_object_class.phys = @sysvar::MsgU3T_Obj_43_50ms::SigU3T43_object_class;
   Msg_U3T_Obj_43_50ms.U3T43_FLcorner_long.phys = @sysvar::MsgU3T_Obj_43_50ms::SigU3T43_FLcorner_long;
   Msg_U3T_Obj_43_50ms.U3T43_status.phys = @sysvar::MsgU3T_Obj_43_50ms::SigU3T43_status;
   Msg_U3T_Obj_43_50ms.U3T43_FRcorner_lat.phys = @sysvar::MsgU3T_Obj_43_50ms::SigU3T43_FRcorner_lat;
   Msg_U3T_Obj_43_50ms.U3T43_FRcorner_long.phys = @sysvar::MsgU3T_Obj_43_50ms::SigU3T43_FRcorner_long;
   Msg_U3T_Obj_43_50ms.U3T43_heading_rate.phys = @sysvar::MsgU3T_Obj_43_50ms::SigU3T43_heading_rate;
   Msg_U3T_Obj_43_50ms.U3T43_id.phys = @sysvar::MsgU3T_Obj_43_50ms::SigU3T43_id;
   Msg_U3T_Obj_43_50ms.U3T43_length.phys = @sysvar::MsgU3T_Obj_43_50ms::SigU3T43_length;
   Msg_U3T_Obj_43_50ms.U3T43_RLcorner_lat.phys = @sysvar::MsgU3T_Obj_43_50ms::SigU3T43_RLcorner_lat;
   Msg_U3T_Obj_43_50ms.U3T43_RLcorner_long.phys = @sysvar::MsgU3T_Obj_43_50ms::SigU3T43_RLcorner_long;
   Msg_U3T_Obj_43_50ms.U3T43_RRcorner_lat.phys = @sysvar::MsgU3T_Obj_43_50ms::SigU3T43_RRcorner_lat;
   Msg_U3T_Obj_43_50ms.U3T43_RRcorner_long.phys = @sysvar::MsgU3T_Obj_43_50ms::SigU3T43_RRcorner_long;
   Msg_U3T_Obj_43_50ms.U3T43_speed.phys = @sysvar::MsgU3T_Obj_43_50ms::SigU3T43_speed;
   Msg_U3T_Obj_43_50ms.U3T43_width.phys = @sysvar::MsgU3T_Obj_43_50ms::SigU3T43_width;
   Msg_U3T_Obj_43_50ms.U3T43_fusion_source.phys = @sysvar::MsgU3T_Obj_43_50ms::SigU3T43_fusion_source;
   Msg_U3T_Obj_43_50ms.U3T43_vcs_heading.phys = @sysvar::MsgU3T_Obj_43_50ms::SigU3T43_vcs_heading;
   Msg_U3T_Obj_43_50ms.U3T43_vcs_lat_accel.phys = @sysvar::MsgU3T_Obj_43_50ms::SigU3T43_vcs_lat_accel;
   Msg_U3T_Obj_43_50ms.U3T43_vcs_lat_posn.phys = @sysvar::MsgU3T_Obj_43_50ms::SigU3T43_vcs_lat_posn;
   Msg_U3T_Obj_43_50ms.U3T43_vcs_lat_vel.phys = @sysvar::MsgU3T_Obj_43_50ms::SigU3T43_vcs_lat_vel;
   Msg_U3T_Obj_43_50ms.U3T43_vcs_long_accel.phys = @sysvar::MsgU3T_Obj_43_50ms::SigU3T43_vcs_long_accel;
   Msg_U3T_Obj_43_50ms.U3T43_vcs_long_posn.phys = @sysvar::MsgU3T_Obj_43_50ms::SigU3T43_vcs_long_posn;
   Msg_U3T_Obj_43_50ms.U3T43_vcs_long_vel.phys = @sysvar::MsgU3T_Obj_43_50ms::SigU3T43_vcs_long_vel;
   Msg_U3T_Obj_43_50ms.U3T43_conf_overall.phys = @sysvar::MsgU3T_Obj_43_50ms::SigU3T43_conf_overall;
   Msg_U3T_Obj_43_50ms.U3T43_f_oncoming.phys = @sysvar::MsgU3T_Obj_43_50ms::SigU3T43_f_oncoming;
   Msg_U3T_Obj_43_50ms.U3T43_f_receding.phys = @sysvar::MsgU3T_Obj_43_50ms::SigU3T43_f_receding;
   output(Msg_U3T_Obj_43_50ms);
   Msg_U3T_Obj_41_50ms.U3T41_age.phys = @sysvar::MsgU3T_Obj_41_50ms::SigU3T41_age;
   Msg_U3T_Obj_41_50ms.U3T41_f_moveable.phys = @sysvar::MsgU3T_Obj_41_50ms::SigU3T41_f_moveable;
   Msg_U3T_Obj_41_50ms.U3T41_f_stationary.phys = @sysvar::MsgU3T_Obj_41_50ms::SigU3T41_f_stationary;
   Msg_U3T_Obj_41_50ms.U3T41_FLcorner_lat.phys = @sysvar::MsgU3T_Obj_41_50ms::SigU3T41_FLcorner_lat;
   Msg_U3T_Obj_41_50ms.U3T41_object_class.phys = @sysvar::MsgU3T_Obj_41_50ms::SigU3T41_object_class;
   Msg_U3T_Obj_41_50ms.U3T41_FLcorner_long.phys = @sysvar::MsgU3T_Obj_41_50ms::SigU3T41_FLcorner_long;
   Msg_U3T_Obj_41_50ms.U3T41_status.phys = @sysvar::MsgU3T_Obj_41_50ms::SigU3T41_status;
   Msg_U3T_Obj_41_50ms.U3T41_FRcorner_lat.phys = @sysvar::MsgU3T_Obj_41_50ms::SigU3T41_FRcorner_lat;
   Msg_U3T_Obj_41_50ms.U3T41_FRcorner_long.phys = @sysvar::MsgU3T_Obj_41_50ms::SigU3T41_FRcorner_long;
   Msg_U3T_Obj_41_50ms.U3T41_heading_rate.phys = @sysvar::MsgU3T_Obj_41_50ms::SigU3T41_heading_rate;
   Msg_U3T_Obj_41_50ms.U3T41_id.phys = @sysvar::MsgU3T_Obj_41_50ms::SigU3T41_id;
   Msg_U3T_Obj_41_50ms.U3T41_length.phys = @sysvar::MsgU3T_Obj_41_50ms::SigU3T41_length;
   Msg_U3T_Obj_41_50ms.U3T41_RLcorner_lat.phys = @sysvar::MsgU3T_Obj_41_50ms::SigU3T41_RLcorner_lat;
   Msg_U3T_Obj_41_50ms.U3T41_RLcorner_long.phys = @sysvar::MsgU3T_Obj_41_50ms::SigU3T41_RLcorner_long;
   Msg_U3T_Obj_41_50ms.U3T41_RRcorner_lat.phys = @sysvar::MsgU3T_Obj_41_50ms::SigU3T41_RRcorner_lat;
   Msg_U3T_Obj_41_50ms.U3T41_RRcorner_long.phys = @sysvar::MsgU3T_Obj_41_50ms::SigU3T41_RRcorner_long;
   Msg_U3T_Obj_41_50ms.U3T41_speed.phys = @sysvar::MsgU3T_Obj_41_50ms::SigU3T41_speed;
   Msg_U3T_Obj_41_50ms.U3T41_width.phys = @sysvar::MsgU3T_Obj_41_50ms::SigU3T41_width;
   Msg_U3T_Obj_41_50ms.U3T41_fusion_source.phys = @sysvar::MsgU3T_Obj_41_50ms::SigU3T41_fusion_source;
   Msg_U3T_Obj_41_50ms.U3T41_vcs_heading.phys = @sysvar::MsgU3T_Obj_41_50ms::SigU3T41_vcs_heading;
   Msg_U3T_Obj_41_50ms.U3T41_vcs_lat_accel.phys = @sysvar::MsgU3T_Obj_41_50ms::SigU3T41_vcs_lat_accel;
   Msg_U3T_Obj_41_50ms.U3T41_vcs_lat_posn.phys = @sysvar::MsgU3T_Obj_41_50ms::SigU3T41_vcs_lat_posn;
   Msg_U3T_Obj_41_50ms.U3T41_vcs_lat_vel.phys = @sysvar::MsgU3T_Obj_41_50ms::SigU3T41_vcs_lat_vel;
   Msg_U3T_Obj_41_50ms.U3T41_vcs_long_accel.phys = @sysvar::MsgU3T_Obj_41_50ms::SigU3T41_vcs_long_accel;
   Msg_U3T_Obj_41_50ms.U3T41_vcs_long_posn.phys = @sysvar::MsgU3T_Obj_41_50ms::SigU3T41_vcs_long_posn;
   Msg_U3T_Obj_41_50ms.U3T41_vcs_long_vel.phys = @sysvar::MsgU3T_Obj_41_50ms::SigU3T41_vcs_long_vel;
   Msg_U3T_Obj_41_50ms.U3T41_conf_overall.phys = @sysvar::MsgU3T_Obj_41_50ms::SigU3T41_conf_overall;
   Msg_U3T_Obj_41_50ms.U3T41_f_oncoming.phys = @sysvar::MsgU3T_Obj_41_50ms::SigU3T41_f_oncoming;
   Msg_U3T_Obj_41_50ms.U3T41_f_receding.phys = @sysvar::MsgU3T_Obj_41_50ms::SigU3T41_f_receding;
   output(Msg_U3T_Obj_41_50ms);
   Msg_U3T_Obj_40_50ms.U3T40_age.phys = @sysvar::MsgU3T_Obj_40_50ms::SigU3T40_age;
   Msg_U3T_Obj_40_50ms.U3T40_f_moveable.phys = @sysvar::MsgU3T_Obj_40_50ms::SigU3T40_f_moveable;
   Msg_U3T_Obj_40_50ms.U3T40_f_stationary.phys = @sysvar::MsgU3T_Obj_40_50ms::SigU3T40_f_stationary;
   Msg_U3T_Obj_40_50ms.U3T40_FLcorner_lat.phys = @sysvar::MsgU3T_Obj_40_50ms::SigU3T40_FLcorner_lat;
   Msg_U3T_Obj_40_50ms.U3T40_object_class.phys = @sysvar::MsgU3T_Obj_40_50ms::SigU3T40_object_class;
   Msg_U3T_Obj_40_50ms.U3T40_FLcorner_long.phys = @sysvar::MsgU3T_Obj_40_50ms::SigU3T40_FLcorner_long;
   Msg_U3T_Obj_40_50ms.U3T40_status.phys = @sysvar::MsgU3T_Obj_40_50ms::SigU3T40_status;
   Msg_U3T_Obj_40_50ms.U3T40_FRcorner_lat.phys = @sysvar::MsgU3T_Obj_40_50ms::SigU3T40_FRcorner_lat;
   Msg_U3T_Obj_40_50ms.U3T40_FRcorner_long.phys = @sysvar::MsgU3T_Obj_40_50ms::SigU3T40_FRcorner_long;
   Msg_U3T_Obj_40_50ms.U3T40_heading_rate.phys = @sysvar::MsgU3T_Obj_40_50ms::SigU3T40_heading_rate;
   Msg_U3T_Obj_40_50ms.U3T40_id.phys = @sysvar::MsgU3T_Obj_40_50ms::SigU3T40_id;
   Msg_U3T_Obj_40_50ms.U3T40_length.phys = @sysvar::MsgU3T_Obj_40_50ms::SigU3T40_length;
   Msg_U3T_Obj_40_50ms.U3T40_RLcorner_lat.phys = @sysvar::MsgU3T_Obj_40_50ms::SigU3T40_RLcorner_lat;
   Msg_U3T_Obj_40_50ms.U3T40_RLcorner_long.phys = @sysvar::MsgU3T_Obj_40_50ms::SigU3T40_RLcorner_long;
   Msg_U3T_Obj_40_50ms.U3T40_RRcorner_lat.phys = @sysvar::MsgU3T_Obj_40_50ms::SigU3T40_RRcorner_lat;
   Msg_U3T_Obj_40_50ms.U3T40_RRcorner_long.phys = @sysvar::MsgU3T_Obj_40_50ms::SigU3T40_RRcorner_long;
   Msg_U3T_Obj_40_50ms.U3T40_speed.phys = @sysvar::MsgU3T_Obj_40_50ms::SigU3T40_speed;
   Msg_U3T_Obj_40_50ms.U3T40_width.phys = @sysvar::MsgU3T_Obj_40_50ms::SigU3T40_width;
   Msg_U3T_Obj_40_50ms.U3T40_fusion_source.phys = @sysvar::MsgU3T_Obj_40_50ms::SigU3T40_fusion_source;
   Msg_U3T_Obj_40_50ms.U3T40_vcs_heading.phys = @sysvar::MsgU3T_Obj_40_50ms::SigU3T40_vcs_heading;
   Msg_U3T_Obj_40_50ms.U3T40_vcs_lat_accel.phys = @sysvar::MsgU3T_Obj_40_50ms::SigU3T40_vcs_lat_accel;
   Msg_U3T_Obj_40_50ms.U3T40_vcs_lat_posn.phys = @sysvar::MsgU3T_Obj_40_50ms::SigU3T40_vcs_lat_posn;
   Msg_U3T_Obj_40_50ms.U3T40_vcs_lat_vel.phys = @sysvar::MsgU3T_Obj_40_50ms::SigU3T40_vcs_lat_vel;
   Msg_U3T_Obj_40_50ms.U3T40_vcs_long_accel.phys = @sysvar::MsgU3T_Obj_40_50ms::SigU3T40_vcs_long_accel;
   Msg_U3T_Obj_40_50ms.U3T40_vcs_long_posn.phys = @sysvar::MsgU3T_Obj_40_50ms::SigU3T40_vcs_long_posn;
   Msg_U3T_Obj_40_50ms.U3T40_vcs_long_vel.phys = @sysvar::MsgU3T_Obj_40_50ms::SigU3T40_vcs_long_vel;
   Msg_U3T_Obj_40_50ms.U3T40_conf_overall.phys = @sysvar::MsgU3T_Obj_40_50ms::SigU3T40_conf_overall;
   Msg_U3T_Obj_40_50ms.U3T40_f_oncoming.phys = @sysvar::MsgU3T_Obj_40_50ms::SigU3T40_f_oncoming;
   Msg_U3T_Obj_40_50ms.U3T40_f_receding.phys = @sysvar::MsgU3T_Obj_40_50ms::SigU3T40_f_receding;
   output(Msg_U3T_Obj_40_50ms);
   Msg_U3T_Obj_39_50ms.U3T39_age.phys = @sysvar::MsgU3T_Obj_39_50ms::SigU3T39_age;
   Msg_U3T_Obj_39_50ms.U3T39_f_moveable.phys = @sysvar::MsgU3T_Obj_39_50ms::SigU3T39_f_moveable;
   Msg_U3T_Obj_39_50ms.U3T39_f_stationary.phys = @sysvar::MsgU3T_Obj_39_50ms::SigU3T39_f_stationary;
   Msg_U3T_Obj_39_50ms.U3T39_FLcorner_lat.phys = @sysvar::MsgU3T_Obj_39_50ms::SigU3T39_FLcorner_lat;
   Msg_U3T_Obj_39_50ms.U3T39_object_class.phys = @sysvar::MsgU3T_Obj_39_50ms::SigU3T39_object_class;
   Msg_U3T_Obj_39_50ms.U3T39_FLcorner_long.phys = @sysvar::MsgU3T_Obj_39_50ms::SigU3T39_FLcorner_long;
   Msg_U3T_Obj_39_50ms.U3T39_status.phys = @sysvar::MsgU3T_Obj_39_50ms::SigU3T39_status;
   Msg_U3T_Obj_39_50ms.U3T39_FRcorner_lat.phys = @sysvar::MsgU3T_Obj_39_50ms::SigU3T39_FRcorner_lat;
   Msg_U3T_Obj_39_50ms.U3T39_FRcorner_long.phys = @sysvar::MsgU3T_Obj_39_50ms::SigU3T39_FRcorner_long;
   Msg_U3T_Obj_39_50ms.U3T39_heading_rate.phys = @sysvar::MsgU3T_Obj_39_50ms::SigU3T39_heading_rate;
   Msg_U3T_Obj_39_50ms.U3T39_id.phys = @sysvar::MsgU3T_Obj_39_50ms::SigU3T39_id;
   Msg_U3T_Obj_39_50ms.U3T39_length.phys = @sysvar::MsgU3T_Obj_39_50ms::SigU3T39_length;
   Msg_U3T_Obj_39_50ms.U3T39_RLcorner_lat.phys = @sysvar::MsgU3T_Obj_39_50ms::SigU3T39_RLcorner_lat;
   Msg_U3T_Obj_39_50ms.U3T39_RLcorner_long.phys = @sysvar::MsgU3T_Obj_39_50ms::SigU3T39_RLcorner_long;
   Msg_U3T_Obj_39_50ms.U3T39_RRcorner_lat.phys = @sysvar::MsgU3T_Obj_39_50ms::SigU3T39_RRcorner_lat;
   Msg_U3T_Obj_39_50ms.U3T39_RRcorner_long.phys = @sysvar::MsgU3T_Obj_39_50ms::SigU3T39_RRcorner_long;
   Msg_U3T_Obj_39_50ms.U3T39_speed.phys = @sysvar::MsgU3T_Obj_39_50ms::SigU3T39_speed;
   Msg_U3T_Obj_39_50ms.U3T39_width.phys = @sysvar::MsgU3T_Obj_39_50ms::SigU3T39_width;
   Msg_U3T_Obj_39_50ms.U3T39_fusion_source.phys = @sysvar::MsgU3T_Obj_39_50ms::SigU3T39_fusion_source;
   Msg_U3T_Obj_39_50ms.U3T39_vcs_heading.phys = @sysvar::MsgU3T_Obj_39_50ms::SigU3T39_vcs_heading;
   Msg_U3T_Obj_39_50ms.U3T39_vcs_lat_accel.phys = @sysvar::MsgU3T_Obj_39_50ms::SigU3T39_vcs_lat_accel;
   Msg_U3T_Obj_39_50ms.U3T39_vcs_lat_posn.phys = @sysvar::MsgU3T_Obj_39_50ms::SigU3T39_vcs_lat_posn;
   Msg_U3T_Obj_39_50ms.U3T39_vcs_lat_vel.phys = @sysvar::MsgU3T_Obj_39_50ms::SigU3T39_vcs_lat_vel;
   Msg_U3T_Obj_39_50ms.U3T39_vcs_long_accel.phys = @sysvar::MsgU3T_Obj_39_50ms::SigU3T39_vcs_long_accel;
   Msg_U3T_Obj_39_50ms.U3T39_vcs_long_posn.phys = @sysvar::MsgU3T_Obj_39_50ms::SigU3T39_vcs_long_posn;
   Msg_U3T_Obj_39_50ms.U3T39_vcs_long_vel.phys = @sysvar::MsgU3T_Obj_39_50ms::SigU3T39_vcs_long_vel;
   Msg_U3T_Obj_39_50ms.U3T39_conf_overall.phys = @sysvar::MsgU3T_Obj_39_50ms::SigU3T39_conf_overall;
   Msg_U3T_Obj_39_50ms.U3T39_f_oncoming.phys = @sysvar::MsgU3T_Obj_39_50ms::SigU3T39_f_oncoming;
   Msg_U3T_Obj_39_50ms.U3T39_f_receding.phys = @sysvar::MsgU3T_Obj_39_50ms::SigU3T39_f_receding;
   output(Msg_U3T_Obj_39_50ms);
   Msg_U3T_Obj_38_50ms.U3T38_age.phys = @sysvar::MsgU3T_Obj_38_50ms::SigU3T38_age;
   Msg_U3T_Obj_38_50ms.U3T38_f_moveable.phys = @sysvar::MsgU3T_Obj_38_50ms::SigU3T38_f_moveable;
   Msg_U3T_Obj_38_50ms.U3T38_f_stationary.phys = @sysvar::MsgU3T_Obj_38_50ms::SigU3T38_f_stationary;
   Msg_U3T_Obj_38_50ms.U3T38_FLcorner_lat.phys = @sysvar::MsgU3T_Obj_38_50ms::SigU3T38_FLcorner_lat;
   Msg_U3T_Obj_38_50ms.U3T38_object_class.phys = @sysvar::MsgU3T_Obj_38_50ms::SigU3T38_object_class;
   Msg_U3T_Obj_38_50ms.U3T38_FLcorner_long.phys = @sysvar::MsgU3T_Obj_38_50ms::SigU3T38_FLcorner_long;
   Msg_U3T_Obj_38_50ms.U3T38_status.phys = @sysvar::MsgU3T_Obj_38_50ms::SigU3T38_status;
   Msg_U3T_Obj_38_50ms.U3T38_FRcorner_lat.phys = @sysvar::MsgU3T_Obj_38_50ms::SigU3T38_FRcorner_lat;
   Msg_U3T_Obj_38_50ms.U3T38_FRcorner_long.phys = @sysvar::MsgU3T_Obj_38_50ms::SigU3T38_FRcorner_long;
   Msg_U3T_Obj_38_50ms.U3T38_heading_rate.phys = @sysvar::MsgU3T_Obj_38_50ms::SigU3T38_heading_rate;
   Msg_U3T_Obj_38_50ms.U3T38_id.phys = @sysvar::MsgU3T_Obj_38_50ms::SigU3T38_id;
   Msg_U3T_Obj_38_50ms.U3T38_length.phys = @sysvar::MsgU3T_Obj_38_50ms::SigU3T38_length;
   Msg_U3T_Obj_38_50ms.U3T38_RLcorner_lat.phys = @sysvar::MsgU3T_Obj_38_50ms::SigU3T38_RLcorner_lat;
   Msg_U3T_Obj_38_50ms.U3T38_RLcorner_long.phys = @sysvar::MsgU3T_Obj_38_50ms::SigU3T38_RLcorner_long;
   Msg_U3T_Obj_38_50ms.U3T38_RRcorner_lat.phys = @sysvar::MsgU3T_Obj_38_50ms::SigU3T38_RRcorner_lat;
   Msg_U3T_Obj_38_50ms.U3T38_RRcorner_long.phys = @sysvar::MsgU3T_Obj_38_50ms::SigU3T38_RRcorner_long;
   Msg_U3T_Obj_38_50ms.U3T38_speed.phys = @sysvar::MsgU3T_Obj_38_50ms::SigU3T38_speed;
   Msg_U3T_Obj_38_50ms.U3T38_width.phys = @sysvar::MsgU3T_Obj_38_50ms::SigU3T38_width;
   Msg_U3T_Obj_38_50ms.U3T38_fusion_source.phys = @sysvar::MsgU3T_Obj_38_50ms::SigU3T38_fusion_source;
   Msg_U3T_Obj_38_50ms.U3T38_vcs_heading.phys = @sysvar::MsgU3T_Obj_38_50ms::SigU3T38_vcs_heading;
   Msg_U3T_Obj_38_50ms.U3T38_vcs_lat_accel.phys = @sysvar::MsgU3T_Obj_38_50ms::SigU3T38_vcs_lat_accel;
   Msg_U3T_Obj_38_50ms.U3T38_vcs_lat_posn.phys = @sysvar::MsgU3T_Obj_38_50ms::SigU3T38_vcs_lat_posn;
   Msg_U3T_Obj_38_50ms.U3T38_vcs_lat_vel.phys = @sysvar::MsgU3T_Obj_38_50ms::SigU3T38_vcs_lat_vel;
   Msg_U3T_Obj_38_50ms.U3T38_vcs_long_accel.phys = @sysvar::MsgU3T_Obj_38_50ms::SigU3T38_vcs_long_accel;
   Msg_U3T_Obj_38_50ms.U3T38_vcs_long_posn.phys = @sysvar::MsgU3T_Obj_38_50ms::SigU3T38_vcs_long_posn;
   Msg_U3T_Obj_38_50ms.U3T38_vcs_long_vel.phys = @sysvar::MsgU3T_Obj_38_50ms::SigU3T38_vcs_long_vel;
   Msg_U3T_Obj_38_50ms.U3T38_conf_overall.phys = @sysvar::MsgU3T_Obj_38_50ms::SigU3T38_conf_overall;
   Msg_U3T_Obj_38_50ms.U3T38_f_oncoming.phys = @sysvar::MsgU3T_Obj_38_50ms::SigU3T38_f_oncoming;
   Msg_U3T_Obj_38_50ms.U3T38_f_receding.phys = @sysvar::MsgU3T_Obj_38_50ms::SigU3T38_f_receding;
   output(Msg_U3T_Obj_38_50ms);
   Msg_U3T_Obj_37_50ms.U3T37_age.phys = @sysvar::MsgU3T_Obj_37_50ms::SigU3T37_age;
   Msg_U3T_Obj_37_50ms.U3T37_f_moveable.phys = @sysvar::MsgU3T_Obj_37_50ms::SigU3T37_f_moveable;
   Msg_U3T_Obj_37_50ms.U3T37_f_stationary.phys = @sysvar::MsgU3T_Obj_37_50ms::SigU3T37_f_stationary;
   Msg_U3T_Obj_37_50ms.U3T37_FLcorner_lat.phys = @sysvar::MsgU3T_Obj_37_50ms::SigU3T37_FLcorner_lat;
   Msg_U3T_Obj_37_50ms.U3T37_object_class.phys = @sysvar::MsgU3T_Obj_37_50ms::SigU3T37_object_class;
   Msg_U3T_Obj_37_50ms.U3T37_FLcorner_long.phys = @sysvar::MsgU3T_Obj_37_50ms::SigU3T37_FLcorner_long;
   Msg_U3T_Obj_37_50ms.U3T37_status.phys = @sysvar::MsgU3T_Obj_37_50ms::SigU3T37_status;
   Msg_U3T_Obj_37_50ms.U3T37_FRcorner_lat.phys = @sysvar::MsgU3T_Obj_37_50ms::SigU3T37_FRcorner_lat;
   Msg_U3T_Obj_37_50ms.U3T37_FRcorner_long.phys = @sysvar::MsgU3T_Obj_37_50ms::SigU3T37_FRcorner_long;
   Msg_U3T_Obj_37_50ms.U3T37_heading_rate.phys = @sysvar::MsgU3T_Obj_37_50ms::SigU3T37_heading_rate;
   Msg_U3T_Obj_37_50ms.U3T37_id.phys = @sysvar::MsgU3T_Obj_37_50ms::SigU3T37_id;
   Msg_U3T_Obj_37_50ms.U3T37_length.phys = @sysvar::MsgU3T_Obj_37_50ms::SigU3T37_length;
   Msg_U3T_Obj_37_50ms.U3T37_RLcorner_lat.phys = @sysvar::MsgU3T_Obj_37_50ms::SigU3T37_RLcorner_lat;
   Msg_U3T_Obj_37_50ms.U3T37_RLcorner_long.phys = @sysvar::MsgU3T_Obj_37_50ms::SigU3T37_RLcorner_long;
   Msg_U3T_Obj_37_50ms.U3T37_RRcorner_lat.phys = @sysvar::MsgU3T_Obj_37_50ms::SigU3T37_RRcorner_lat;
   Msg_U3T_Obj_37_50ms.U3T37_RRcorner_long.phys = @sysvar::MsgU3T_Obj_37_50ms::SigU3T37_RRcorner_long;
   Msg_U3T_Obj_37_50ms.U3T37_speed.phys = @sysvar::MsgU3T_Obj_37_50ms::SigU3T37_speed;
   Msg_U3T_Obj_37_50ms.U3T37_width.phys = @sysvar::MsgU3T_Obj_37_50ms::SigU3T37_width;
   Msg_U3T_Obj_37_50ms.U3T37_fusion_source.phys = @sysvar::MsgU3T_Obj_37_50ms::SigU3T37_fusion_source;
   Msg_U3T_Obj_37_50ms.U3T37_vcs_heading.phys = @sysvar::MsgU3T_Obj_37_50ms::SigU3T37_vcs_heading;
   Msg_U3T_Obj_37_50ms.U3T37_vcs_lat_accel.phys = @sysvar::MsgU3T_Obj_37_50ms::SigU3T37_vcs_lat_accel;
   Msg_U3T_Obj_37_50ms.U3T37_vcs_lat_posn.phys = @sysvar::MsgU3T_Obj_37_50ms::SigU3T37_vcs_lat_posn;
   Msg_U3T_Obj_37_50ms.U3T37_vcs_lat_vel.phys = @sysvar::MsgU3T_Obj_37_50ms::SigU3T37_vcs_lat_vel;
   Msg_U3T_Obj_37_50ms.U3T37_vcs_long_accel.phys = @sysvar::MsgU3T_Obj_37_50ms::SigU3T37_vcs_long_accel;
   Msg_U3T_Obj_37_50ms.U3T37_vcs_long_posn.phys = @sysvar::MsgU3T_Obj_37_50ms::SigU3T37_vcs_long_posn;
   Msg_U3T_Obj_37_50ms.U3T37_vcs_long_vel.phys = @sysvar::MsgU3T_Obj_37_50ms::SigU3T37_vcs_long_vel;
   Msg_U3T_Obj_37_50ms.U3T37_conf_overall.phys = @sysvar::MsgU3T_Obj_37_50ms::SigU3T37_conf_overall;
   Msg_U3T_Obj_37_50ms.U3T37_f_oncoming.phys = @sysvar::MsgU3T_Obj_37_50ms::SigU3T37_f_oncoming;
   Msg_U3T_Obj_37_50ms.U3T37_f_receding.phys = @sysvar::MsgU3T_Obj_37_50ms::SigU3T37_f_receding;
   output(Msg_U3T_Obj_37_50ms);
   Msg_U3T_Obj_36_50ms.U3T36_age.phys = @sysvar::MsgU3T_Obj_36_50ms::SigU3T36_age;
   Msg_U3T_Obj_36_50ms.U3T36_f_moveable.phys = @sysvar::MsgU3T_Obj_36_50ms::SigU3T36_f_moveable;
   Msg_U3T_Obj_36_50ms.U3T36_f_stationary.phys = @sysvar::MsgU3T_Obj_36_50ms::SigU3T36_f_stationary;
   Msg_U3T_Obj_36_50ms.U3T36_FLcorner_lat.phys = @sysvar::MsgU3T_Obj_36_50ms::SigU3T36_FLcorner_lat;
   Msg_U3T_Obj_36_50ms.U3T36_object_class.phys = @sysvar::MsgU3T_Obj_36_50ms::SigU3T36_object_class;
   Msg_U3T_Obj_36_50ms.U3T36_FLcorner_long.phys = @sysvar::MsgU3T_Obj_36_50ms::SigU3T36_FLcorner_long;
   Msg_U3T_Obj_36_50ms.U3T36_status.phys = @sysvar::MsgU3T_Obj_36_50ms::SigU3T36_status;
   Msg_U3T_Obj_36_50ms.U3T36_FRcorner_lat.phys = @sysvar::MsgU3T_Obj_36_50ms::SigU3T36_FRcorner_lat;
   Msg_U3T_Obj_36_50ms.U3T36_FRcorner_long.phys = @sysvar::MsgU3T_Obj_36_50ms::SigU3T36_FRcorner_long;
   Msg_U3T_Obj_36_50ms.U3T36_heading_rate.phys = @sysvar::MsgU3T_Obj_36_50ms::SigU3T36_heading_rate;
   Msg_U3T_Obj_36_50ms.U3T36_id.phys = @sysvar::MsgU3T_Obj_36_50ms::SigU3T36_id;
   Msg_U3T_Obj_36_50ms.U3T36_length.phys = @sysvar::MsgU3T_Obj_36_50ms::SigU3T36_length;
   Msg_U3T_Obj_36_50ms.U3T36_RLcorner_lat.phys = @sysvar::MsgU3T_Obj_36_50ms::SigU3T36_RLcorner_lat;
   Msg_U3T_Obj_36_50ms.U3T36_RLcorner_long.phys = @sysvar::MsgU3T_Obj_36_50ms::SigU3T36_RLcorner_long;
   Msg_U3T_Obj_36_50ms.U3T36_RRcorner_lat.phys = @sysvar::MsgU3T_Obj_36_50ms::SigU3T36_RRcorner_lat;
   Msg_U3T_Obj_36_50ms.U3T36_RRcorner_long.phys = @sysvar::MsgU3T_Obj_36_50ms::SigU3T36_RRcorner_long;
   Msg_U3T_Obj_36_50ms.U3T36_speed.phys = @sysvar::MsgU3T_Obj_36_50ms::SigU3T36_speed;
   Msg_U3T_Obj_36_50ms.U3T36_width.phys = @sysvar::MsgU3T_Obj_36_50ms::SigU3T36_width;
   Msg_U3T_Obj_36_50ms.U3T36_fusion_source.phys = @sysvar::MsgU3T_Obj_36_50ms::SigU3T36_fusion_source;
   Msg_U3T_Obj_36_50ms.U3T36_vcs_heading.phys = @sysvar::MsgU3T_Obj_36_50ms::SigU3T36_vcs_heading;
   Msg_U3T_Obj_36_50ms.U3T36_vcs_lat_accel.phys = @sysvar::MsgU3T_Obj_36_50ms::SigU3T36_vcs_lat_accel;
   Msg_U3T_Obj_36_50ms.U3T36_vcs_lat_posn.phys = @sysvar::MsgU3T_Obj_36_50ms::SigU3T36_vcs_lat_posn;
   Msg_U3T_Obj_36_50ms.U3T36_vcs_lat_vel.phys = @sysvar::MsgU3T_Obj_36_50ms::SigU3T36_vcs_lat_vel;
   Msg_U3T_Obj_36_50ms.U3T36_vcs_long_accel.phys = @sysvar::MsgU3T_Obj_36_50ms::SigU3T36_vcs_long_accel;
   Msg_U3T_Obj_36_50ms.U3T36_vcs_long_posn.phys = @sysvar::MsgU3T_Obj_36_50ms::SigU3T36_vcs_long_posn;
   Msg_U3T_Obj_36_50ms.U3T36_vcs_long_vel.phys = @sysvar::MsgU3T_Obj_36_50ms::SigU3T36_vcs_long_vel;
   Msg_U3T_Obj_36_50ms.U3T36_conf_overall.phys = @sysvar::MsgU3T_Obj_36_50ms::SigU3T36_conf_overall;
   Msg_U3T_Obj_36_50ms.U3T36_f_oncoming.phys = @sysvar::MsgU3T_Obj_36_50ms::SigU3T36_f_oncoming;
   Msg_U3T_Obj_36_50ms.U3T36_f_receding.phys = @sysvar::MsgU3T_Obj_36_50ms::SigU3T36_f_receding;
   output(Msg_U3T_Obj_36_50ms);
   Msg_U3T_Obj_35_50ms.U3T35_age.phys = @sysvar::MsgU3T_Obj_35_50ms::SigU3T35_age;
   Msg_U3T_Obj_35_50ms.U3T35_f_moveable.phys = @sysvar::MsgU3T_Obj_35_50ms::SigU3T35_f_moveable;
   Msg_U3T_Obj_35_50ms.U3T35_f_stationary.phys = @sysvar::MsgU3T_Obj_35_50ms::SigU3T35_f_stationary;
   Msg_U3T_Obj_35_50ms.U3T35_FLcorner_lat.phys = @sysvar::MsgU3T_Obj_35_50ms::SigU3T35_FLcorner_lat;
   Msg_U3T_Obj_35_50ms.U3T35_object_class.phys = @sysvar::MsgU3T_Obj_35_50ms::SigU3T35_object_class;
   Msg_U3T_Obj_35_50ms.U3T35_FLcorner_long.phys = @sysvar::MsgU3T_Obj_35_50ms::SigU3T35_FLcorner_long;
   Msg_U3T_Obj_35_50ms.U3T35_status.phys = @sysvar::MsgU3T_Obj_35_50ms::SigU3T35_status;
   Msg_U3T_Obj_35_50ms.U3T35_FRcorner_lat.phys = @sysvar::MsgU3T_Obj_35_50ms::SigU3T35_FRcorner_lat;
   Msg_U3T_Obj_35_50ms.U3T35_FRcorner_long.phys = @sysvar::MsgU3T_Obj_35_50ms::SigU3T35_FRcorner_long;
   Msg_U3T_Obj_35_50ms.U3T35_heading_rate.phys = @sysvar::MsgU3T_Obj_35_50ms::SigU3T35_heading_rate;
   Msg_U3T_Obj_35_50ms.U3T35_id.phys = @sysvar::MsgU3T_Obj_35_50ms::SigU3T35_id;
   Msg_U3T_Obj_35_50ms.U3T35_length.phys = @sysvar::MsgU3T_Obj_35_50ms::SigU3T35_length;
   Msg_U3T_Obj_35_50ms.U3T35_RLcorner_lat.phys = @sysvar::MsgU3T_Obj_35_50ms::SigU3T35_RLcorner_lat;
   Msg_U3T_Obj_35_50ms.U3T35_RLcorner_long.phys = @sysvar::MsgU3T_Obj_35_50ms::SigU3T35_RLcorner_long;
   Msg_U3T_Obj_35_50ms.U3T35_RRcorner_lat.phys = @sysvar::MsgU3T_Obj_35_50ms::SigU3T35_RRcorner_lat;
   Msg_U3T_Obj_35_50ms.U3T35_RRcorner_long.phys = @sysvar::MsgU3T_Obj_35_50ms::SigU3T35_RRcorner_long;
   Msg_U3T_Obj_35_50ms.U3T35_speed.phys = @sysvar::MsgU3T_Obj_35_50ms::SigU3T35_speed;
   Msg_U3T_Obj_35_50ms.U3T35_width.phys = @sysvar::MsgU3T_Obj_35_50ms::SigU3T35_width;
   Msg_U3T_Obj_35_50ms.U3T35_fusion_source.phys = @sysvar::MsgU3T_Obj_35_50ms::SigU3T35_fusion_source;
   Msg_U3T_Obj_35_50ms.U3T35_vcs_heading.phys = @sysvar::MsgU3T_Obj_35_50ms::SigU3T35_vcs_heading;
   Msg_U3T_Obj_35_50ms.U3T35_vcs_lat_accel.phys = @sysvar::MsgU3T_Obj_35_50ms::SigU3T35_vcs_lat_accel;
   Msg_U3T_Obj_35_50ms.U3T35_vcs_lat_posn.phys = @sysvar::MsgU3T_Obj_35_50ms::SigU3T35_vcs_lat_posn;
   Msg_U3T_Obj_35_50ms.U3T35_vcs_lat_vel.phys = @sysvar::MsgU3T_Obj_35_50ms::SigU3T35_vcs_lat_vel;
   Msg_U3T_Obj_35_50ms.U3T35_vcs_long_accel.phys = @sysvar::MsgU3T_Obj_35_50ms::SigU3T35_vcs_long_accel;
   Msg_U3T_Obj_35_50ms.U3T35_vcs_long_posn.phys = @sysvar::MsgU3T_Obj_35_50ms::SigU3T35_vcs_long_posn;
   Msg_U3T_Obj_35_50ms.U3T35_vcs_long_vel.phys = @sysvar::MsgU3T_Obj_35_50ms::SigU3T35_vcs_long_vel;
   Msg_U3T_Obj_35_50ms.U3T35_conf_overall.phys = @sysvar::MsgU3T_Obj_35_50ms::SigU3T35_conf_overall;
   Msg_U3T_Obj_35_50ms.U3T35_f_oncoming.phys = @sysvar::MsgU3T_Obj_35_50ms::SigU3T35_f_oncoming;
   Msg_U3T_Obj_35_50ms.U3T35_f_receding.phys = @sysvar::MsgU3T_Obj_35_50ms::SigU3T35_f_receding;
   output(Msg_U3T_Obj_35_50ms);
   Msg_U3T_Obj_34_50ms.U3T34_age.phys = @sysvar::MsgU3T_Obj_34_50ms::SigU3T34_age;
   Msg_U3T_Obj_34_50ms.U3T34_f_moveable.phys = @sysvar::MsgU3T_Obj_34_50ms::SigU3T34_f_moveable;
   Msg_U3T_Obj_34_50ms.U3T34_f_stationary.phys = @sysvar::MsgU3T_Obj_34_50ms::SigU3T34_f_stationary;
   Msg_U3T_Obj_34_50ms.U3T34_FLcorner_lat.phys = @sysvar::MsgU3T_Obj_34_50ms::SigU3T34_FLcorner_lat;
   Msg_U3T_Obj_34_50ms.U3T34_object_class.phys = @sysvar::MsgU3T_Obj_34_50ms::SigU3T34_object_class;
   Msg_U3T_Obj_34_50ms.U3T34_FLcorner_long.phys = @sysvar::MsgU3T_Obj_34_50ms::SigU3T34_FLcorner_long;
   Msg_U3T_Obj_34_50ms.U3T34_status.phys = @sysvar::MsgU3T_Obj_34_50ms::SigU3T34_status;
   Msg_U3T_Obj_34_50ms.U3T34_FRcorner_lat.phys = @sysvar::MsgU3T_Obj_34_50ms::SigU3T34_FRcorner_lat;
   Msg_U3T_Obj_34_50ms.U3T34_FRcorner_long.phys = @sysvar::MsgU3T_Obj_34_50ms::SigU3T34_FRcorner_long;
   Msg_U3T_Obj_34_50ms.U3T34_heading_rate.phys = @sysvar::MsgU3T_Obj_34_50ms::SigU3T34_heading_rate;
   Msg_U3T_Obj_34_50ms.U3T34_id.phys = @sysvar::MsgU3T_Obj_34_50ms::SigU3T34_id;
   Msg_U3T_Obj_34_50ms.U3T34_length.phys = @sysvar::MsgU3T_Obj_34_50ms::SigU3T34_length;
   Msg_U3T_Obj_34_50ms.U3T34_RLcorner_lat.phys = @sysvar::MsgU3T_Obj_34_50ms::SigU3T34_RLcorner_lat;
   Msg_U3T_Obj_34_50ms.U3T34_RLcorner_long.phys = @sysvar::MsgU3T_Obj_34_50ms::SigU3T34_RLcorner_long;
   Msg_U3T_Obj_34_50ms.U3T34_RRcorner_lat.phys = @sysvar::MsgU3T_Obj_34_50ms::SigU3T34_RRcorner_lat;
   Msg_U3T_Obj_34_50ms.U3T34_RRcorner_long.phys = @sysvar::MsgU3T_Obj_34_50ms::SigU3T34_RRcorner_long;
   Msg_U3T_Obj_34_50ms.U3T34_speed.phys = @sysvar::MsgU3T_Obj_34_50ms::SigU3T34_speed;
   Msg_U3T_Obj_34_50ms.U3T34_width.phys = @sysvar::MsgU3T_Obj_34_50ms::SigU3T34_width;
   Msg_U3T_Obj_34_50ms.U3T34_fusion_source.phys = @sysvar::MsgU3T_Obj_34_50ms::SigU3T34_fusion_source;
   Msg_U3T_Obj_34_50ms.U3T34_vcs_heading.phys = @sysvar::MsgU3T_Obj_34_50ms::SigU3T34_vcs_heading;
   Msg_U3T_Obj_34_50ms.U3T34_vcs_lat_accel.phys = @sysvar::MsgU3T_Obj_34_50ms::SigU3T34_vcs_lat_accel;
   Msg_U3T_Obj_34_50ms.U3T34_vcs_lat_posn.phys = @sysvar::MsgU3T_Obj_34_50ms::SigU3T34_vcs_lat_posn;
   Msg_U3T_Obj_34_50ms.U3T34_vcs_lat_vel.phys = @sysvar::MsgU3T_Obj_34_50ms::SigU3T34_vcs_lat_vel;
   Msg_U3T_Obj_34_50ms.U3T34_vcs_long_accel.phys = @sysvar::MsgU3T_Obj_34_50ms::SigU3T34_vcs_long_accel;
   Msg_U3T_Obj_34_50ms.U3T34_vcs_long_posn.phys = @sysvar::MsgU3T_Obj_34_50ms::SigU3T34_vcs_long_posn;
   Msg_U3T_Obj_34_50ms.U3T34_vcs_long_vel.phys = @sysvar::MsgU3T_Obj_34_50ms::SigU3T34_vcs_long_vel;
   Msg_U3T_Obj_34_50ms.U3T34_conf_overall.phys = @sysvar::MsgU3T_Obj_34_50ms::SigU3T34_conf_overall;
   Msg_U3T_Obj_34_50ms.U3T34_f_oncoming.phys = @sysvar::MsgU3T_Obj_34_50ms::SigU3T34_f_oncoming;
   Msg_U3T_Obj_34_50ms.U3T34_f_receding.phys = @sysvar::MsgU3T_Obj_34_50ms::SigU3T34_f_receding;
   output(Msg_U3T_Obj_34_50ms);
   Msg_U3T_Obj_33_50ms.U3T33_age.phys = @sysvar::MsgU3T_Obj_33_50ms::SigU3T33_age;
   Msg_U3T_Obj_33_50ms.U3T33_f_moveable.phys = @sysvar::MsgU3T_Obj_33_50ms::SigU3T33_f_moveable;
   Msg_U3T_Obj_33_50ms.U3T33_f_stationary.phys = @sysvar::MsgU3T_Obj_33_50ms::SigU3T33_f_stationary;
   Msg_U3T_Obj_33_50ms.U3T33_FLcorner_lat.phys = @sysvar::MsgU3T_Obj_33_50ms::SigU3T33_FLcorner_lat;
   Msg_U3T_Obj_33_50ms.U3T33_object_class.phys = @sysvar::MsgU3T_Obj_33_50ms::SigU3T33_object_class;
   Msg_U3T_Obj_33_50ms.U3T33_FLcorner_long.phys = @sysvar::MsgU3T_Obj_33_50ms::SigU3T33_FLcorner_long;
   Msg_U3T_Obj_33_50ms.U3T33_status.phys = @sysvar::MsgU3T_Obj_33_50ms::SigU3T33_status;
   Msg_U3T_Obj_33_50ms.U3T33_FRcorner_lat.phys = @sysvar::MsgU3T_Obj_33_50ms::SigU3T33_FRcorner_lat;
   Msg_U3T_Obj_33_50ms.U3T33_FRcorner_long.phys = @sysvar::MsgU3T_Obj_33_50ms::SigU3T33_FRcorner_long;
   Msg_U3T_Obj_33_50ms.U3T33_heading_rate.phys = @sysvar::MsgU3T_Obj_33_50ms::SigU3T33_heading_rate;
   Msg_U3T_Obj_33_50ms.U3T33_id.phys = @sysvar::MsgU3T_Obj_33_50ms::SigU3T33_id;
   Msg_U3T_Obj_33_50ms.U3T33_length.phys = @sysvar::MsgU3T_Obj_33_50ms::SigU3T33_length;
   Msg_U3T_Obj_33_50ms.U3T33_RLcorner_lat.phys = @sysvar::MsgU3T_Obj_33_50ms::SigU3T33_RLcorner_lat;
   Msg_U3T_Obj_33_50ms.U3T33_RLcorner_long.phys = @sysvar::MsgU3T_Obj_33_50ms::SigU3T33_RLcorner_long;
   Msg_U3T_Obj_33_50ms.U3T33_RRcorner_lat.phys = @sysvar::MsgU3T_Obj_33_50ms::SigU3T33_RRcorner_lat;
   Msg_U3T_Obj_33_50ms.U3T33_RRcorner_long.phys = @sysvar::MsgU3T_Obj_33_50ms::SigU3T33_RRcorner_long;
   Msg_U3T_Obj_33_50ms.U3T33_speed.phys = @sysvar::MsgU3T_Obj_33_50ms::SigU3T33_speed;
   Msg_U3T_Obj_33_50ms.U3T33_width.phys = @sysvar::MsgU3T_Obj_33_50ms::SigU3T33_width;
   Msg_U3T_Obj_33_50ms.U3T33_fusion_source.phys = @sysvar::MsgU3T_Obj_33_50ms::SigU3T33_fusion_source;
   Msg_U3T_Obj_33_50ms.U3T33_vcs_heading.phys = @sysvar::MsgU3T_Obj_33_50ms::SigU3T33_vcs_heading;
   Msg_U3T_Obj_33_50ms.U3T33_vcs_lat_accel.phys = @sysvar::MsgU3T_Obj_33_50ms::SigU3T33_vcs_lat_accel;
   Msg_U3T_Obj_33_50ms.U3T33_vcs_lat_posn.phys = @sysvar::MsgU3T_Obj_33_50ms::SigU3T33_vcs_lat_posn;
   Msg_U3T_Obj_33_50ms.U3T33_vcs_lat_vel.phys = @sysvar::MsgU3T_Obj_33_50ms::SigU3T33_vcs_lat_vel;
   Msg_U3T_Obj_33_50ms.U3T33_vcs_long_accel.phys = @sysvar::MsgU3T_Obj_33_50ms::SigU3T33_vcs_long_accel;
   Msg_U3T_Obj_33_50ms.U3T33_vcs_long_posn.phys = @sysvar::MsgU3T_Obj_33_50ms::SigU3T33_vcs_long_posn;
   Msg_U3T_Obj_33_50ms.U3T33_vcs_long_vel.phys = @sysvar::MsgU3T_Obj_33_50ms::SigU3T33_vcs_long_vel;
   Msg_U3T_Obj_33_50ms.U3T33_conf_overall.phys = @sysvar::MsgU3T_Obj_33_50ms::SigU3T33_conf_overall;
   Msg_U3T_Obj_33_50ms.U3T33_f_oncoming.phys = @sysvar::MsgU3T_Obj_33_50ms::SigU3T33_f_oncoming;
   Msg_U3T_Obj_33_50ms.U3T33_f_receding.phys = @sysvar::MsgU3T_Obj_33_50ms::SigU3T33_f_receding;
   output(Msg_U3T_Obj_33_50ms);
   Msg_U3T_Obj_32_50ms.U3T32_age.phys = @sysvar::MsgU3T_Obj_32_50ms::SigU3T32_age;
   Msg_U3T_Obj_32_50ms.U3T32_f_moveable.phys = @sysvar::MsgU3T_Obj_32_50ms::SigU3T32_f_moveable;
   Msg_U3T_Obj_32_50ms.U3T32_f_stationary.phys = @sysvar::MsgU3T_Obj_32_50ms::SigU3T32_f_stationary;
   Msg_U3T_Obj_32_50ms.U3T32_FLcorner_lat.phys = @sysvar::MsgU3T_Obj_32_50ms::SigU3T32_FLcorner_lat;
   Msg_U3T_Obj_32_50ms.U3T32_object_class.phys = @sysvar::MsgU3T_Obj_32_50ms::SigU3T32_object_class;
   Msg_U3T_Obj_32_50ms.U3T32_FLcorner_long.phys = @sysvar::MsgU3T_Obj_32_50ms::SigU3T32_FLcorner_long;
   Msg_U3T_Obj_32_50ms.U3T32_status.phys = @sysvar::MsgU3T_Obj_32_50ms::SigU3T32_status;
   Msg_U3T_Obj_32_50ms.U3T32_FRcorner_lat.phys = @sysvar::MsgU3T_Obj_32_50ms::SigU3T32_FRcorner_lat;
   Msg_U3T_Obj_32_50ms.U3T32_FRcorner_long.phys = @sysvar::MsgU3T_Obj_32_50ms::SigU3T32_FRcorner_long;
   Msg_U3T_Obj_32_50ms.U3T32_heading_rate.phys = @sysvar::MsgU3T_Obj_32_50ms::SigU3T32_heading_rate;
   Msg_U3T_Obj_32_50ms.U3T32_id.phys = @sysvar::MsgU3T_Obj_32_50ms::SigU3T32_id;
   Msg_U3T_Obj_32_50ms.U3T32_length.phys = @sysvar::MsgU3T_Obj_32_50ms::SigU3T32_length;
   Msg_U3T_Obj_32_50ms.U3T32_RLcorner_lat.phys = @sysvar::MsgU3T_Obj_32_50ms::SigU3T32_RLcorner_lat;
   Msg_U3T_Obj_32_50ms.U3T32_RLcorner_long.phys = @sysvar::MsgU3T_Obj_32_50ms::SigU3T32_RLcorner_long;
   Msg_U3T_Obj_32_50ms.U3T32_RRcorner_lat.phys = @sysvar::MsgU3T_Obj_32_50ms::SigU3T32_RRcorner_lat;
   Msg_U3T_Obj_32_50ms.U3T32_RRcorner_long.phys = @sysvar::MsgU3T_Obj_32_50ms::SigU3T32_RRcorner_long;
   Msg_U3T_Obj_32_50ms.U3T32_speed.phys = @sysvar::MsgU3T_Obj_32_50ms::SigU3T32_speed;
   Msg_U3T_Obj_32_50ms.U3T32_width.phys = @sysvar::MsgU3T_Obj_32_50ms::SigU3T32_width;
   Msg_U3T_Obj_32_50ms.U3T32_fusion_source.phys = @sysvar::MsgU3T_Obj_32_50ms::SigU3T32_fusion_source;
   Msg_U3T_Obj_32_50ms.U3T32_vcs_heading.phys = @sysvar::MsgU3T_Obj_32_50ms::SigU3T32_vcs_heading;
   Msg_U3T_Obj_32_50ms.U3T32_vcs_lat_accel.phys = @sysvar::MsgU3T_Obj_32_50ms::SigU3T32_vcs_lat_accel;
   Msg_U3T_Obj_32_50ms.U3T32_vcs_lat_posn.phys = @sysvar::MsgU3T_Obj_32_50ms::SigU3T32_vcs_lat_posn;
   Msg_U3T_Obj_32_50ms.U3T32_vcs_lat_vel.phys = @sysvar::MsgU3T_Obj_32_50ms::SigU3T32_vcs_lat_vel;
   Msg_U3T_Obj_32_50ms.U3T32_vcs_long_accel.phys = @sysvar::MsgU3T_Obj_32_50ms::SigU3T32_vcs_long_accel;
   Msg_U3T_Obj_32_50ms.U3T32_vcs_long_posn.phys = @sysvar::MsgU3T_Obj_32_50ms::SigU3T32_vcs_long_posn;
   Msg_U3T_Obj_32_50ms.U3T32_vcs_long_vel.phys = @sysvar::MsgU3T_Obj_32_50ms::SigU3T32_vcs_long_vel;
   Msg_U3T_Obj_32_50ms.U3T32_conf_overall.phys = @sysvar::MsgU3T_Obj_32_50ms::SigU3T32_conf_overall;
   Msg_U3T_Obj_32_50ms.U3T32_f_oncoming.phys = @sysvar::MsgU3T_Obj_32_50ms::SigU3T32_f_oncoming;
   Msg_U3T_Obj_32_50ms.U3T32_f_receding.phys = @sysvar::MsgU3T_Obj_32_50ms::SigU3T32_f_receding;
   output(Msg_U3T_Obj_32_50ms);
   Msg_U3T_Obj_23_50ms.U3T23_age.phys = @sysvar::MsgU3T_Obj_23_50ms::SigU3T23_age;
   Msg_U3T_Obj_23_50ms.U3T23_f_moveable.phys = @sysvar::MsgU3T_Obj_23_50ms::SigU3T23_f_moveable;
   Msg_U3T_Obj_23_50ms.U3T23_f_stationary.phys = @sysvar::MsgU3T_Obj_23_50ms::SigU3T23_f_stationary;
   Msg_U3T_Obj_23_50ms.U3T23_FLcorner_lat.phys = @sysvar::MsgU3T_Obj_23_50ms::SigU3T23_FLcorner_lat;
   Msg_U3T_Obj_23_50ms.U3T23_object_class.phys = @sysvar::MsgU3T_Obj_23_50ms::SigU3T23_object_class;
   Msg_U3T_Obj_23_50ms.U3T23_FLcorner_long.phys = @sysvar::MsgU3T_Obj_23_50ms::SigU3T23_FLcorner_long;
   Msg_U3T_Obj_23_50ms.U3T23_status.phys = @sysvar::MsgU3T_Obj_23_50ms::SigU3T23_status;
   Msg_U3T_Obj_23_50ms.U3T23_FRcorner_lat.phys = @sysvar::MsgU3T_Obj_23_50ms::SigU3T23_FRcorner_lat;
   Msg_U3T_Obj_23_50ms.U3T23_FRcorner_long.phys = @sysvar::MsgU3T_Obj_23_50ms::SigU3T23_FRcorner_long;
   Msg_U3T_Obj_23_50ms.U3T23_heading_rate.phys = @sysvar::MsgU3T_Obj_23_50ms::SigU3T23_heading_rate;
   Msg_U3T_Obj_23_50ms.U3T23_id.phys = @sysvar::MsgU3T_Obj_23_50ms::SigU3T23_id;
   Msg_U3T_Obj_23_50ms.U3T23_length.phys = @sysvar::MsgU3T_Obj_23_50ms::SigU3T23_length;
   Msg_U3T_Obj_23_50ms.U3T23_RLcorner_lat.phys = @sysvar::MsgU3T_Obj_23_50ms::SigU3T23_RLcorner_lat;
   Msg_U3T_Obj_23_50ms.U3T23_RLcorner_long.phys = @sysvar::MsgU3T_Obj_23_50ms::SigU3T23_RLcorner_long;
   Msg_U3T_Obj_23_50ms.U3T23_RRcorner_lat.phys = @sysvar::MsgU3T_Obj_23_50ms::SigU3T23_RRcorner_lat;
   Msg_U3T_Obj_23_50ms.U3T23_RRcorner_long.phys = @sysvar::MsgU3T_Obj_23_50ms::SigU3T23_RRcorner_long;
   Msg_U3T_Obj_23_50ms.U3T23_speed.phys = @sysvar::MsgU3T_Obj_23_50ms::SigU3T23_speed;
   Msg_U3T_Obj_23_50ms.U3T23_width.phys = @sysvar::MsgU3T_Obj_23_50ms::SigU3T23_width;
   Msg_U3T_Obj_23_50ms.U3T23_fusion_source.phys = @sysvar::MsgU3T_Obj_23_50ms::SigU3T23_fusion_source;
   Msg_U3T_Obj_23_50ms.U3T23_vcs_heading.phys = @sysvar::MsgU3T_Obj_23_50ms::SigU3T23_vcs_heading;
   Msg_U3T_Obj_23_50ms.U3T23_vcs_lat_accel.phys = @sysvar::MsgU3T_Obj_23_50ms::SigU3T23_vcs_lat_accel;
   Msg_U3T_Obj_23_50ms.U3T23_vcs_lat_posn.phys = @sysvar::MsgU3T_Obj_23_50ms::SigU3T23_vcs_lat_posn;
   Msg_U3T_Obj_23_50ms.U3T23_vcs_lat_vel.phys = @sysvar::MsgU3T_Obj_23_50ms::SigU3T23_vcs_lat_vel;
   Msg_U3T_Obj_23_50ms.U3T23_vcs_long_accel.phys = @sysvar::MsgU3T_Obj_23_50ms::SigU3T23_vcs_long_accel;
   Msg_U3T_Obj_23_50ms.U3T23_vcs_long_posn.phys = @sysvar::MsgU3T_Obj_23_50ms::SigU3T23_vcs_long_posn;
   Msg_U3T_Obj_23_50ms.U3T23_vcs_long_vel.phys = @sysvar::MsgU3T_Obj_23_50ms::SigU3T23_vcs_long_vel;
   Msg_U3T_Obj_23_50ms.U3T23_conf_overall.phys = @sysvar::MsgU3T_Obj_23_50ms::SigU3T23_conf_overall;
   Msg_U3T_Obj_23_50ms.U3T23_f_oncoming.phys = @sysvar::MsgU3T_Obj_23_50ms::SigU3T23_f_oncoming;
   Msg_U3T_Obj_23_50ms.U3T23_f_receding.phys = @sysvar::MsgU3T_Obj_23_50ms::SigU3T23_f_receding;
   output(Msg_U3T_Obj_23_50ms);
   Msg_U3T_Obj_31_50ms.U3T31_age.phys = @sysvar::MsgU3T_Obj_31_50ms::SigU3T31_age;
   Msg_U3T_Obj_31_50ms.U3T31_f_moveable.phys = @sysvar::MsgU3T_Obj_31_50ms::SigU3T31_f_moveable;
   Msg_U3T_Obj_31_50ms.U3T31_f_stationary.phys = @sysvar::MsgU3T_Obj_31_50ms::SigU3T31_f_stationary;
   Msg_U3T_Obj_31_50ms.U3T31_FLcorner_lat.phys = @sysvar::MsgU3T_Obj_31_50ms::SigU3T31_FLcorner_lat;
   Msg_U3T_Obj_31_50ms.U3T31_object_class.phys = @sysvar::MsgU3T_Obj_31_50ms::SigU3T31_object_class;
   Msg_U3T_Obj_31_50ms.U3T31_FLcorner_long.phys = @sysvar::MsgU3T_Obj_31_50ms::SigU3T31_FLcorner_long;
   Msg_U3T_Obj_31_50ms.U3T31_status.phys = @sysvar::MsgU3T_Obj_31_50ms::SigU3T31_status;
   Msg_U3T_Obj_31_50ms.U3T31_FRcorner_lat.phys = @sysvar::MsgU3T_Obj_31_50ms::SigU3T31_FRcorner_lat;
   Msg_U3T_Obj_31_50ms.U3T31_FRcorner_long.phys = @sysvar::MsgU3T_Obj_31_50ms::SigU3T31_FRcorner_long;
   Msg_U3T_Obj_31_50ms.U3T31_heading_rate.phys = @sysvar::MsgU3T_Obj_31_50ms::SigU3T31_heading_rate;
   Msg_U3T_Obj_31_50ms.U3T31_id.phys = @sysvar::MsgU3T_Obj_31_50ms::SigU3T31_id;
   Msg_U3T_Obj_31_50ms.U3T31_length.phys = @sysvar::MsgU3T_Obj_31_50ms::SigU3T31_length;
   Msg_U3T_Obj_31_50ms.U3T31_RLcorner_lat.phys = @sysvar::MsgU3T_Obj_31_50ms::SigU3T31_RLcorner_lat;
   Msg_U3T_Obj_31_50ms.U3T31_RLcorner_long.phys = @sysvar::MsgU3T_Obj_31_50ms::SigU3T31_RLcorner_long;
   Msg_U3T_Obj_31_50ms.U3T31_RRcorner_lat.phys = @sysvar::MsgU3T_Obj_31_50ms::SigU3T31_RRcorner_lat;
   Msg_U3T_Obj_31_50ms.U3T31_RRcorner_long.phys = @sysvar::MsgU3T_Obj_31_50ms::SigU3T31_RRcorner_long;
   Msg_U3T_Obj_31_50ms.U3T31_speed.phys = @sysvar::MsgU3T_Obj_31_50ms::SigU3T31_speed;
   Msg_U3T_Obj_31_50ms.U3T31_width.phys = @sysvar::MsgU3T_Obj_31_50ms::SigU3T31_width;
   Msg_U3T_Obj_31_50ms.U3T31_fusion_source.phys = @sysvar::MsgU3T_Obj_31_50ms::SigU3T31_fusion_source;
   Msg_U3T_Obj_31_50ms.U3T31_vcs_heading.phys = @sysvar::MsgU3T_Obj_31_50ms::SigU3T31_vcs_heading;
   Msg_U3T_Obj_31_50ms.U3T31_vcs_lat_accel.phys = @sysvar::MsgU3T_Obj_31_50ms::SigU3T31_vcs_lat_accel;
   Msg_U3T_Obj_31_50ms.U3T31_vcs_lat_posn.phys = @sysvar::MsgU3T_Obj_31_50ms::SigU3T31_vcs_lat_posn;
   Msg_U3T_Obj_31_50ms.U3T31_vcs_lat_vel.phys = @sysvar::MsgU3T_Obj_31_50ms::SigU3T31_vcs_lat_vel;
   Msg_U3T_Obj_31_50ms.U3T31_vcs_long_accel.phys = @sysvar::MsgU3T_Obj_31_50ms::SigU3T31_vcs_long_accel;
   Msg_U3T_Obj_31_50ms.U3T31_vcs_long_posn.phys = @sysvar::MsgU3T_Obj_31_50ms::SigU3T31_vcs_long_posn;
   Msg_U3T_Obj_31_50ms.U3T31_vcs_long_vel.phys = @sysvar::MsgU3T_Obj_31_50ms::SigU3T31_vcs_long_vel;
   Msg_U3T_Obj_31_50ms.U3T31_conf_overall.phys = @sysvar::MsgU3T_Obj_31_50ms::SigU3T31_conf_overall;
   Msg_U3T_Obj_31_50ms.U3T31_f_oncoming.phys = @sysvar::MsgU3T_Obj_31_50ms::SigU3T31_f_oncoming;
   Msg_U3T_Obj_31_50ms.U3T31_f_receding.phys = @sysvar::MsgU3T_Obj_31_50ms::SigU3T31_f_receding;
   output(Msg_U3T_Obj_31_50ms);
   Msg_U3T_Obj_30_50ms.U3T30_age.phys = @sysvar::MsgU3T_Obj_30_50ms::SigU3T30_age;
   Msg_U3T_Obj_30_50ms.U3T30_f_moveable.phys = @sysvar::MsgU3T_Obj_30_50ms::SigU3T30_f_moveable;
   Msg_U3T_Obj_30_50ms.U3T30_f_stationary.phys = @sysvar::MsgU3T_Obj_30_50ms::SigU3T30_f_stationary;
   Msg_U3T_Obj_30_50ms.U3T30_FLcorner_lat.phys = @sysvar::MsgU3T_Obj_30_50ms::SigU3T30_FLcorner_lat;
   Msg_U3T_Obj_30_50ms.U3T30_object_class.phys = @sysvar::MsgU3T_Obj_30_50ms::SigU3T30_object_class;
   Msg_U3T_Obj_30_50ms.U3T30_FLcorner_long.phys = @sysvar::MsgU3T_Obj_30_50ms::SigU3T30_FLcorner_long;
   Msg_U3T_Obj_30_50ms.U3T30_status.phys = @sysvar::MsgU3T_Obj_30_50ms::SigU3T30_status;
   Msg_U3T_Obj_30_50ms.U3T30_FRcorner_lat.phys = @sysvar::MsgU3T_Obj_30_50ms::SigU3T30_FRcorner_lat;
   Msg_U3T_Obj_30_50ms.U3T30_FRcorner_long.phys = @sysvar::MsgU3T_Obj_30_50ms::SigU3T30_FRcorner_long;
   Msg_U3T_Obj_30_50ms.U3T30_heading_rate.phys = @sysvar::MsgU3T_Obj_30_50ms::SigU3T30_heading_rate;
   Msg_U3T_Obj_30_50ms.U3T30_id.phys = @sysvar::MsgU3T_Obj_30_50ms::SigU3T30_id;
   Msg_U3T_Obj_30_50ms.U3T30_length.phys = @sysvar::MsgU3T_Obj_30_50ms::SigU3T30_length;
   Msg_U3T_Obj_30_50ms.U3T30_RLcorner_lat.phys = @sysvar::MsgU3T_Obj_30_50ms::SigU3T30_RLcorner_lat;
   Msg_U3T_Obj_30_50ms.U3T30_RLcorner_long.phys = @sysvar::MsgU3T_Obj_30_50ms::SigU3T30_RLcorner_long;
   Msg_U3T_Obj_30_50ms.U3T30_RRcorner_lat.phys = @sysvar::MsgU3T_Obj_30_50ms::SigU3T30_RRcorner_lat;
   Msg_U3T_Obj_30_50ms.U3T30_RRcorner_long.phys = @sysvar::MsgU3T_Obj_30_50ms::SigU3T30_RRcorner_long;
   Msg_U3T_Obj_30_50ms.U3T30_speed.phys = @sysvar::MsgU3T_Obj_30_50ms::SigU3T30_speed;
   Msg_U3T_Obj_30_50ms.U3T30_width.phys = @sysvar::MsgU3T_Obj_30_50ms::SigU3T30_width;
   Msg_U3T_Obj_30_50ms.U3T30_fusion_source.phys = @sysvar::MsgU3T_Obj_30_50ms::SigU3T30_fusion_source;
   Msg_U3T_Obj_30_50ms.U3T30_vcs_heading.phys = @sysvar::MsgU3T_Obj_30_50ms::SigU3T30_vcs_heading;
   Msg_U3T_Obj_30_50ms.U3T30_vcs_lat_accel.phys = @sysvar::MsgU3T_Obj_30_50ms::SigU3T30_vcs_lat_accel;
   Msg_U3T_Obj_30_50ms.U3T30_vcs_lat_posn.phys = @sysvar::MsgU3T_Obj_30_50ms::SigU3T30_vcs_lat_posn;
   Msg_U3T_Obj_30_50ms.U3T30_vcs_lat_vel.phys = @sysvar::MsgU3T_Obj_30_50ms::SigU3T30_vcs_lat_vel;
   Msg_U3T_Obj_30_50ms.U3T30_vcs_long_accel.phys = @sysvar::MsgU3T_Obj_30_50ms::SigU3T30_vcs_long_accel;
   Msg_U3T_Obj_30_50ms.U3T30_vcs_long_posn.phys = @sysvar::MsgU3T_Obj_30_50ms::SigU3T30_vcs_long_posn;
   Msg_U3T_Obj_30_50ms.U3T30_vcs_long_vel.phys = @sysvar::MsgU3T_Obj_30_50ms::SigU3T30_vcs_long_vel;
   Msg_U3T_Obj_30_50ms.U3T30_conf_overall.phys = @sysvar::MsgU3T_Obj_30_50ms::SigU3T30_conf_overall;
   Msg_U3T_Obj_30_50ms.U3T30_f_oncoming.phys = @sysvar::MsgU3T_Obj_30_50ms::SigU3T30_f_oncoming;
   Msg_U3T_Obj_30_50ms.U3T30_f_receding.phys = @sysvar::MsgU3T_Obj_30_50ms::SigU3T30_f_receding;
   output(Msg_U3T_Obj_30_50ms);
   Msg_U3T_Obj_29_50ms.U3T29_age.phys = @sysvar::MsgU3T_Obj_29_50ms::SigU3T29_age;
   Msg_U3T_Obj_29_50ms.U3T29_f_moveable.phys = @sysvar::MsgU3T_Obj_29_50ms::SigU3T29_f_moveable;
   Msg_U3T_Obj_29_50ms.U3T29_f_stationary.phys = @sysvar::MsgU3T_Obj_29_50ms::SigU3T29_f_stationary;
   Msg_U3T_Obj_29_50ms.U3T29_FLcorner_lat.phys = @sysvar::MsgU3T_Obj_29_50ms::SigU3T29_FLcorner_lat;
   Msg_U3T_Obj_29_50ms.U3T29_object_class.phys = @sysvar::MsgU3T_Obj_29_50ms::SigU3T29_object_class;
   Msg_U3T_Obj_29_50ms.U3T29_FLcorner_long.phys = @sysvar::MsgU3T_Obj_29_50ms::SigU3T29_FLcorner_long;
   Msg_U3T_Obj_29_50ms.U3T29_status.phys = @sysvar::MsgU3T_Obj_29_50ms::SigU3T29_status;
   Msg_U3T_Obj_29_50ms.U3T29_FRcorner_lat.phys = @sysvar::MsgU3T_Obj_29_50ms::SigU3T29_FRcorner_lat;
   Msg_U3T_Obj_29_50ms.U3T29_FRcorner_long.phys = @sysvar::MsgU3T_Obj_29_50ms::SigU3T29_FRcorner_long;
   Msg_U3T_Obj_29_50ms.U3T29_heading_rate.phys = @sysvar::MsgU3T_Obj_29_50ms::SigU3T29_heading_rate;
   Msg_U3T_Obj_29_50ms.U3T29_id.phys = @sysvar::MsgU3T_Obj_29_50ms::SigU3T29_id;
   Msg_U3T_Obj_29_50ms.U3T29_length.phys = @sysvar::MsgU3T_Obj_29_50ms::SigU3T29_length;
   Msg_U3T_Obj_29_50ms.U3T29_RLcorner_lat.phys = @sysvar::MsgU3T_Obj_29_50ms::SigU3T29_RLcorner_lat;
   Msg_U3T_Obj_29_50ms.U3T29_RLcorner_long.phys = @sysvar::MsgU3T_Obj_29_50ms::SigU3T29_RLcorner_long;
   Msg_U3T_Obj_29_50ms.U3T29_RRcorner_lat.phys = @sysvar::MsgU3T_Obj_29_50ms::SigU3T29_RRcorner_lat;
   Msg_U3T_Obj_29_50ms.U3T29_RRcorner_long.phys = @sysvar::MsgU3T_Obj_29_50ms::SigU3T29_RRcorner_long;
   Msg_U3T_Obj_29_50ms.U3T29_speed.phys = @sysvar::MsgU3T_Obj_29_50ms::SigU3T29_speed;
   Msg_U3T_Obj_29_50ms.U3T29_width.phys = @sysvar::MsgU3T_Obj_29_50ms::SigU3T29_width;
   Msg_U3T_Obj_29_50ms.U3T29_fusion_source.phys = @sysvar::MsgU3T_Obj_29_50ms::SigU3T29_fusion_source;
   Msg_U3T_Obj_29_50ms.U3T29_vcs_heading.phys = @sysvar::MsgU3T_Obj_29_50ms::SigU3T29_vcs_heading;
   Msg_U3T_Obj_29_50ms.U3T29_vcs_lat_accel.phys = @sysvar::MsgU3T_Obj_29_50ms::SigU3T29_vcs_lat_accel;
   Msg_U3T_Obj_29_50ms.U3T29_vcs_lat_posn.phys = @sysvar::MsgU3T_Obj_29_50ms::SigU3T29_vcs_lat_posn;
   Msg_U3T_Obj_29_50ms.U3T29_vcs_lat_vel.phys = @sysvar::MsgU3T_Obj_29_50ms::SigU3T29_vcs_lat_vel;
   Msg_U3T_Obj_29_50ms.U3T29_vcs_long_accel.phys = @sysvar::MsgU3T_Obj_29_50ms::SigU3T29_vcs_long_accel;
   Msg_U3T_Obj_29_50ms.U3T29_vcs_long_posn.phys = @sysvar::MsgU3T_Obj_29_50ms::SigU3T29_vcs_long_posn;
   Msg_U3T_Obj_29_50ms.U3T29_vcs_long_vel.phys = @sysvar::MsgU3T_Obj_29_50ms::SigU3T29_vcs_long_vel;
   Msg_U3T_Obj_29_50ms.U3T29_conf_overall.phys = @sysvar::MsgU3T_Obj_29_50ms::SigU3T29_conf_overall;
   Msg_U3T_Obj_29_50ms.U3T29_f_oncoming.phys = @sysvar::MsgU3T_Obj_29_50ms::SigU3T29_f_oncoming;
   Msg_U3T_Obj_29_50ms.U3T29_f_receding.phys = @sysvar::MsgU3T_Obj_29_50ms::SigU3T29_f_receding;
   output(Msg_U3T_Obj_29_50ms);
   Msg_U3T_Obj_28_50ms.U3T28_age.phys = @sysvar::MsgU3T_Obj_28_50ms::SigU3T28_age;
   Msg_U3T_Obj_28_50ms.U3T28_f_moveable.phys = @sysvar::MsgU3T_Obj_28_50ms::SigU3T28_f_moveable;
   Msg_U3T_Obj_28_50ms.U3T28_f_stationary.phys = @sysvar::MsgU3T_Obj_28_50ms::SigU3T28_f_stationary;
   Msg_U3T_Obj_28_50ms.U3T28_FLcorner_lat.phys = @sysvar::MsgU3T_Obj_28_50ms::SigU3T28_FLcorner_lat;
   Msg_U3T_Obj_28_50ms.U3T28_object_class.phys = @sysvar::MsgU3T_Obj_28_50ms::SigU3T28_object_class;
   Msg_U3T_Obj_28_50ms.U3T28_FLcorner_long.phys = @sysvar::MsgU3T_Obj_28_50ms::SigU3T28_FLcorner_long;
   Msg_U3T_Obj_28_50ms.U3T28_status.phys = @sysvar::MsgU3T_Obj_28_50ms::SigU3T28_status;
   Msg_U3T_Obj_28_50ms.U3T28_FRcorner_lat.phys = @sysvar::MsgU3T_Obj_28_50ms::SigU3T28_FRcorner_lat;
   Msg_U3T_Obj_28_50ms.U3T28_FRcorner_long.phys = @sysvar::MsgU3T_Obj_28_50ms::SigU3T28_FRcorner_long;
   Msg_U3T_Obj_28_50ms.U3T28_heading_rate.phys = @sysvar::MsgU3T_Obj_28_50ms::SigU3T28_heading_rate;
   Msg_U3T_Obj_28_50ms.U3T28_id.phys = @sysvar::MsgU3T_Obj_28_50ms::SigU3T28_id;
   Msg_U3T_Obj_28_50ms.U3T28_length.phys = @sysvar::MsgU3T_Obj_28_50ms::SigU3T28_length;
   Msg_U3T_Obj_28_50ms.U3T28_RLcorner_lat.phys = @sysvar::MsgU3T_Obj_28_50ms::SigU3T28_RLcorner_lat;
   Msg_U3T_Obj_28_50ms.U3T28_RLcorner_long.phys = @sysvar::MsgU3T_Obj_28_50ms::SigU3T28_RLcorner_long;
   Msg_U3T_Obj_28_50ms.U3T28_RRcorner_lat.phys = @sysvar::MsgU3T_Obj_28_50ms::SigU3T28_RRcorner_lat;
   Msg_U3T_Obj_28_50ms.U3T28_RRcorner_long.phys = @sysvar::MsgU3T_Obj_28_50ms::SigU3T28_RRcorner_long;
   Msg_U3T_Obj_28_50ms.U3T28_speed.phys = @sysvar::MsgU3T_Obj_28_50ms::SigU3T28_speed;
   Msg_U3T_Obj_28_50ms.U3T28_width.phys = @sysvar::MsgU3T_Obj_28_50ms::SigU3T28_width;
   Msg_U3T_Obj_28_50ms.U3T28_fusion_source.phys = @sysvar::MsgU3T_Obj_28_50ms::SigU3T28_fusion_source;
   Msg_U3T_Obj_28_50ms.U3T28_vcs_heading.phys = @sysvar::MsgU3T_Obj_28_50ms::SigU3T28_vcs_heading;
   Msg_U3T_Obj_28_50ms.U3T28_vcs_lat_accel.phys = @sysvar::MsgU3T_Obj_28_50ms::SigU3T28_vcs_lat_accel;
   Msg_U3T_Obj_28_50ms.U3T28_vcs_lat_posn.phys = @sysvar::MsgU3T_Obj_28_50ms::SigU3T28_vcs_lat_posn;
   Msg_U3T_Obj_28_50ms.U3T28_vcs_lat_vel.phys = @sysvar::MsgU3T_Obj_28_50ms::SigU3T28_vcs_lat_vel;
   Msg_U3T_Obj_28_50ms.U3T28_vcs_long_accel.phys = @sysvar::MsgU3T_Obj_28_50ms::SigU3T28_vcs_long_accel;
   Msg_U3T_Obj_28_50ms.U3T28_vcs_long_posn.phys = @sysvar::MsgU3T_Obj_28_50ms::SigU3T28_vcs_long_posn;
   Msg_U3T_Obj_28_50ms.U3T28_vcs_long_vel.phys = @sysvar::MsgU3T_Obj_28_50ms::SigU3T28_vcs_long_vel;
   Msg_U3T_Obj_28_50ms.U3T28_conf_overall.phys = @sysvar::MsgU3T_Obj_28_50ms::SigU3T28_conf_overall;
   Msg_U3T_Obj_28_50ms.U3T28_f_oncoming.phys = @sysvar::MsgU3T_Obj_28_50ms::SigU3T28_f_oncoming;
   Msg_U3T_Obj_28_50ms.U3T28_f_receding.phys = @sysvar::MsgU3T_Obj_28_50ms::SigU3T28_f_receding;
   output(Msg_U3T_Obj_28_50ms);
   Msg_U3T_Obj_27_50ms.U3T27_age.phys = @sysvar::MsgU3T_Obj_27_50ms::SigU3T27_age;
   Msg_U3T_Obj_27_50ms.U3T27_f_moveable.phys = @sysvar::MsgU3T_Obj_27_50ms::SigU3T27_f_moveable;
   Msg_U3T_Obj_27_50ms.U3T27_f_stationary.phys = @sysvar::MsgU3T_Obj_27_50ms::SigU3T27_f_stationary;
   Msg_U3T_Obj_27_50ms.U3T27_FLcorner_lat.phys = @sysvar::MsgU3T_Obj_27_50ms::SigU3T27_FLcorner_lat;
   Msg_U3T_Obj_27_50ms.U3T27_object_class.phys = @sysvar::MsgU3T_Obj_27_50ms::SigU3T27_object_class;
   Msg_U3T_Obj_27_50ms.U3T27_FLcorner_long.phys = @sysvar::MsgU3T_Obj_27_50ms::SigU3T27_FLcorner_long;
   Msg_U3T_Obj_27_50ms.U3T27_status.phys = @sysvar::MsgU3T_Obj_27_50ms::SigU3T27_status;
   Msg_U3T_Obj_27_50ms.U3T27_FRcorner_lat.phys = @sysvar::MsgU3T_Obj_27_50ms::SigU3T27_FRcorner_lat;
   Msg_U3T_Obj_27_50ms.U3T27_FRcorner_long.phys = @sysvar::MsgU3T_Obj_27_50ms::SigU3T27_FRcorner_long;
   Msg_U3T_Obj_27_50ms.U3T27_heading_rate.phys = @sysvar::MsgU3T_Obj_27_50ms::SigU3T27_heading_rate;
   Msg_U3T_Obj_27_50ms.U3T27_id.phys = @sysvar::MsgU3T_Obj_27_50ms::SigU3T27_id;
   Msg_U3T_Obj_27_50ms.U3T27_length.phys = @sysvar::MsgU3T_Obj_27_50ms::SigU3T27_length;
   Msg_U3T_Obj_27_50ms.U3T27_RLcorner_lat.phys = @sysvar::MsgU3T_Obj_27_50ms::SigU3T27_RLcorner_lat;
   Msg_U3T_Obj_27_50ms.U3T27_RLcorner_long.phys = @sysvar::MsgU3T_Obj_27_50ms::SigU3T27_RLcorner_long;
   Msg_U3T_Obj_27_50ms.U3T27_RRcorner_lat.phys = @sysvar::MsgU3T_Obj_27_50ms::SigU3T27_RRcorner_lat;
   Msg_U3T_Obj_27_50ms.U3T27_RRcorner_long.phys = @sysvar::MsgU3T_Obj_27_50ms::SigU3T27_RRcorner_long;
   Msg_U3T_Obj_27_50ms.U3T27_speed.phys = @sysvar::MsgU3T_Obj_27_50ms::SigU3T27_speed;
   Msg_U3T_Obj_27_50ms.U3T27_width.phys = @sysvar::MsgU3T_Obj_27_50ms::SigU3T27_width;
   Msg_U3T_Obj_27_50ms.U3T27_fusion_source.phys = @sysvar::MsgU3T_Obj_27_50ms::SigU3T27_fusion_source;
   Msg_U3T_Obj_27_50ms.U3T27_vcs_heading.phys = @sysvar::MsgU3T_Obj_27_50ms::SigU3T27_vcs_heading;
   Msg_U3T_Obj_27_50ms.U3T27_vcs_lat_accel.phys = @sysvar::MsgU3T_Obj_27_50ms::SigU3T27_vcs_lat_accel;
   Msg_U3T_Obj_27_50ms.U3T27_vcs_lat_posn.phys = @sysvar::MsgU3T_Obj_27_50ms::SigU3T27_vcs_lat_posn;
   Msg_U3T_Obj_27_50ms.U3T27_vcs_lat_vel.phys = @sysvar::MsgU3T_Obj_27_50ms::SigU3T27_vcs_lat_vel;
   Msg_U3T_Obj_27_50ms.U3T27_vcs_long_accel.phys = @sysvar::MsgU3T_Obj_27_50ms::SigU3T27_vcs_long_accel;
   Msg_U3T_Obj_27_50ms.U3T27_vcs_long_posn.phys = @sysvar::MsgU3T_Obj_27_50ms::SigU3T27_vcs_long_posn;
   Msg_U3T_Obj_27_50ms.U3T27_vcs_long_vel.phys = @sysvar::MsgU3T_Obj_27_50ms::SigU3T27_vcs_long_vel;
   Msg_U3T_Obj_27_50ms.U3T27_conf_overall.phys = @sysvar::MsgU3T_Obj_27_50ms::SigU3T27_conf_overall;
   Msg_U3T_Obj_27_50ms.U3T27_f_oncoming.phys = @sysvar::MsgU3T_Obj_27_50ms::SigU3T27_f_oncoming;
   Msg_U3T_Obj_27_50ms.U3T27_f_receding.phys = @sysvar::MsgU3T_Obj_27_50ms::SigU3T27_f_receding;
   output(Msg_U3T_Obj_27_50ms);
   Msg_U3T_Obj_26_50ms.U3T26_age.phys = @sysvar::MsgU3T_Obj_26_50ms::SigU3T26_age;
   Msg_U3T_Obj_26_50ms.U3T26_f_moveable.phys = @sysvar::MsgU3T_Obj_26_50ms::SigU3T26_f_moveable;
   Msg_U3T_Obj_26_50ms.U3T26_f_stationary.phys = @sysvar::MsgU3T_Obj_26_50ms::SigU3T26_f_stationary;
   Msg_U3T_Obj_26_50ms.U3T26_FLcorner_lat.phys = @sysvar::MsgU3T_Obj_26_50ms::SigU3T26_FLcorner_lat;
   Msg_U3T_Obj_26_50ms.U3T26_object_class.phys = @sysvar::MsgU3T_Obj_26_50ms::SigU3T26_object_class;
   Msg_U3T_Obj_26_50ms.U3T26_FLcorner_long.phys = @sysvar::MsgU3T_Obj_26_50ms::SigU3T26_FLcorner_long;
   Msg_U3T_Obj_26_50ms.U3T26_status.phys = @sysvar::MsgU3T_Obj_26_50ms::SigU3T26_status;
   Msg_U3T_Obj_26_50ms.U3T26_FRcorner_lat.phys = @sysvar::MsgU3T_Obj_26_50ms::SigU3T26_FRcorner_lat;
   Msg_U3T_Obj_26_50ms.U3T26_FRcorner_long.phys = @sysvar::MsgU3T_Obj_26_50ms::SigU3T26_FRcorner_long;
   Msg_U3T_Obj_26_50ms.U3T26_heading_rate.phys = @sysvar::MsgU3T_Obj_26_50ms::SigU3T26_heading_rate;
   Msg_U3T_Obj_26_50ms.U3T26_id.phys = @sysvar::MsgU3T_Obj_26_50ms::SigU3T26_id;
   Msg_U3T_Obj_26_50ms.U3T26_length.phys = @sysvar::MsgU3T_Obj_26_50ms::SigU3T26_length;
   Msg_U3T_Obj_26_50ms.U3T26_RLcorner_lat.phys = @sysvar::MsgU3T_Obj_26_50ms::SigU3T26_RLcorner_lat;
   Msg_U3T_Obj_26_50ms.U3T26_RLcorner_long.phys = @sysvar::MsgU3T_Obj_26_50ms::SigU3T26_RLcorner_long;
   Msg_U3T_Obj_26_50ms.U3T26_RRcorner_lat.phys = @sysvar::MsgU3T_Obj_26_50ms::SigU3T26_RRcorner_lat;
   Msg_U3T_Obj_26_50ms.U3T26_RRcorner_long.phys = @sysvar::MsgU3T_Obj_26_50ms::SigU3T26_RRcorner_long;
   Msg_U3T_Obj_26_50ms.U3T26_speed.phys = @sysvar::MsgU3T_Obj_26_50ms::SigU3T26_speed;
   Msg_U3T_Obj_26_50ms.U3T26_width.phys = @sysvar::MsgU3T_Obj_26_50ms::SigU3T26_width;
   Msg_U3T_Obj_26_50ms.U3T26_fusion_source.phys = @sysvar::MsgU3T_Obj_26_50ms::SigU3T26_fusion_source;
   Msg_U3T_Obj_26_50ms.U3T26_vcs_heading.phys = @sysvar::MsgU3T_Obj_26_50ms::SigU3T26_vcs_heading;
   Msg_U3T_Obj_26_50ms.U3T26_vcs_lat_accel.phys = @sysvar::MsgU3T_Obj_26_50ms::SigU3T26_vcs_lat_accel;
   Msg_U3T_Obj_26_50ms.U3T26_vcs_lat_posn.phys = @sysvar::MsgU3T_Obj_26_50ms::SigU3T26_vcs_lat_posn;
   Msg_U3T_Obj_26_50ms.U3T26_vcs_lat_vel.phys = @sysvar::MsgU3T_Obj_26_50ms::SigU3T26_vcs_lat_vel;
   Msg_U3T_Obj_26_50ms.U3T26_vcs_long_accel.phys = @sysvar::MsgU3T_Obj_26_50ms::SigU3T26_vcs_long_accel;
   Msg_U3T_Obj_26_50ms.U3T26_vcs_long_posn.phys = @sysvar::MsgU3T_Obj_26_50ms::SigU3T26_vcs_long_posn;
   Msg_U3T_Obj_26_50ms.U3T26_vcs_long_vel.phys = @sysvar::MsgU3T_Obj_26_50ms::SigU3T26_vcs_long_vel;
   Msg_U3T_Obj_26_50ms.U3T26_conf_overall.phys = @sysvar::MsgU3T_Obj_26_50ms::SigU3T26_conf_overall;
   Msg_U3T_Obj_26_50ms.U3T26_f_oncoming.phys = @sysvar::MsgU3T_Obj_26_50ms::SigU3T26_f_oncoming;
   Msg_U3T_Obj_26_50ms.U3T26_f_receding.phys = @sysvar::MsgU3T_Obj_26_50ms::SigU3T26_f_receding;
   output(Msg_U3T_Obj_26_50ms);
   Msg_U3T_Obj_25_50ms.U3T25_age.phys = @sysvar::MsgU3T_Obj_25_50ms::SigU3T25_age;
   Msg_U3T_Obj_25_50ms.U3T25_f_moveable.phys = @sysvar::MsgU3T_Obj_25_50ms::SigU3T25_f_moveable;
   Msg_U3T_Obj_25_50ms.U3T25_f_stationary.phys = @sysvar::MsgU3T_Obj_25_50ms::SigU3T25_f_stationary;
   Msg_U3T_Obj_25_50ms.U3T25_FLcorner_lat.phys = @sysvar::MsgU3T_Obj_25_50ms::SigU3T25_FLcorner_lat;
   Msg_U3T_Obj_25_50ms.U3T25_object_class.phys = @sysvar::MsgU3T_Obj_25_50ms::SigU3T25_object_class;
   Msg_U3T_Obj_25_50ms.U3T25_FLcorner_long.phys = @sysvar::MsgU3T_Obj_25_50ms::SigU3T25_FLcorner_long;
   Msg_U3T_Obj_25_50ms.U3T25_status.phys = @sysvar::MsgU3T_Obj_25_50ms::SigU3T25_status;
   Msg_U3T_Obj_25_50ms.U3T25_FRcorner_lat.phys = @sysvar::MsgU3T_Obj_25_50ms::SigU3T25_FRcorner_lat;
   Msg_U3T_Obj_25_50ms.U3T25_FRcorner_long.phys = @sysvar::MsgU3T_Obj_25_50ms::SigU3T25_FRcorner_long;
   Msg_U3T_Obj_25_50ms.U3T25_heading_rate.phys = @sysvar::MsgU3T_Obj_25_50ms::SigU3T25_heading_rate;
   Msg_U3T_Obj_25_50ms.U3T25_id.phys = @sysvar::MsgU3T_Obj_25_50ms::SigU3T25_id;
   Msg_U3T_Obj_25_50ms.U3T25_length.phys = @sysvar::MsgU3T_Obj_25_50ms::SigU3T25_length;
   Msg_U3T_Obj_25_50ms.U3T25_RLcorner_lat.phys = @sysvar::MsgU3T_Obj_25_50ms::SigU3T25_RLcorner_lat;
   Msg_U3T_Obj_25_50ms.U3T25_RLcorner_long.phys = @sysvar::MsgU3T_Obj_25_50ms::SigU3T25_RLcorner_long;
   Msg_U3T_Obj_25_50ms.U3T25_RRcorner_lat.phys = @sysvar::MsgU3T_Obj_25_50ms::SigU3T25_RRcorner_lat;
   Msg_U3T_Obj_25_50ms.U3T25_RRcorner_long.phys = @sysvar::MsgU3T_Obj_25_50ms::SigU3T25_RRcorner_long;
   Msg_U3T_Obj_25_50ms.U3T25_speed.phys = @sysvar::MsgU3T_Obj_25_50ms::SigU3T25_speed;
   Msg_U3T_Obj_25_50ms.U3T25_width.phys = @sysvar::MsgU3T_Obj_25_50ms::SigU3T25_width;
   Msg_U3T_Obj_25_50ms.U3T25_fusion_source.phys = @sysvar::MsgU3T_Obj_25_50ms::SigU3T25_fusion_source;
   Msg_U3T_Obj_25_50ms.U3T25_vcs_heading.phys = @sysvar::MsgU3T_Obj_25_50ms::SigU3T25_vcs_heading;
   Msg_U3T_Obj_25_50ms.U3T25_vcs_lat_accel.phys = @sysvar::MsgU3T_Obj_25_50ms::SigU3T25_vcs_lat_accel;
   Msg_U3T_Obj_25_50ms.U3T25_vcs_lat_posn.phys = @sysvar::MsgU3T_Obj_25_50ms::SigU3T25_vcs_lat_posn;
   Msg_U3T_Obj_25_50ms.U3T25_vcs_lat_vel.phys = @sysvar::MsgU3T_Obj_25_50ms::SigU3T25_vcs_lat_vel;
   Msg_U3T_Obj_25_50ms.U3T25_vcs_long_accel.phys = @sysvar::MsgU3T_Obj_25_50ms::SigU3T25_vcs_long_accel;
   Msg_U3T_Obj_25_50ms.U3T25_vcs_long_posn.phys = @sysvar::MsgU3T_Obj_25_50ms::SigU3T25_vcs_long_posn;
   Msg_U3T_Obj_25_50ms.U3T25_vcs_long_vel.phys = @sysvar::MsgU3T_Obj_25_50ms::SigU3T25_vcs_long_vel;
   Msg_U3T_Obj_25_50ms.U3T25_conf_overall.phys = @sysvar::MsgU3T_Obj_25_50ms::SigU3T25_conf_overall;
   Msg_U3T_Obj_25_50ms.U3T25_f_oncoming.phys = @sysvar::MsgU3T_Obj_25_50ms::SigU3T25_f_oncoming;
   Msg_U3T_Obj_25_50ms.U3T25_f_receding.phys = @sysvar::MsgU3T_Obj_25_50ms::SigU3T25_f_receding;
   output(Msg_U3T_Obj_25_50ms);
   Msg_U3T_Obj_24_50ms.U3T24_age.phys = @sysvar::MsgU3T_Obj_24_50ms::SigU3T24_age;
   Msg_U3T_Obj_24_50ms.U3T24_f_moveable.phys = @sysvar::MsgU3T_Obj_24_50ms::SigU3T24_f_moveable;
   Msg_U3T_Obj_24_50ms.U3T24_f_stationary.phys = @sysvar::MsgU3T_Obj_24_50ms::SigU3T24_f_stationary;
   Msg_U3T_Obj_24_50ms.U3T24_FLcorner_lat.phys = @sysvar::MsgU3T_Obj_24_50ms::SigU3T24_FLcorner_lat;
   Msg_U3T_Obj_24_50ms.U3T24_object_class.phys = @sysvar::MsgU3T_Obj_24_50ms::SigU3T24_object_class;
   Msg_U3T_Obj_24_50ms.U3T24_FLcorner_long.phys = @sysvar::MsgU3T_Obj_24_50ms::SigU3T24_FLcorner_long;
   Msg_U3T_Obj_24_50ms.U3T24_status.phys = @sysvar::MsgU3T_Obj_24_50ms::SigU3T24_status;
   Msg_U3T_Obj_24_50ms.U3T24_FRcorner_lat.phys = @sysvar::MsgU3T_Obj_24_50ms::SigU3T24_FRcorner_lat;
   Msg_U3T_Obj_24_50ms.U3T24_FRcorner_long.phys = @sysvar::MsgU3T_Obj_24_50ms::SigU3T24_FRcorner_long;
   Msg_U3T_Obj_24_50ms.U3T24_heading_rate.phys = @sysvar::MsgU3T_Obj_24_50ms::SigU3T24_heading_rate;
   Msg_U3T_Obj_24_50ms.U3T24_id.phys = @sysvar::MsgU3T_Obj_24_50ms::SigU3T24_id;
   Msg_U3T_Obj_24_50ms.U3T24_length.phys = @sysvar::MsgU3T_Obj_24_50ms::SigU3T24_length;
   Msg_U3T_Obj_24_50ms.U3T24_RLcorner_lat.phys = @sysvar::MsgU3T_Obj_24_50ms::SigU3T24_RLcorner_lat;
   Msg_U3T_Obj_24_50ms.U3T24_RLcorner_long.phys = @sysvar::MsgU3T_Obj_24_50ms::SigU3T24_RLcorner_long;
   Msg_U3T_Obj_24_50ms.U3T24_RRcorner_lat.phys = @sysvar::MsgU3T_Obj_24_50ms::SigU3T24_RRcorner_lat;
   Msg_U3T_Obj_24_50ms.U3T24_RRcorner_long.phys = @sysvar::MsgU3T_Obj_24_50ms::SigU3T24_RRcorner_long;
   Msg_U3T_Obj_24_50ms.U3T24_speed.phys = @sysvar::MsgU3T_Obj_24_50ms::SigU3T24_speed;
   Msg_U3T_Obj_24_50ms.U3T24_width.phys = @sysvar::MsgU3T_Obj_24_50ms::SigU3T24_width;
   Msg_U3T_Obj_24_50ms.U3T24_fusion_source.phys = @sysvar::MsgU3T_Obj_24_50ms::SigU3T24_fusion_source;
   Msg_U3T_Obj_24_50ms.U3T24_vcs_heading.phys = @sysvar::MsgU3T_Obj_24_50ms::SigU3T24_vcs_heading;
   Msg_U3T_Obj_24_50ms.U3T24_vcs_lat_accel.phys = @sysvar::MsgU3T_Obj_24_50ms::SigU3T24_vcs_lat_accel;
   Msg_U3T_Obj_24_50ms.U3T24_vcs_lat_posn.phys = @sysvar::MsgU3T_Obj_24_50ms::SigU3T24_vcs_lat_posn;
   Msg_U3T_Obj_24_50ms.U3T24_vcs_lat_vel.phys = @sysvar::MsgU3T_Obj_24_50ms::SigU3T24_vcs_lat_vel;
   Msg_U3T_Obj_24_50ms.U3T24_vcs_long_accel.phys = @sysvar::MsgU3T_Obj_24_50ms::SigU3T24_vcs_long_accel;
   Msg_U3T_Obj_24_50ms.U3T24_vcs_long_posn.phys = @sysvar::MsgU3T_Obj_24_50ms::SigU3T24_vcs_long_posn;
   Msg_U3T_Obj_24_50ms.U3T24_vcs_long_vel.phys = @sysvar::MsgU3T_Obj_24_50ms::SigU3T24_vcs_long_vel;
   Msg_U3T_Obj_24_50ms.U3T24_conf_overall.phys = @sysvar::MsgU3T_Obj_24_50ms::SigU3T24_conf_overall;
   Msg_U3T_Obj_24_50ms.U3T24_f_oncoming.phys = @sysvar::MsgU3T_Obj_24_50ms::SigU3T24_f_oncoming;
   Msg_U3T_Obj_24_50ms.U3T24_f_receding.phys = @sysvar::MsgU3T_Obj_24_50ms::SigU3T24_f_receding;
   output(Msg_U3T_Obj_24_50ms);
   Msg_U3T_Obj_22_50ms.U3T22_age.phys = @sysvar::MsgU3T_Obj_22_50ms::SigU3T22_age;
   Msg_U3T_Obj_22_50ms.U3T22_f_moveable.phys = @sysvar::MsgU3T_Obj_22_50ms::SigU3T22_f_moveable;
   Msg_U3T_Obj_22_50ms.U3T22_f_stationary.phys = @sysvar::MsgU3T_Obj_22_50ms::SigU3T22_f_stationary;
   Msg_U3T_Obj_22_50ms.U3T22_FLcorner_lat.phys = @sysvar::MsgU3T_Obj_22_50ms::SigU3T22_FLcorner_lat;
   Msg_U3T_Obj_22_50ms.U3T22_object_class.phys = @sysvar::MsgU3T_Obj_22_50ms::SigU3T22_object_class;
   Msg_U3T_Obj_22_50ms.U3T22_FLcorner_long.phys = @sysvar::MsgU3T_Obj_22_50ms::SigU3T22_FLcorner_long;
   Msg_U3T_Obj_22_50ms.U3T22_status.phys = @sysvar::MsgU3T_Obj_22_50ms::SigU3T22_status;
   Msg_U3T_Obj_22_50ms.U3T22_FRcorner_lat.phys = @sysvar::MsgU3T_Obj_22_50ms::SigU3T22_FRcorner_lat;
   Msg_U3T_Obj_22_50ms.U3T22_FRcorner_long.phys = @sysvar::MsgU3T_Obj_22_50ms::SigU3T22_FRcorner_long;
   Msg_U3T_Obj_22_50ms.U3T22_heading_rate.phys = @sysvar::MsgU3T_Obj_22_50ms::SigU3T22_heading_rate;
   Msg_U3T_Obj_22_50ms.U3T22_id.phys = @sysvar::MsgU3T_Obj_22_50ms::SigU3T22_id;
   Msg_U3T_Obj_22_50ms.U3T22_length.phys = @sysvar::MsgU3T_Obj_22_50ms::SigU3T22_length;
   Msg_U3T_Obj_22_50ms.U3T22_RLcorner_lat.phys = @sysvar::MsgU3T_Obj_22_50ms::SigU3T22_RLcorner_lat;
   Msg_U3T_Obj_22_50ms.U3T22_RLcorner_long.phys = @sysvar::MsgU3T_Obj_22_50ms::SigU3T22_RLcorner_long;
   Msg_U3T_Obj_22_50ms.U3T22_RRcorner_lat.phys = @sysvar::MsgU3T_Obj_22_50ms::SigU3T22_RRcorner_lat;
   Msg_U3T_Obj_22_50ms.U3T22_RRcorner_long.phys = @sysvar::MsgU3T_Obj_22_50ms::SigU3T22_RRcorner_long;
   Msg_U3T_Obj_22_50ms.U3T22_speed.phys = @sysvar::MsgU3T_Obj_22_50ms::SigU3T22_speed;
   Msg_U3T_Obj_22_50ms.U3T22_width.phys = @sysvar::MsgU3T_Obj_22_50ms::SigU3T22_width;
   Msg_U3T_Obj_22_50ms.U3T22_fusion_source.phys = @sysvar::MsgU3T_Obj_22_50ms::SigU3T22_fusion_source;
   Msg_U3T_Obj_22_50ms.U3T22_vcs_heading.phys = @sysvar::MsgU3T_Obj_22_50ms::SigU3T22_vcs_heading;
   Msg_U3T_Obj_22_50ms.U3T22_vcs_lat_accel.phys = @sysvar::MsgU3T_Obj_22_50ms::SigU3T22_vcs_lat_accel;
   Msg_U3T_Obj_22_50ms.U3T22_vcs_lat_posn.phys = @sysvar::MsgU3T_Obj_22_50ms::SigU3T22_vcs_lat_posn;
   Msg_U3T_Obj_22_50ms.U3T22_vcs_lat_vel.phys = @sysvar::MsgU3T_Obj_22_50ms::SigU3T22_vcs_lat_vel;
   Msg_U3T_Obj_22_50ms.U3T22_vcs_long_accel.phys = @sysvar::MsgU3T_Obj_22_50ms::SigU3T22_vcs_long_accel;
   Msg_U3T_Obj_22_50ms.U3T22_vcs_long_posn.phys = @sysvar::MsgU3T_Obj_22_50ms::SigU3T22_vcs_long_posn;
   Msg_U3T_Obj_22_50ms.U3T22_vcs_long_vel.phys = @sysvar::MsgU3T_Obj_22_50ms::SigU3T22_vcs_long_vel;
   Msg_U3T_Obj_22_50ms.U3T22_conf_overall.phys = @sysvar::MsgU3T_Obj_22_50ms::SigU3T22_conf_overall;
   Msg_U3T_Obj_22_50ms.U3T22_f_oncoming.phys = @sysvar::MsgU3T_Obj_22_50ms::SigU3T22_f_oncoming;
   Msg_U3T_Obj_22_50ms.U3T22_f_receding.phys = @sysvar::MsgU3T_Obj_22_50ms::SigU3T22_f_receding;
   output(Msg_U3T_Obj_22_50ms);
   Msg_U3T_Obj_21_50ms.U3T21_age.phys = @sysvar::MsgU3T_Obj_21_50ms::SigU3T21_age;
   Msg_U3T_Obj_21_50ms.U3T21_f_moveable.phys = @sysvar::MsgU3T_Obj_21_50ms::SigU3T21_f_moveable;
   Msg_U3T_Obj_21_50ms.U3T21_f_stationary.phys = @sysvar::MsgU3T_Obj_21_50ms::SigU3T21_f_stationary;
   Msg_U3T_Obj_21_50ms.U3T21_FLcorner_lat.phys = @sysvar::MsgU3T_Obj_21_50ms::SigU3T21_FLcorner_lat;
   Msg_U3T_Obj_21_50ms.U3T21_object_class.phys = @sysvar::MsgU3T_Obj_21_50ms::SigU3T21_object_class;
   Msg_U3T_Obj_21_50ms.U3T21_FLcorner_long.phys = @sysvar::MsgU3T_Obj_21_50ms::SigU3T21_FLcorner_long;
   Msg_U3T_Obj_21_50ms.U3T21_status.phys = @sysvar::MsgU3T_Obj_21_50ms::SigU3T21_status;
   Msg_U3T_Obj_21_50ms.U3T21_FRcorner_lat.phys = @sysvar::MsgU3T_Obj_21_50ms::SigU3T21_FRcorner_lat;
   Msg_U3T_Obj_21_50ms.U3T21_FRcorner_long.phys = @sysvar::MsgU3T_Obj_21_50ms::SigU3T21_FRcorner_long;
   Msg_U3T_Obj_21_50ms.U3T21_heading_rate.phys = @sysvar::MsgU3T_Obj_21_50ms::SigU3T21_heading_rate;
   Msg_U3T_Obj_21_50ms.U3T21_id.phys = @sysvar::MsgU3T_Obj_21_50ms::SigU3T21_id;
   Msg_U3T_Obj_21_50ms.U3T21_length.phys = @sysvar::MsgU3T_Obj_21_50ms::SigU3T21_length;
   Msg_U3T_Obj_21_50ms.U3T21_RLcorner_lat.phys = @sysvar::MsgU3T_Obj_21_50ms::SigU3T21_RLcorner_lat;
   Msg_U3T_Obj_21_50ms.U3T21_RLcorner_long.phys = @sysvar::MsgU3T_Obj_21_50ms::SigU3T21_RLcorner_long;
   Msg_U3T_Obj_21_50ms.U3T21_RRcorner_lat.phys = @sysvar::MsgU3T_Obj_21_50ms::SigU3T21_RRcorner_lat;
   Msg_U3T_Obj_21_50ms.U3T21_RRcorner_long.phys = @sysvar::MsgU3T_Obj_21_50ms::SigU3T21_RRcorner_long;
   Msg_U3T_Obj_21_50ms.U3T21_speed.phys = @sysvar::MsgU3T_Obj_21_50ms::SigU3T21_speed;
   Msg_U3T_Obj_21_50ms.U3T21_width.phys = @sysvar::MsgU3T_Obj_21_50ms::SigU3T21_width;
   Msg_U3T_Obj_21_50ms.U3T21_fusion_source.phys = @sysvar::MsgU3T_Obj_21_50ms::SigU3T21_fusion_source;
   Msg_U3T_Obj_21_50ms.U3T21_vcs_heading.phys = @sysvar::MsgU3T_Obj_21_50ms::SigU3T21_vcs_heading;
   Msg_U3T_Obj_21_50ms.U3T21_vcs_lat_accel.phys = @sysvar::MsgU3T_Obj_21_50ms::SigU3T21_vcs_lat_accel;
   Msg_U3T_Obj_21_50ms.U3T21_vcs_lat_posn.phys = @sysvar::MsgU3T_Obj_21_50ms::SigU3T21_vcs_lat_posn;
   Msg_U3T_Obj_21_50ms.U3T21_vcs_lat_vel.phys = @sysvar::MsgU3T_Obj_21_50ms::SigU3T21_vcs_lat_vel;
   Msg_U3T_Obj_21_50ms.U3T21_vcs_long_accel.phys = @sysvar::MsgU3T_Obj_21_50ms::SigU3T21_vcs_long_accel;
   Msg_U3T_Obj_21_50ms.U3T21_vcs_long_posn.phys = @sysvar::MsgU3T_Obj_21_50ms::SigU3T21_vcs_long_posn;
   Msg_U3T_Obj_21_50ms.U3T21_vcs_long_vel.phys = @sysvar::MsgU3T_Obj_21_50ms::SigU3T21_vcs_long_vel;
   Msg_U3T_Obj_21_50ms.U3T21_conf_overall.phys = @sysvar::MsgU3T_Obj_21_50ms::SigU3T21_conf_overall;
   Msg_U3T_Obj_21_50ms.U3T21_f_oncoming.phys = @sysvar::MsgU3T_Obj_21_50ms::SigU3T21_f_oncoming;
   Msg_U3T_Obj_21_50ms.U3T21_f_receding.phys = @sysvar::MsgU3T_Obj_21_50ms::SigU3T21_f_receding;
   output(Msg_U3T_Obj_21_50ms);
   Msg_U3T_Obj_20_50ms.U3T20_age.phys = @sysvar::MsgU3T_Obj_20_50ms::SigU3T20_age;
   Msg_U3T_Obj_20_50ms.U3T20_f_moveable.phys = @sysvar::MsgU3T_Obj_20_50ms::SigU3T20_f_moveable;
   Msg_U3T_Obj_20_50ms.U3T20_f_stationary.phys = @sysvar::MsgU3T_Obj_20_50ms::SigU3T20_f_stationary;
   Msg_U3T_Obj_20_50ms.U3T20_FLcorner_lat.phys = @sysvar::MsgU3T_Obj_20_50ms::SigU3T20_FLcorner_lat;
   Msg_U3T_Obj_20_50ms.U3T20_object_class.phys = @sysvar::MsgU3T_Obj_20_50ms::SigU3T20_object_class;
   Msg_U3T_Obj_20_50ms.U3T20_FLcorner_long.phys = @sysvar::MsgU3T_Obj_20_50ms::SigU3T20_FLcorner_long;
   Msg_U3T_Obj_20_50ms.U3T20_status.phys = @sysvar::MsgU3T_Obj_20_50ms::SigU3T20_status;
   Msg_U3T_Obj_20_50ms.U3T20_FRcorner_lat.phys = @sysvar::MsgU3T_Obj_20_50ms::SigU3T20_FRcorner_lat;
   Msg_U3T_Obj_20_50ms.U3T20_FRcorner_long.phys = @sysvar::MsgU3T_Obj_20_50ms::SigU3T20_FRcorner_long;
   Msg_U3T_Obj_20_50ms.U3T20_heading_rate.phys = @sysvar::MsgU3T_Obj_20_50ms::SigU3T20_heading_rate;
   Msg_U3T_Obj_20_50ms.U3T20_id.phys = @sysvar::MsgU3T_Obj_20_50ms::SigU3T20_id;
   Msg_U3T_Obj_20_50ms.U3T20_length.phys = @sysvar::MsgU3T_Obj_20_50ms::SigU3T20_length;
   Msg_U3T_Obj_20_50ms.U3T20_RLcorner_lat.phys = @sysvar::MsgU3T_Obj_20_50ms::SigU3T20_RLcorner_lat;
   Msg_U3T_Obj_20_50ms.U3T20_RLcorner_long.phys = @sysvar::MsgU3T_Obj_20_50ms::SigU3T20_RLcorner_long;
   Msg_U3T_Obj_20_50ms.U3T20_RRcorner_lat.phys = @sysvar::MsgU3T_Obj_20_50ms::SigU3T20_RRcorner_lat;
   Msg_U3T_Obj_20_50ms.U3T20_RRcorner_long.phys = @sysvar::MsgU3T_Obj_20_50ms::SigU3T20_RRcorner_long;
   Msg_U3T_Obj_20_50ms.U3T20_speed.phys = @sysvar::MsgU3T_Obj_20_50ms::SigU3T20_speed;
   Msg_U3T_Obj_20_50ms.U3T20_width.phys = @sysvar::MsgU3T_Obj_20_50ms::SigU3T20_width;
   Msg_U3T_Obj_20_50ms.U3T20_fusion_source.phys = @sysvar::MsgU3T_Obj_20_50ms::SigU3T20_fusion_source;
   Msg_U3T_Obj_20_50ms.U3T20_vcs_heading.phys = @sysvar::MsgU3T_Obj_20_50ms::SigU3T20_vcs_heading;
   Msg_U3T_Obj_20_50ms.U3T20_vcs_lat_accel.phys = @sysvar::MsgU3T_Obj_20_50ms::SigU3T20_vcs_lat_accel;
   Msg_U3T_Obj_20_50ms.U3T20_vcs_lat_posn.phys = @sysvar::MsgU3T_Obj_20_50ms::SigU3T20_vcs_lat_posn;
   Msg_U3T_Obj_20_50ms.U3T20_vcs_lat_vel.phys = @sysvar::MsgU3T_Obj_20_50ms::SigU3T20_vcs_lat_vel;
   Msg_U3T_Obj_20_50ms.U3T20_vcs_long_accel.phys = @sysvar::MsgU3T_Obj_20_50ms::SigU3T20_vcs_long_accel;
   Msg_U3T_Obj_20_50ms.U3T20_vcs_long_posn.phys = @sysvar::MsgU3T_Obj_20_50ms::SigU3T20_vcs_long_posn;
   Msg_U3T_Obj_20_50ms.U3T20_vcs_long_vel.phys = @sysvar::MsgU3T_Obj_20_50ms::SigU3T20_vcs_long_vel;
   Msg_U3T_Obj_20_50ms.U3T20_conf_overall.phys = @sysvar::MsgU3T_Obj_20_50ms::SigU3T20_conf_overall;
   Msg_U3T_Obj_20_50ms.U3T20_f_oncoming.phys = @sysvar::MsgU3T_Obj_20_50ms::SigU3T20_f_oncoming;
   Msg_U3T_Obj_20_50ms.U3T20_f_receding.phys = @sysvar::MsgU3T_Obj_20_50ms::SigU3T20_f_receding;
   output(Msg_U3T_Obj_20_50ms);
   Msg_U3T_Obj_19_50ms.U3T19_age.phys = @sysvar::MsgU3T_Obj_19_50ms::SigU3T19_age;
   Msg_U3T_Obj_19_50ms.U3T19_f_moveable.phys = @sysvar::MsgU3T_Obj_19_50ms::SigU3T19_f_moveable;
   Msg_U3T_Obj_19_50ms.U3T19_f_stationary.phys = @sysvar::MsgU3T_Obj_19_50ms::SigU3T19_f_stationary;
   Msg_U3T_Obj_19_50ms.U3T19_FLcorner_lat.phys = @sysvar::MsgU3T_Obj_19_50ms::SigU3T19_FLcorner_lat;
   Msg_U3T_Obj_19_50ms.U3T19_object_class.phys = @sysvar::MsgU3T_Obj_19_50ms::SigU3T19_object_class;
   Msg_U3T_Obj_19_50ms.U3T19_FLcorner_long.phys = @sysvar::MsgU3T_Obj_19_50ms::SigU3T19_FLcorner_long;
   Msg_U3T_Obj_19_50ms.U3T19_status.phys = @sysvar::MsgU3T_Obj_19_50ms::SigU3T19_status;
   Msg_U3T_Obj_19_50ms.U3T19_FRcorner_lat.phys = @sysvar::MsgU3T_Obj_19_50ms::SigU3T19_FRcorner_lat;
   Msg_U3T_Obj_19_50ms.U3T19_FRcorner_long.phys = @sysvar::MsgU3T_Obj_19_50ms::SigU3T19_FRcorner_long;
   Msg_U3T_Obj_19_50ms.U3T19_heading_rate.phys = @sysvar::MsgU3T_Obj_19_50ms::SigU3T19_heading_rate;
   Msg_U3T_Obj_19_50ms.U3T19_id.phys = @sysvar::MsgU3T_Obj_19_50ms::SigU3T19_id;
   Msg_U3T_Obj_19_50ms.U3T19_length.phys = @sysvar::MsgU3T_Obj_19_50ms::SigU3T19_length;
   Msg_U3T_Obj_19_50ms.U3T19_RLcorner_lat.phys = @sysvar::MsgU3T_Obj_19_50ms::SigU3T19_RLcorner_lat;
   Msg_U3T_Obj_19_50ms.U3T19_RLcorner_long.phys = @sysvar::MsgU3T_Obj_19_50ms::SigU3T19_RLcorner_long;
   Msg_U3T_Obj_19_50ms.U3T19_RRcorner_lat.phys = @sysvar::MsgU3T_Obj_19_50ms::SigU3T19_RRcorner_lat;
   Msg_U3T_Obj_19_50ms.U3T19_RRcorner_long.phys = @sysvar::MsgU3T_Obj_19_50ms::SigU3T19_RRcorner_long;
   Msg_U3T_Obj_19_50ms.U3T19_speed.phys = @sysvar::MsgU3T_Obj_19_50ms::SigU3T19_speed;
   Msg_U3T_Obj_19_50ms.U3T19_width.phys = @sysvar::MsgU3T_Obj_19_50ms::SigU3T19_width;
   Msg_U3T_Obj_19_50ms.U3T19_fusion_source.phys = @sysvar::MsgU3T_Obj_19_50ms::SigU3T19_fusion_source;
   Msg_U3T_Obj_19_50ms.U3T19_vcs_heading.phys = @sysvar::MsgU3T_Obj_19_50ms::SigU3T19_vcs_heading;
   Msg_U3T_Obj_19_50ms.U3T19_vcs_lat_accel.phys = @sysvar::MsgU3T_Obj_19_50ms::SigU3T19_vcs_lat_accel;
   Msg_U3T_Obj_19_50ms.U3T19_vcs_lat_posn.phys = @sysvar::MsgU3T_Obj_19_50ms::SigU3T19_vcs_lat_posn;
   Msg_U3T_Obj_19_50ms.U3T19_vcs_lat_vel.phys = @sysvar::MsgU3T_Obj_19_50ms::SigU3T19_vcs_lat_vel;
   Msg_U3T_Obj_19_50ms.U3T19_vcs_long_accel.phys = @sysvar::MsgU3T_Obj_19_50ms::SigU3T19_vcs_long_accel;
   Msg_U3T_Obj_19_50ms.U3T19_vcs_long_posn.phys = @sysvar::MsgU3T_Obj_19_50ms::SigU3T19_vcs_long_posn;
   Msg_U3T_Obj_19_50ms.U3T19_vcs_long_vel.phys = @sysvar::MsgU3T_Obj_19_50ms::SigU3T19_vcs_long_vel;
   Msg_U3T_Obj_19_50ms.U3T19_conf_overall.phys = @sysvar::MsgU3T_Obj_19_50ms::SigU3T19_conf_overall;
   Msg_U3T_Obj_19_50ms.U3T19_f_oncoming.phys = @sysvar::MsgU3T_Obj_19_50ms::SigU3T19_f_oncoming;
   Msg_U3T_Obj_19_50ms.U3T19_f_receding.phys = @sysvar::MsgU3T_Obj_19_50ms::SigU3T19_f_receding;
   output(Msg_U3T_Obj_19_50ms);
   Msg_U3T_Obj_18_50ms.U3T18_age.phys = @sysvar::MsgU3T_Obj_18_50ms::SigU3T18_age;
   Msg_U3T_Obj_18_50ms.U3T18_f_moveable.phys = @sysvar::MsgU3T_Obj_18_50ms::SigU3T18_f_moveable;
   Msg_U3T_Obj_18_50ms.U3T18_f_stationary.phys = @sysvar::MsgU3T_Obj_18_50ms::SigU3T18_f_stationary;
   Msg_U3T_Obj_18_50ms.U3T18_FLcorner_lat.phys = @sysvar::MsgU3T_Obj_18_50ms::SigU3T18_FLcorner_lat;
   Msg_U3T_Obj_18_50ms.U3T18_object_class.phys = @sysvar::MsgU3T_Obj_18_50ms::SigU3T18_object_class;
   Msg_U3T_Obj_18_50ms.U3T18_FLcorner_long.phys = @sysvar::MsgU3T_Obj_18_50ms::SigU3T18_FLcorner_long;
   Msg_U3T_Obj_18_50ms.U3T18_status.phys = @sysvar::MsgU3T_Obj_18_50ms::SigU3T18_status;
   Msg_U3T_Obj_18_50ms.U3T18_FRcorner_lat.phys = @sysvar::MsgU3T_Obj_18_50ms::SigU3T18_FRcorner_lat;
   Msg_U3T_Obj_18_50ms.U3T18_FRcorner_long.phys = @sysvar::MsgU3T_Obj_18_50ms::SigU3T18_FRcorner_long;
   Msg_U3T_Obj_18_50ms.U3T18_heading_rate.phys = @sysvar::MsgU3T_Obj_18_50ms::SigU3T18_heading_rate;
   Msg_U3T_Obj_18_50ms.U3T18_id.phys = @sysvar::MsgU3T_Obj_18_50ms::SigU3T18_id;
   Msg_U3T_Obj_18_50ms.U3T18_length.phys = @sysvar::MsgU3T_Obj_18_50ms::SigU3T18_length;
   Msg_U3T_Obj_18_50ms.U3T18_RLcorner_lat.phys = @sysvar::MsgU3T_Obj_18_50ms::SigU3T18_RLcorner_lat;
   Msg_U3T_Obj_18_50ms.U3T18_RLcorner_long.phys = @sysvar::MsgU3T_Obj_18_50ms::SigU3T18_RLcorner_long;
   Msg_U3T_Obj_18_50ms.U3T18_RRcorner_lat.phys = @sysvar::MsgU3T_Obj_18_50ms::SigU3T18_RRcorner_lat;
   Msg_U3T_Obj_18_50ms.U3T18_RRcorner_long.phys = @sysvar::MsgU3T_Obj_18_50ms::SigU3T18_RRcorner_long;
   Msg_U3T_Obj_18_50ms.U3T18_speed.phys = @sysvar::MsgU3T_Obj_18_50ms::SigU3T18_speed;
   Msg_U3T_Obj_18_50ms.U3T18_width.phys = @sysvar::MsgU3T_Obj_18_50ms::SigU3T18_width;
   Msg_U3T_Obj_18_50ms.U3T18_fusion_source.phys = @sysvar::MsgU3T_Obj_18_50ms::SigU3T18_fusion_source;
   Msg_U3T_Obj_18_50ms.U3T18_vcs_heading.phys = @sysvar::MsgU3T_Obj_18_50ms::SigU3T18_vcs_heading;
   Msg_U3T_Obj_18_50ms.U3T18_vcs_lat_accel.phys = @sysvar::MsgU3T_Obj_18_50ms::SigU3T18_vcs_lat_accel;
   Msg_U3T_Obj_18_50ms.U3T18_vcs_lat_posn.phys = @sysvar::MsgU3T_Obj_18_50ms::SigU3T18_vcs_lat_posn;
   Msg_U3T_Obj_18_50ms.U3T18_vcs_lat_vel.phys = @sysvar::MsgU3T_Obj_18_50ms::SigU3T18_vcs_lat_vel;
   Msg_U3T_Obj_18_50ms.U3T18_vcs_long_accel.phys = @sysvar::MsgU3T_Obj_18_50ms::SigU3T18_vcs_long_accel;
   Msg_U3T_Obj_18_50ms.U3T18_vcs_long_posn.phys = @sysvar::MsgU3T_Obj_18_50ms::SigU3T18_vcs_long_posn;
   Msg_U3T_Obj_18_50ms.U3T18_vcs_long_vel.phys = @sysvar::MsgU3T_Obj_18_50ms::SigU3T18_vcs_long_vel;
   Msg_U3T_Obj_18_50ms.U3T18_conf_overall.phys = @sysvar::MsgU3T_Obj_18_50ms::SigU3T18_conf_overall;
   Msg_U3T_Obj_18_50ms.U3T18_f_oncoming.phys = @sysvar::MsgU3T_Obj_18_50ms::SigU3T18_f_oncoming;
   Msg_U3T_Obj_18_50ms.U3T18_f_receding.phys = @sysvar::MsgU3T_Obj_18_50ms::SigU3T18_f_receding;
   output(Msg_U3T_Obj_18_50ms);
   Msg_U3T_Obj_17_50ms.U3T17_age.phys = @sysvar::MsgU3T_Obj_17_50ms::SigU3T17_age;
   Msg_U3T_Obj_17_50ms.U3T17_f_moveable.phys = @sysvar::MsgU3T_Obj_17_50ms::SigU3T17_f_moveable;
   Msg_U3T_Obj_17_50ms.U3T17_f_stationary.phys = @sysvar::MsgU3T_Obj_17_50ms::SigU3T17_f_stationary;
   Msg_U3T_Obj_17_50ms.U3T17_FLcorner_lat.phys = @sysvar::MsgU3T_Obj_17_50ms::SigU3T17_FLcorner_lat;
   Msg_U3T_Obj_17_50ms.U3T17_object_class.phys = @sysvar::MsgU3T_Obj_17_50ms::SigU3T17_object_class;
   Msg_U3T_Obj_17_50ms.U3T17_FLcorner_long.phys = @sysvar::MsgU3T_Obj_17_50ms::SigU3T17_FLcorner_long;
   Msg_U3T_Obj_17_50ms.U3T17_status.phys = @sysvar::MsgU3T_Obj_17_50ms::SigU3T17_status;
   Msg_U3T_Obj_17_50ms.U3T17_FRcorner_lat.phys = @sysvar::MsgU3T_Obj_17_50ms::SigU3T17_FRcorner_lat;
   Msg_U3T_Obj_17_50ms.U3T17_FRcorner_long.phys = @sysvar::MsgU3T_Obj_17_50ms::SigU3T17_FRcorner_long;
   Msg_U3T_Obj_17_50ms.U3T17_heading_rate.phys = @sysvar::MsgU3T_Obj_17_50ms::SigU3T17_heading_rate;
   Msg_U3T_Obj_17_50ms.U3T17_id.phys = @sysvar::MsgU3T_Obj_17_50ms::SigU3T17_id;
   Msg_U3T_Obj_17_50ms.U3T17_length.phys = @sysvar::MsgU3T_Obj_17_50ms::SigU3T17_length;
   Msg_U3T_Obj_17_50ms.U3T17_RLcorner_lat.phys = @sysvar::MsgU3T_Obj_17_50ms::SigU3T17_RLcorner_lat;
   Msg_U3T_Obj_17_50ms.U3T17_RLcorner_long.phys = @sysvar::MsgU3T_Obj_17_50ms::SigU3T17_RLcorner_long;
   Msg_U3T_Obj_17_50ms.U3T17_RRcorner_lat.phys = @sysvar::MsgU3T_Obj_17_50ms::SigU3T17_RRcorner_lat;
   Msg_U3T_Obj_17_50ms.U3T17_RRcorner_long.phys = @sysvar::MsgU3T_Obj_17_50ms::SigU3T17_RRcorner_long;
   Msg_U3T_Obj_17_50ms.U3T17_speed.phys = @sysvar::MsgU3T_Obj_17_50ms::SigU3T17_speed;
   Msg_U3T_Obj_17_50ms.U3T17_width.phys = @sysvar::MsgU3T_Obj_17_50ms::SigU3T17_width;
   Msg_U3T_Obj_17_50ms.U3T17_fusion_source.phys = @sysvar::MsgU3T_Obj_17_50ms::SigU3T17_fusion_source;
   Msg_U3T_Obj_17_50ms.U3T17_vcs_heading.phys = @sysvar::MsgU3T_Obj_17_50ms::SigU3T17_vcs_heading;
   Msg_U3T_Obj_17_50ms.U3T17_vcs_lat_accel.phys = @sysvar::MsgU3T_Obj_17_50ms::SigU3T17_vcs_lat_accel;
   Msg_U3T_Obj_17_50ms.U3T17_vcs_lat_posn.phys = @sysvar::MsgU3T_Obj_17_50ms::SigU3T17_vcs_lat_posn;
   Msg_U3T_Obj_17_50ms.U3T17_vcs_lat_vel.phys = @sysvar::MsgU3T_Obj_17_50ms::SigU3T17_vcs_lat_vel;
   Msg_U3T_Obj_17_50ms.U3T17_vcs_long_accel.phys = @sysvar::MsgU3T_Obj_17_50ms::SigU3T17_vcs_long_accel;
   Msg_U3T_Obj_17_50ms.U3T17_vcs_long_posn.phys = @sysvar::MsgU3T_Obj_17_50ms::SigU3T17_vcs_long_posn;
   Msg_U3T_Obj_17_50ms.U3T17_vcs_long_vel.phys = @sysvar::MsgU3T_Obj_17_50ms::SigU3T17_vcs_long_vel;
   Msg_U3T_Obj_17_50ms.U3T17_conf_overall.phys = @sysvar::MsgU3T_Obj_17_50ms::SigU3T17_conf_overall;
   Msg_U3T_Obj_17_50ms.U3T17_f_oncoming.phys = @sysvar::MsgU3T_Obj_17_50ms::SigU3T17_f_oncoming;
   Msg_U3T_Obj_17_50ms.U3T17_f_receding.phys = @sysvar::MsgU3T_Obj_17_50ms::SigU3T17_f_receding;
   output(Msg_U3T_Obj_17_50ms);
   Msg_U3T_Obj_16_50ms.U3T16_age.phys = @sysvar::MsgU3T_Obj_16_50ms::SigU3T16_age;
   Msg_U3T_Obj_16_50ms.U3T16_f_moveable.phys = @sysvar::MsgU3T_Obj_16_50ms::SigU3T16_f_moveable;
   Msg_U3T_Obj_16_50ms.U3T16_f_stationary.phys = @sysvar::MsgU3T_Obj_16_50ms::SigU3T16_f_stationary;
   Msg_U3T_Obj_16_50ms.U3T16_FLcorner_lat.phys = @sysvar::MsgU3T_Obj_16_50ms::SigU3T16_FLcorner_lat;
   Msg_U3T_Obj_16_50ms.U3T16_object_class.phys = @sysvar::MsgU3T_Obj_16_50ms::SigU3T16_object_class;
   Msg_U3T_Obj_16_50ms.U3T16_FLcorner_long.phys = @sysvar::MsgU3T_Obj_16_50ms::SigU3T16_FLcorner_long;
   Msg_U3T_Obj_16_50ms.U3T16_status.phys = @sysvar::MsgU3T_Obj_16_50ms::SigU3T16_status;
   Msg_U3T_Obj_16_50ms.U3T16_FRcorner_lat.phys = @sysvar::MsgU3T_Obj_16_50ms::SigU3T16_FRcorner_lat;
   Msg_U3T_Obj_16_50ms.U3T16_FRcorner_long.phys = @sysvar::MsgU3T_Obj_16_50ms::SigU3T16_FRcorner_long;
   Msg_U3T_Obj_16_50ms.U3T16_heading_rate.phys = @sysvar::MsgU3T_Obj_16_50ms::SigU3T16_heading_rate;
   Msg_U3T_Obj_16_50ms.U3T16_id.phys = @sysvar::MsgU3T_Obj_16_50ms::SigU3T16_id;
   Msg_U3T_Obj_16_50ms.U3T16_length.phys = @sysvar::MsgU3T_Obj_16_50ms::SigU3T16_length;
   Msg_U3T_Obj_16_50ms.U3T16_RLcorner_lat.phys = @sysvar::MsgU3T_Obj_16_50ms::SigU3T16_RLcorner_lat;
   Msg_U3T_Obj_16_50ms.U3T16_RLcorner_long.phys = @sysvar::MsgU3T_Obj_16_50ms::SigU3T16_RLcorner_long;
   Msg_U3T_Obj_16_50ms.U3T16_RRcorner_lat.phys = @sysvar::MsgU3T_Obj_16_50ms::SigU3T16_RRcorner_lat;
   Msg_U3T_Obj_16_50ms.U3T16_RRcorner_long.phys = @sysvar::MsgU3T_Obj_16_50ms::SigU3T16_RRcorner_long;
   Msg_U3T_Obj_16_50ms.U3T16_speed.phys = @sysvar::MsgU3T_Obj_16_50ms::SigU3T16_speed;
   Msg_U3T_Obj_16_50ms.U3T16_width.phys = @sysvar::MsgU3T_Obj_16_50ms::SigU3T16_width;
   Msg_U3T_Obj_16_50ms.U3T16_fusion_source.phys = @sysvar::MsgU3T_Obj_16_50ms::SigU3T16_fusion_source;
   Msg_U3T_Obj_16_50ms.U3T16_vcs_heading.phys = @sysvar::MsgU3T_Obj_16_50ms::SigU3T16_vcs_heading;
   Msg_U3T_Obj_16_50ms.U3T16_vcs_lat_accel.phys = @sysvar::MsgU3T_Obj_16_50ms::SigU3T16_vcs_lat_accel;
   Msg_U3T_Obj_16_50ms.U3T16_vcs_lat_posn.phys = @sysvar::MsgU3T_Obj_16_50ms::SigU3T16_vcs_lat_posn;
   Msg_U3T_Obj_16_50ms.U3T16_vcs_lat_vel.phys = @sysvar::MsgU3T_Obj_16_50ms::SigU3T16_vcs_lat_vel;
   Msg_U3T_Obj_16_50ms.U3T16_vcs_long_accel.phys = @sysvar::MsgU3T_Obj_16_50ms::SigU3T16_vcs_long_accel;
   Msg_U3T_Obj_16_50ms.U3T16_vcs_long_posn.phys = @sysvar::MsgU3T_Obj_16_50ms::SigU3T16_vcs_long_posn;
   Msg_U3T_Obj_16_50ms.U3T16_vcs_long_vel.phys = @sysvar::MsgU3T_Obj_16_50ms::SigU3T16_vcs_long_vel;
   Msg_U3T_Obj_16_50ms.U3T16_conf_overall.phys = @sysvar::MsgU3T_Obj_16_50ms::SigU3T16_conf_overall;
   Msg_U3T_Obj_16_50ms.U3T16_f_oncoming.phys = @sysvar::MsgU3T_Obj_16_50ms::SigU3T16_f_oncoming;
   Msg_U3T_Obj_16_50ms.U3T16_f_receding.phys = @sysvar::MsgU3T_Obj_16_50ms::SigU3T16_f_receding;
   output(Msg_U3T_Obj_16_50ms);
   Msg_U3T_Obj_15_50ms.U3T15_age.phys = @sysvar::MsgU3T_Obj_15_50ms::SigU3T15_age;
   Msg_U3T_Obj_15_50ms.U3T15_f_moveable.phys = @sysvar::MsgU3T_Obj_15_50ms::SigU3T15_f_moveable;
   Msg_U3T_Obj_15_50ms.U3T15_f_stationary.phys = @sysvar::MsgU3T_Obj_15_50ms::SigU3T15_f_stationary;
   Msg_U3T_Obj_15_50ms.U3T15_FLcorner_lat.phys = @sysvar::MsgU3T_Obj_15_50ms::SigU3T15_FLcorner_lat;
   Msg_U3T_Obj_15_50ms.U3T15_object_class.phys = @sysvar::MsgU3T_Obj_15_50ms::SigU3T15_object_class;
   Msg_U3T_Obj_15_50ms.U3T15_FLcorner_long.phys = @sysvar::MsgU3T_Obj_15_50ms::SigU3T15_FLcorner_long;
   Msg_U3T_Obj_15_50ms.U3T15_status.phys = @sysvar::MsgU3T_Obj_15_50ms::SigU3T15_status;
   Msg_U3T_Obj_15_50ms.U3T15_FRcorner_lat.phys = @sysvar::MsgU3T_Obj_15_50ms::SigU3T15_FRcorner_lat;
   Msg_U3T_Obj_15_50ms.U3T15_FRcorner_long.phys = @sysvar::MsgU3T_Obj_15_50ms::SigU3T15_FRcorner_long;
   Msg_U3T_Obj_15_50ms.U3T15_heading_rate.phys = @sysvar::MsgU3T_Obj_15_50ms::SigU3T15_heading_rate;
   Msg_U3T_Obj_15_50ms.U3T15_id.phys = @sysvar::MsgU3T_Obj_15_50ms::SigU3T15_id;
   Msg_U3T_Obj_15_50ms.U3T15_length.phys = @sysvar::MsgU3T_Obj_15_50ms::SigU3T15_length;
   Msg_U3T_Obj_15_50ms.U3T15_RLcorner_lat.phys = @sysvar::MsgU3T_Obj_15_50ms::SigU3T15_RLcorner_lat;
   Msg_U3T_Obj_15_50ms.U3T15_RLcorner_long.phys = @sysvar::MsgU3T_Obj_15_50ms::SigU3T15_RLcorner_long;
   Msg_U3T_Obj_15_50ms.U3T15_RRcorner_lat.phys = @sysvar::MsgU3T_Obj_15_50ms::SigU3T15_RRcorner_lat;
   Msg_U3T_Obj_15_50ms.U3T15_RRcorner_long.phys = @sysvar::MsgU3T_Obj_15_50ms::SigU3T15_RRcorner_long;
   Msg_U3T_Obj_15_50ms.U3T15_speed.phys = @sysvar::MsgU3T_Obj_15_50ms::SigU3T15_speed;
   Msg_U3T_Obj_15_50ms.U3T15_width.phys = @sysvar::MsgU3T_Obj_15_50ms::SigU3T15_width;
   Msg_U3T_Obj_15_50ms.U3T15_fusion_source.phys = @sysvar::MsgU3T_Obj_15_50ms::SigU3T15_fusion_source;
   Msg_U3T_Obj_15_50ms.U3T15_vcs_heading.phys = @sysvar::MsgU3T_Obj_15_50ms::SigU3T15_vcs_heading;
   Msg_U3T_Obj_15_50ms.U3T15_vcs_lat_accel.phys = @sysvar::MsgU3T_Obj_15_50ms::SigU3T15_vcs_lat_accel;
   Msg_U3T_Obj_15_50ms.U3T15_vcs_lat_posn.phys = @sysvar::MsgU3T_Obj_15_50ms::SigU3T15_vcs_lat_posn;
   Msg_U3T_Obj_15_50ms.U3T15_vcs_lat_vel.phys = @sysvar::MsgU3T_Obj_15_50ms::SigU3T15_vcs_lat_vel;
   Msg_U3T_Obj_15_50ms.U3T15_vcs_long_accel.phys = @sysvar::MsgU3T_Obj_15_50ms::SigU3T15_vcs_long_accel;
   Msg_U3T_Obj_15_50ms.U3T15_vcs_long_posn.phys = @sysvar::MsgU3T_Obj_15_50ms::SigU3T15_vcs_long_posn;
   Msg_U3T_Obj_15_50ms.U3T15_vcs_long_vel.phys = @sysvar::MsgU3T_Obj_15_50ms::SigU3T15_vcs_long_vel;
   Msg_U3T_Obj_15_50ms.U3T15_conf_overall.phys = @sysvar::MsgU3T_Obj_15_50ms::SigU3T15_conf_overall;
   Msg_U3T_Obj_15_50ms.U3T15_f_oncoming.phys = @sysvar::MsgU3T_Obj_15_50ms::SigU3T15_f_oncoming;
   Msg_U3T_Obj_15_50ms.U3T15_f_receding.phys = @sysvar::MsgU3T_Obj_15_50ms::SigU3T15_f_receding;
   output(Msg_U3T_Obj_15_50ms);
   Msg_U3T_Obj_14_50ms.U3T14_age.phys = @sysvar::MsgU3T_Obj_14_50ms::SigU3T14_age;
   Msg_U3T_Obj_14_50ms.U3T14_f_moveable.phys = @sysvar::MsgU3T_Obj_14_50ms::SigU3T14_f_moveable;
   Msg_U3T_Obj_14_50ms.U3T14_f_stationary.phys = @sysvar::MsgU3T_Obj_14_50ms::SigU3T14_f_stationary;
   Msg_U3T_Obj_14_50ms.U3T14_FLcorner_lat.phys = @sysvar::MsgU3T_Obj_14_50ms::SigU3T14_FLcorner_lat;
   Msg_U3T_Obj_14_50ms.U3T14_object_class.phys = @sysvar::MsgU3T_Obj_14_50ms::SigU3T14_object_class;
   Msg_U3T_Obj_14_50ms.U3T14_FLcorner_long.phys = @sysvar::MsgU3T_Obj_14_50ms::SigU3T14_FLcorner_long;
   Msg_U3T_Obj_14_50ms.U3T14_status.phys = @sysvar::MsgU3T_Obj_14_50ms::SigU3T14_status;
   Msg_U3T_Obj_14_50ms.U3T14_FRcorner_lat.phys = @sysvar::MsgU3T_Obj_14_50ms::SigU3T14_FRcorner_lat;
   Msg_U3T_Obj_14_50ms.U3T14_FRcorner_long.phys = @sysvar::MsgU3T_Obj_14_50ms::SigU3T14_FRcorner_long;
   Msg_U3T_Obj_14_50ms.U3T14_heading_rate.phys = @sysvar::MsgU3T_Obj_14_50ms::SigU3T14_heading_rate;
   Msg_U3T_Obj_14_50ms.U3T14_id.phys = @sysvar::MsgU3T_Obj_14_50ms::SigU3T14_id;
   Msg_U3T_Obj_14_50ms.U3T14_length.phys = @sysvar::MsgU3T_Obj_14_50ms::SigU3T14_length;
   Msg_U3T_Obj_14_50ms.U3T14_RLcorner_lat.phys = @sysvar::MsgU3T_Obj_14_50ms::SigU3T14_RLcorner_lat;
   Msg_U3T_Obj_14_50ms.U3T14_RLcorner_long.phys = @sysvar::MsgU3T_Obj_14_50ms::SigU3T14_RLcorner_long;
   Msg_U3T_Obj_14_50ms.U3T14_RRcorner_lat.phys = @sysvar::MsgU3T_Obj_14_50ms::SigU3T14_RRcorner_lat;
   Msg_U3T_Obj_14_50ms.U3T14_RRcorner_long.phys = @sysvar::MsgU3T_Obj_14_50ms::SigU3T14_RRcorner_long;
   Msg_U3T_Obj_14_50ms.U3T14_speed.phys = @sysvar::MsgU3T_Obj_14_50ms::SigU3T14_speed;
   Msg_U3T_Obj_14_50ms.U3T14_width.phys = @sysvar::MsgU3T_Obj_14_50ms::SigU3T14_width;
   Msg_U3T_Obj_14_50ms.U3T14_fusion_source.phys = @sysvar::MsgU3T_Obj_14_50ms::SigU3T14_fusion_source;
   Msg_U3T_Obj_14_50ms.U3T14_vcs_heading.phys = @sysvar::MsgU3T_Obj_14_50ms::SigU3T14_vcs_heading;
   Msg_U3T_Obj_14_50ms.U3T14_vcs_lat_accel.phys = @sysvar::MsgU3T_Obj_14_50ms::SigU3T14_vcs_lat_accel;
   Msg_U3T_Obj_14_50ms.U3T14_vcs_lat_posn.phys = @sysvar::MsgU3T_Obj_14_50ms::SigU3T14_vcs_lat_posn;
   Msg_U3T_Obj_14_50ms.U3T14_vcs_lat_vel.phys = @sysvar::MsgU3T_Obj_14_50ms::SigU3T14_vcs_lat_vel;
   Msg_U3T_Obj_14_50ms.U3T14_vcs_long_accel.phys = @sysvar::MsgU3T_Obj_14_50ms::SigU3T14_vcs_long_accel;
   Msg_U3T_Obj_14_50ms.U3T14_vcs_long_posn.phys = @sysvar::MsgU3T_Obj_14_50ms::SigU3T14_vcs_long_posn;
   Msg_U3T_Obj_14_50ms.U3T14_vcs_long_vel.phys = @sysvar::MsgU3T_Obj_14_50ms::SigU3T14_vcs_long_vel;
   Msg_U3T_Obj_14_50ms.U3T14_conf_overall.phys = @sysvar::MsgU3T_Obj_14_50ms::SigU3T14_conf_overall;
   Msg_U3T_Obj_14_50ms.U3T14_f_oncoming.phys = @sysvar::MsgU3T_Obj_14_50ms::SigU3T14_f_oncoming;
   Msg_U3T_Obj_14_50ms.U3T14_f_receding.phys = @sysvar::MsgU3T_Obj_14_50ms::SigU3T14_f_receding;
   output(Msg_U3T_Obj_14_50ms);
   Msg_U3T_Obj_13_50ms.U3T13_age.phys = @sysvar::MsgU3T_Obj_13_50ms::SigU3T13_age;
   Msg_U3T_Obj_13_50ms.U3T13_f_moveable.phys = @sysvar::MsgU3T_Obj_13_50ms::SigU3T13_f_moveable;
   Msg_U3T_Obj_13_50ms.U3T13_f_stationary.phys = @sysvar::MsgU3T_Obj_13_50ms::SigU3T13_f_stationary;
   Msg_U3T_Obj_13_50ms.U3T13_FLcorner_lat.phys = @sysvar::MsgU3T_Obj_13_50ms::SigU3T13_FLcorner_lat;
   Msg_U3T_Obj_13_50ms.U3T13_object_class.phys = @sysvar::MsgU3T_Obj_13_50ms::SigU3T13_object_class;
   Msg_U3T_Obj_13_50ms.U3T13_FLcorner_long.phys = @sysvar::MsgU3T_Obj_13_50ms::SigU3T13_FLcorner_long;
   Msg_U3T_Obj_13_50ms.U3T13_status.phys = @sysvar::MsgU3T_Obj_13_50ms::SigU3T13_status;
   Msg_U3T_Obj_13_50ms.U3T13_FRcorner_lat.phys = @sysvar::MsgU3T_Obj_13_50ms::SigU3T13_FRcorner_lat;
   Msg_U3T_Obj_13_50ms.U3T13_FRcorner_long.phys = @sysvar::MsgU3T_Obj_13_50ms::SigU3T13_FRcorner_long;
   Msg_U3T_Obj_13_50ms.U3T13_heading_rate.phys = @sysvar::MsgU3T_Obj_13_50ms::SigU3T13_heading_rate;
   Msg_U3T_Obj_13_50ms.U3T13_id.phys = @sysvar::MsgU3T_Obj_13_50ms::SigU3T13_id;
   Msg_U3T_Obj_13_50ms.U3T13_length.phys = @sysvar::MsgU3T_Obj_13_50ms::SigU3T13_length;
   Msg_U3T_Obj_13_50ms.U3T13_RLcorner_lat.phys = @sysvar::MsgU3T_Obj_13_50ms::SigU3T13_RLcorner_lat;
   Msg_U3T_Obj_13_50ms.U3T13_RLcorner_long.phys = @sysvar::MsgU3T_Obj_13_50ms::SigU3T13_RLcorner_long;
   Msg_U3T_Obj_13_50ms.U3T13_RRcorner_lat.phys = @sysvar::MsgU3T_Obj_13_50ms::SigU3T13_RRcorner_lat;
   Msg_U3T_Obj_13_50ms.U3T13_RRcorner_long.phys = @sysvar::MsgU3T_Obj_13_50ms::SigU3T13_RRcorner_long;
   Msg_U3T_Obj_13_50ms.U3T13_speed.phys = @sysvar::MsgU3T_Obj_13_50ms::SigU3T13_speed;
   Msg_U3T_Obj_13_50ms.U3T13_width.phys = @sysvar::MsgU3T_Obj_13_50ms::SigU3T13_width;
   Msg_U3T_Obj_13_50ms.U3T13_fusion_source.phys = @sysvar::MsgU3T_Obj_13_50ms::SigU3T13_fusion_source;
   Msg_U3T_Obj_13_50ms.U3T13_vcs_heading.phys = @sysvar::MsgU3T_Obj_13_50ms::SigU3T13_vcs_heading;
   Msg_U3T_Obj_13_50ms.U3T13_vcs_lat_accel.phys = @sysvar::MsgU3T_Obj_13_50ms::SigU3T13_vcs_lat_accel;
   Msg_U3T_Obj_13_50ms.U3T13_vcs_lat_posn.phys = @sysvar::MsgU3T_Obj_13_50ms::SigU3T13_vcs_lat_posn;
   Msg_U3T_Obj_13_50ms.U3T13_vcs_lat_vel.phys = @sysvar::MsgU3T_Obj_13_50ms::SigU3T13_vcs_lat_vel;
   Msg_U3T_Obj_13_50ms.U3T13_vcs_long_accel.phys = @sysvar::MsgU3T_Obj_13_50ms::SigU3T13_vcs_long_accel;
   Msg_U3T_Obj_13_50ms.U3T13_vcs_long_posn.phys = @sysvar::MsgU3T_Obj_13_50ms::SigU3T13_vcs_long_posn;
   Msg_U3T_Obj_13_50ms.U3T13_vcs_long_vel.phys = @sysvar::MsgU3T_Obj_13_50ms::SigU3T13_vcs_long_vel;
   Msg_U3T_Obj_13_50ms.U3T13_conf_overall.phys = @sysvar::MsgU3T_Obj_13_50ms::SigU3T13_conf_overall;
   Msg_U3T_Obj_13_50ms.U3T13_f_oncoming.phys = @sysvar::MsgU3T_Obj_13_50ms::SigU3T13_f_oncoming;
   Msg_U3T_Obj_13_50ms.U3T13_f_receding.phys = @sysvar::MsgU3T_Obj_13_50ms::SigU3T13_f_receding;
   output(Msg_U3T_Obj_13_50ms);
   Msg_U3T_Obj_12_50ms.U3T12_age.phys = @sysvar::MsgU3T_Obj_12_50ms::SigU3T12_age;
   Msg_U3T_Obj_12_50ms.U3T12_f_moveable.phys = @sysvar::MsgU3T_Obj_12_50ms::SigU3T12_f_moveable;
   Msg_U3T_Obj_12_50ms.U3T12_f_stationary.phys = @sysvar::MsgU3T_Obj_12_50ms::SigU3T12_f_stationary;
   Msg_U3T_Obj_12_50ms.U3T12_FLcorner_lat.phys = @sysvar::MsgU3T_Obj_12_50ms::SigU3T12_FLcorner_lat;
   Msg_U3T_Obj_12_50ms.U3T12_object_class.phys = @sysvar::MsgU3T_Obj_12_50ms::SigU3T12_object_class;
   Msg_U3T_Obj_12_50ms.U3T12_FLcorner_long.phys = @sysvar::MsgU3T_Obj_12_50ms::SigU3T12_FLcorner_long;
   Msg_U3T_Obj_12_50ms.U3T12_status.phys = @sysvar::MsgU3T_Obj_12_50ms::SigU3T12_status;
   Msg_U3T_Obj_12_50ms.U3T12_FRcorner_lat.phys = @sysvar::MsgU3T_Obj_12_50ms::SigU3T12_FRcorner_lat;
   Msg_U3T_Obj_12_50ms.U3T12_FRcorner_long.phys = @sysvar::MsgU3T_Obj_12_50ms::SigU3T12_FRcorner_long;
   Msg_U3T_Obj_12_50ms.U3T12_heading_rate.phys = @sysvar::MsgU3T_Obj_12_50ms::SigU3T12_heading_rate;
   Msg_U3T_Obj_12_50ms.U3T12_id.phys = @sysvar::MsgU3T_Obj_12_50ms::SigU3T12_id;
   Msg_U3T_Obj_12_50ms.U3T12_length.phys = @sysvar::MsgU3T_Obj_12_50ms::SigU3T12_length;
   Msg_U3T_Obj_12_50ms.U3T12_RLcorner_lat.phys = @sysvar::MsgU3T_Obj_12_50ms::SigU3T12_RLcorner_lat;
   Msg_U3T_Obj_12_50ms.U3T12_RLcorner_long.phys = @sysvar::MsgU3T_Obj_12_50ms::SigU3T12_RLcorner_long;
   Msg_U3T_Obj_12_50ms.U3T12_RRcorner_lat.phys = @sysvar::MsgU3T_Obj_12_50ms::SigU3T12_RRcorner_lat;
   Msg_U3T_Obj_12_50ms.U3T12_RRcorner_long.phys = @sysvar::MsgU3T_Obj_12_50ms::SigU3T12_RRcorner_long;
   Msg_U3T_Obj_12_50ms.U3T12_speed.phys = @sysvar::MsgU3T_Obj_12_50ms::SigU3T12_speed;
   Msg_U3T_Obj_12_50ms.U3T12_width.phys = @sysvar::MsgU3T_Obj_12_50ms::SigU3T12_width;
   Msg_U3T_Obj_12_50ms.U3T12_fusion_source.phys = @sysvar::MsgU3T_Obj_12_50ms::SigU3T12_fusion_source;
   Msg_U3T_Obj_12_50ms.U3T12_vcs_heading.phys = @sysvar::MsgU3T_Obj_12_50ms::SigU3T12_vcs_heading;
   Msg_U3T_Obj_12_50ms.U3T12_vcs_lat_accel.phys = @sysvar::MsgU3T_Obj_12_50ms::SigU3T12_vcs_lat_accel;
   Msg_U3T_Obj_12_50ms.U3T12_vcs_lat_posn.phys = @sysvar::MsgU3T_Obj_12_50ms::SigU3T12_vcs_lat_posn;
   Msg_U3T_Obj_12_50ms.U3T12_vcs_lat_vel.phys = @sysvar::MsgU3T_Obj_12_50ms::SigU3T12_vcs_lat_vel;
   Msg_U3T_Obj_12_50ms.U3T12_vcs_long_accel.phys = @sysvar::MsgU3T_Obj_12_50ms::SigU3T12_vcs_long_accel;
   Msg_U3T_Obj_12_50ms.U3T12_vcs_long_posn.phys = @sysvar::MsgU3T_Obj_12_50ms::SigU3T12_vcs_long_posn;
   Msg_U3T_Obj_12_50ms.U3T12_vcs_long_vel.phys = @sysvar::MsgU3T_Obj_12_50ms::SigU3T12_vcs_long_vel;
   Msg_U3T_Obj_12_50ms.U3T12_conf_overall.phys = @sysvar::MsgU3T_Obj_12_50ms::SigU3T12_conf_overall;
   Msg_U3T_Obj_12_50ms.U3T12_f_oncoming.phys = @sysvar::MsgU3T_Obj_12_50ms::SigU3T12_f_oncoming;
   Msg_U3T_Obj_12_50ms.U3T12_f_receding.phys = @sysvar::MsgU3T_Obj_12_50ms::SigU3T12_f_receding;
   output(Msg_U3T_Obj_12_50ms);
   Msg_U3T_Obj_11_50ms.U3T11_age.phys = @sysvar::MsgU3T_Obj_11_50ms::SigU3T11_age;
   Msg_U3T_Obj_11_50ms.U3T11_f_moveable.phys = @sysvar::MsgU3T_Obj_11_50ms::SigU3T11_f_moveable;
   Msg_U3T_Obj_11_50ms.U3T11_f_stationary.phys = @sysvar::MsgU3T_Obj_11_50ms::SigU3T11_f_stationary;
   Msg_U3T_Obj_11_50ms.U3T11_FLcorner_lat.phys = @sysvar::MsgU3T_Obj_11_50ms::SigU3T11_FLcorner_lat;
   Msg_U3T_Obj_11_50ms.U3T11_object_class.phys = @sysvar::MsgU3T_Obj_11_50ms::SigU3T11_object_class;
   Msg_U3T_Obj_11_50ms.U3T11_FLcorner_long.phys = @sysvar::MsgU3T_Obj_11_50ms::SigU3T11_FLcorner_long;
   Msg_U3T_Obj_11_50ms.U3T11_status.phys = @sysvar::MsgU3T_Obj_11_50ms::SigU3T11_status;
   Msg_U3T_Obj_11_50ms.U3T11_FRcorner_lat.phys = @sysvar::MsgU3T_Obj_11_50ms::SigU3T11_FRcorner_lat;
   Msg_U3T_Obj_11_50ms.U3T11_FRcorner_long.phys = @sysvar::MsgU3T_Obj_11_50ms::SigU3T11_FRcorner_long;
   Msg_U3T_Obj_11_50ms.U3T11_heading_rate.phys = @sysvar::MsgU3T_Obj_11_50ms::SigU3T11_heading_rate;
   Msg_U3T_Obj_11_50ms.U3T11_id.phys = @sysvar::MsgU3T_Obj_11_50ms::SigU3T11_id;
   Msg_U3T_Obj_11_50ms.U3T11_length.phys = @sysvar::MsgU3T_Obj_11_50ms::SigU3T11_length;
   Msg_U3T_Obj_11_50ms.U3T11_RLcorner_lat.phys = @sysvar::MsgU3T_Obj_11_50ms::SigU3T11_RLcorner_lat;
   Msg_U3T_Obj_11_50ms.U3T11_RLcorner_long.phys = @sysvar::MsgU3T_Obj_11_50ms::SigU3T11_RLcorner_long;
   Msg_U3T_Obj_11_50ms.U3T11_RRcorner_lat.phys = @sysvar::MsgU3T_Obj_11_50ms::SigU3T11_RRcorner_lat;
   Msg_U3T_Obj_11_50ms.U3T11_RRcorner_long.phys = @sysvar::MsgU3T_Obj_11_50ms::SigU3T11_RRcorner_long;
   Msg_U3T_Obj_11_50ms.U3T11_speed.phys = @sysvar::MsgU3T_Obj_11_50ms::SigU3T11_speed;
   Msg_U3T_Obj_11_50ms.U3T11_width.phys = @sysvar::MsgU3T_Obj_11_50ms::SigU3T11_width;
   Msg_U3T_Obj_11_50ms.U3T11_fusion_source.phys = @sysvar::MsgU3T_Obj_11_50ms::SigU3T11_fusion_source;
   Msg_U3T_Obj_11_50ms.U3T11_vcs_heading.phys = @sysvar::MsgU3T_Obj_11_50ms::SigU3T11_vcs_heading;
   Msg_U3T_Obj_11_50ms.U3T11_vcs_lat_accel.phys = @sysvar::MsgU3T_Obj_11_50ms::SigU3T11_vcs_lat_accel;
   Msg_U3T_Obj_11_50ms.U3T11_vcs_lat_posn.phys = @sysvar::MsgU3T_Obj_11_50ms::SigU3T11_vcs_lat_posn;
   Msg_U3T_Obj_11_50ms.U3T11_vcs_lat_vel.phys = @sysvar::MsgU3T_Obj_11_50ms::SigU3T11_vcs_lat_vel;
   Msg_U3T_Obj_11_50ms.U3T11_vcs_long_accel.phys = @sysvar::MsgU3T_Obj_11_50ms::SigU3T11_vcs_long_accel;
   Msg_U3T_Obj_11_50ms.U3T11_vcs_long_posn.phys = @sysvar::MsgU3T_Obj_11_50ms::SigU3T11_vcs_long_posn;
   Msg_U3T_Obj_11_50ms.U3T11_vcs_long_vel.phys = @sysvar::MsgU3T_Obj_11_50ms::SigU3T11_vcs_long_vel;
   Msg_U3T_Obj_11_50ms.U3T11_conf_overall.phys = @sysvar::MsgU3T_Obj_11_50ms::SigU3T11_conf_overall;
   Msg_U3T_Obj_11_50ms.U3T11_f_oncoming.phys = @sysvar::MsgU3T_Obj_11_50ms::SigU3T11_f_oncoming;
   Msg_U3T_Obj_11_50ms.U3T11_f_receding.phys = @sysvar::MsgU3T_Obj_11_50ms::SigU3T11_f_receding;
   output(Msg_U3T_Obj_11_50ms);
   Msg_U3T_Obj_10_50ms.U3T10_age.phys = @sysvar::MsgU3T_Obj_10_50ms::SigU3T10_age;
   Msg_U3T_Obj_10_50ms.U3T10_f_moveable.phys = @sysvar::MsgU3T_Obj_10_50ms::SigU3T10_f_moveable;
   Msg_U3T_Obj_10_50ms.U3T10_f_stationary.phys = @sysvar::MsgU3T_Obj_10_50ms::SigU3T10_f_stationary;
   Msg_U3T_Obj_10_50ms.U3T10_FLcorner_lat.phys = @sysvar::MsgU3T_Obj_10_50ms::SigU3T10_FLcorner_lat;
   Msg_U3T_Obj_10_50ms.U3T10_object_class.phys = @sysvar::MsgU3T_Obj_10_50ms::SigU3T10_object_class;
   Msg_U3T_Obj_10_50ms.U3T10_FLcorner_long.phys = @sysvar::MsgU3T_Obj_10_50ms::SigU3T10_FLcorner_long;
   Msg_U3T_Obj_10_50ms.U3T10_status.phys = @sysvar::MsgU3T_Obj_10_50ms::SigU3T10_status;
   Msg_U3T_Obj_10_50ms.U3T10_FRcorner_lat.phys = @sysvar::MsgU3T_Obj_10_50ms::SigU3T10_FRcorner_lat;
   Msg_U3T_Obj_10_50ms.U3T10_FRcorner_long.phys = @sysvar::MsgU3T_Obj_10_50ms::SigU3T10_FRcorner_long;
   Msg_U3T_Obj_10_50ms.U3T10_heading_rate.phys = @sysvar::MsgU3T_Obj_10_50ms::SigU3T10_heading_rate;
   Msg_U3T_Obj_10_50ms.U3T10_id.phys = @sysvar::MsgU3T_Obj_10_50ms::SigU3T10_id;
   Msg_U3T_Obj_10_50ms.U3T10_length.phys = @sysvar::MsgU3T_Obj_10_50ms::SigU3T10_length;
   Msg_U3T_Obj_10_50ms.U3T10_RLcorner_lat.phys = @sysvar::MsgU3T_Obj_10_50ms::SigU3T10_RLcorner_lat;
   Msg_U3T_Obj_10_50ms.U3T10_RLcorner_long.phys = @sysvar::MsgU3T_Obj_10_50ms::SigU3T10_RLcorner_long;
   Msg_U3T_Obj_10_50ms.U3T10_RRcorner_lat.phys = @sysvar::MsgU3T_Obj_10_50ms::SigU3T10_RRcorner_lat;
   Msg_U3T_Obj_10_50ms.U3T10_RRcorner_long.phys = @sysvar::MsgU3T_Obj_10_50ms::SigU3T10_RRcorner_long;
   Msg_U3T_Obj_10_50ms.U3T10_speed.phys = @sysvar::MsgU3T_Obj_10_50ms::SigU3T10_speed;
   Msg_U3T_Obj_10_50ms.U3T10_width.phys = @sysvar::MsgU3T_Obj_10_50ms::SigU3T10_width;
   Msg_U3T_Obj_10_50ms.U3T10_fusion_source.phys = @sysvar::MsgU3T_Obj_10_50ms::SigU3T10_fusion_source;
   Msg_U3T_Obj_10_50ms.U3T10_vcs_heading.phys = @sysvar::MsgU3T_Obj_10_50ms::SigU3T10_vcs_heading;
   Msg_U3T_Obj_10_50ms.U3T10_vcs_lat_accel.phys = @sysvar::MsgU3T_Obj_10_50ms::SigU3T10_vcs_lat_accel;
   Msg_U3T_Obj_10_50ms.U3T10_vcs_lat_posn.phys = @sysvar::MsgU3T_Obj_10_50ms::SigU3T10_vcs_lat_posn;
   Msg_U3T_Obj_10_50ms.U3T10_vcs_lat_vel.phys = @sysvar::MsgU3T_Obj_10_50ms::SigU3T10_vcs_lat_vel;
   Msg_U3T_Obj_10_50ms.U3T10_vcs_long_accel.phys = @sysvar::MsgU3T_Obj_10_50ms::SigU3T10_vcs_long_accel;
   Msg_U3T_Obj_10_50ms.U3T10_vcs_long_posn.phys = @sysvar::MsgU3T_Obj_10_50ms::SigU3T10_vcs_long_posn;
   Msg_U3T_Obj_10_50ms.U3T10_vcs_long_vel.phys = @sysvar::MsgU3T_Obj_10_50ms::SigU3T10_vcs_long_vel;
   Msg_U3T_Obj_10_50ms.U3T10_conf_overall.phys = @sysvar::MsgU3T_Obj_10_50ms::SigU3T10_conf_overall;
   Msg_U3T_Obj_10_50ms.U3T10_f_oncoming.phys = @sysvar::MsgU3T_Obj_10_50ms::SigU3T10_f_oncoming;
   Msg_U3T_Obj_10_50ms.U3T10_f_receding.phys = @sysvar::MsgU3T_Obj_10_50ms::SigU3T10_f_receding;
   output(Msg_U3T_Obj_10_50ms);
   Msg_U3T_Obj_09_50ms.U3T09_age.phys = @sysvar::MsgU3T_Obj_09_50ms::SigU3T09_age;
   Msg_U3T_Obj_09_50ms.U3T09_f_moveable.phys = @sysvar::MsgU3T_Obj_09_50ms::SigU3T09_f_moveable;
   Msg_U3T_Obj_09_50ms.U3T09_f_stationary.phys = @sysvar::MsgU3T_Obj_09_50ms::SigU3T09_f_stationary;
   Msg_U3T_Obj_09_50ms.U3T09_FLcorner_lat.phys = @sysvar::MsgU3T_Obj_09_50ms::SigU3T09_FLcorner_lat;
   Msg_U3T_Obj_09_50ms.U3T09_object_class.phys = @sysvar::MsgU3T_Obj_09_50ms::SigU3T09_object_class;
   Msg_U3T_Obj_09_50ms.U3T09_FLcorner_long.phys = @sysvar::MsgU3T_Obj_09_50ms::SigU3T09_FLcorner_long;
   Msg_U3T_Obj_09_50ms.U3T09_status.phys = @sysvar::MsgU3T_Obj_09_50ms::SigU3T09_status;
   Msg_U3T_Obj_09_50ms.U3T09_FRcorner_lat.phys = @sysvar::MsgU3T_Obj_09_50ms::SigU3T09_FRcorner_lat;
   Msg_U3T_Obj_09_50ms.U3T09_FRcorner_long.phys = @sysvar::MsgU3T_Obj_09_50ms::SigU3T09_FRcorner_long;
   Msg_U3T_Obj_09_50ms.U3T09_heading_rate.phys = @sysvar::MsgU3T_Obj_09_50ms::SigU3T09_heading_rate;
   Msg_U3T_Obj_09_50ms.U3T09_id.phys = @sysvar::MsgU3T_Obj_09_50ms::SigU3T09_id;
   Msg_U3T_Obj_09_50ms.U3T09_length.phys = @sysvar::MsgU3T_Obj_09_50ms::SigU3T09_length;
   Msg_U3T_Obj_09_50ms.U3T09_RLcorner_lat.phys = @sysvar::MsgU3T_Obj_09_50ms::SigU3T09_RLcorner_lat;
   Msg_U3T_Obj_09_50ms.U3T09_RLcorner_long.phys = @sysvar::MsgU3T_Obj_09_50ms::SigU3T09_RLcorner_long;
   Msg_U3T_Obj_09_50ms.U3T09_RRcorner_lat.phys = @sysvar::MsgU3T_Obj_09_50ms::SigU3T09_RRcorner_lat;
   Msg_U3T_Obj_09_50ms.U3T09_RRcorner_long.phys = @sysvar::MsgU3T_Obj_09_50ms::SigU3T09_RRcorner_long;
   Msg_U3T_Obj_09_50ms.U3T09_speed.phys = @sysvar::MsgU3T_Obj_09_50ms::SigU3T09_speed;
   Msg_U3T_Obj_09_50ms.U3T09_width.phys = @sysvar::MsgU3T_Obj_09_50ms::SigU3T09_width;
   Msg_U3T_Obj_09_50ms.U3T09_fusion_source.phys = @sysvar::MsgU3T_Obj_09_50ms::SigU3T09_fusion_source;
   Msg_U3T_Obj_09_50ms.U3T09_vcs_heading.phys = @sysvar::MsgU3T_Obj_09_50ms::SigU3T09_vcs_heading;
   Msg_U3T_Obj_09_50ms.U3T09_vcs_lat_accel.phys = @sysvar::MsgU3T_Obj_09_50ms::SigU3T09_vcs_lat_accel;
   Msg_U3T_Obj_09_50ms.U3T09_vcs_lat_posn.phys = @sysvar::MsgU3T_Obj_09_50ms::SigU3T09_vcs_lat_posn;
   Msg_U3T_Obj_09_50ms.U3T09_vcs_lat_vel.phys = @sysvar::MsgU3T_Obj_09_50ms::SigU3T09_vcs_lat_vel;
   Msg_U3T_Obj_09_50ms.U3T09_vcs_long_accel.phys = @sysvar::MsgU3T_Obj_09_50ms::SigU3T09_vcs_long_accel;
   Msg_U3T_Obj_09_50ms.U3T09_vcs_long_posn.phys = @sysvar::MsgU3T_Obj_09_50ms::SigU3T09_vcs_long_posn;
   Msg_U3T_Obj_09_50ms.U3T09_vcs_long_vel.phys = @sysvar::MsgU3T_Obj_09_50ms::SigU3T09_vcs_long_vel;
   Msg_U3T_Obj_09_50ms.U3T09_conf_overall.phys = @sysvar::MsgU3T_Obj_09_50ms::SigU3T09_conf_overall;
   Msg_U3T_Obj_09_50ms.U3T09_f_oncoming.phys = @sysvar::MsgU3T_Obj_09_50ms::SigU3T09_f_oncoming;
   Msg_U3T_Obj_09_50ms.U3T09_f_receding.phys = @sysvar::MsgU3T_Obj_09_50ms::SigU3T09_f_receding;
   output(Msg_U3T_Obj_09_50ms);
   Msg_U3T_Obj_08_50ms.U3T08_age.phys = @sysvar::MsgU3T_Obj_08_50ms::SigU3T08_age;
   Msg_U3T_Obj_08_50ms.U3T08_f_moveable.phys = @sysvar::MsgU3T_Obj_08_50ms::SigU3T08_f_moveable;
   Msg_U3T_Obj_08_50ms.U3T08_f_stationary.phys = @sysvar::MsgU3T_Obj_08_50ms::SigU3T08_f_stationary;
   Msg_U3T_Obj_08_50ms.U3T08_FLcorner_lat.phys = @sysvar::MsgU3T_Obj_08_50ms::SigU3T08_FLcorner_lat;
   Msg_U3T_Obj_08_50ms.U3T08_object_class.phys = @sysvar::MsgU3T_Obj_08_50ms::SigU3T08_object_class;
   Msg_U3T_Obj_08_50ms.U3T08_FLcorner_long.phys = @sysvar::MsgU3T_Obj_08_50ms::SigU3T08_FLcorner_long;
   Msg_U3T_Obj_08_50ms.U3T08_status.phys = @sysvar::MsgU3T_Obj_08_50ms::SigU3T08_status;
   Msg_U3T_Obj_08_50ms.U3T08_FRcorner_lat.phys = @sysvar::MsgU3T_Obj_08_50ms::SigU3T08_FRcorner_lat;
   Msg_U3T_Obj_08_50ms.U3T08_FRcorner_long.phys = @sysvar::MsgU3T_Obj_08_50ms::SigU3T08_FRcorner_long;
   Msg_U3T_Obj_08_50ms.U3T08_heading_rate.phys = @sysvar::MsgU3T_Obj_08_50ms::SigU3T08_heading_rate;
   Msg_U3T_Obj_08_50ms.U3T08_id.phys = @sysvar::MsgU3T_Obj_08_50ms::SigU3T08_id;
   Msg_U3T_Obj_08_50ms.U3T08_length.phys = @sysvar::MsgU3T_Obj_08_50ms::SigU3T08_length;
   Msg_U3T_Obj_08_50ms.U3T08_RLcorner_lat.phys = @sysvar::MsgU3T_Obj_08_50ms::SigU3T08_RLcorner_lat;
   Msg_U3T_Obj_08_50ms.U3T08_RLcorner_long.phys = @sysvar::MsgU3T_Obj_08_50ms::SigU3T08_RLcorner_long;
   Msg_U3T_Obj_08_50ms.U3T08_RRcorner_lat.phys = @sysvar::MsgU3T_Obj_08_50ms::SigU3T08_RRcorner_lat;
   Msg_U3T_Obj_08_50ms.U3T08_RRcorner_long.phys = @sysvar::MsgU3T_Obj_08_50ms::SigU3T08_RRcorner_long;
   Msg_U3T_Obj_08_50ms.U3T08_speed.phys = @sysvar::MsgU3T_Obj_08_50ms::SigU3T08_speed;
   Msg_U3T_Obj_08_50ms.U3T08_width.phys = @sysvar::MsgU3T_Obj_08_50ms::SigU3T08_width;
   Msg_U3T_Obj_08_50ms.U3T08_fusion_source.phys = @sysvar::MsgU3T_Obj_08_50ms::SigU3T08_fusion_source;
   Msg_U3T_Obj_08_50ms.U3T08_vcs_heading.phys = @sysvar::MsgU3T_Obj_08_50ms::SigU3T08_vcs_heading;
   Msg_U3T_Obj_08_50ms.U3T08_vcs_lat_accel.phys = @sysvar::MsgU3T_Obj_08_50ms::SigU3T08_vcs_lat_accel;
   Msg_U3T_Obj_08_50ms.U3T08_vcs_lat_posn.phys = @sysvar::MsgU3T_Obj_08_50ms::SigU3T08_vcs_lat_posn;
   Msg_U3T_Obj_08_50ms.U3T08_vcs_lat_vel.phys = @sysvar::MsgU3T_Obj_08_50ms::SigU3T08_vcs_lat_vel;
   Msg_U3T_Obj_08_50ms.U3T08_vcs_long_accel.phys = @sysvar::MsgU3T_Obj_08_50ms::SigU3T08_vcs_long_accel;
   Msg_U3T_Obj_08_50ms.U3T08_vcs_long_posn.phys = @sysvar::MsgU3T_Obj_08_50ms::SigU3T08_vcs_long_posn;
   Msg_U3T_Obj_08_50ms.U3T08_vcs_long_vel.phys = @sysvar::MsgU3T_Obj_08_50ms::SigU3T08_vcs_long_vel;
   Msg_U3T_Obj_08_50ms.U3T08_conf_overall.phys = @sysvar::MsgU3T_Obj_08_50ms::SigU3T08_conf_overall;
   Msg_U3T_Obj_08_50ms.U3T08_f_oncoming.phys = @sysvar::MsgU3T_Obj_08_50ms::SigU3T08_f_oncoming;
   Msg_U3T_Obj_08_50ms.U3T08_f_receding.phys = @sysvar::MsgU3T_Obj_08_50ms::SigU3T08_f_receding;
   output(Msg_U3T_Obj_08_50ms);
   Msg_U3T_Obj_07_50ms.U3T07_age.phys = @sysvar::MsgU3T_Obj_07_50ms::SigU3T07_age;
   Msg_U3T_Obj_07_50ms.U3T07_f_moveable.phys = @sysvar::MsgU3T_Obj_07_50ms::SigU3T07_f_moveable;
   Msg_U3T_Obj_07_50ms.U3T07_f_stationary.phys = @sysvar::MsgU3T_Obj_07_50ms::SigU3T07_f_stationary;
   Msg_U3T_Obj_07_50ms.U3T07_FLcorner_lat.phys = @sysvar::MsgU3T_Obj_07_50ms::SigU3T07_FLcorner_lat;
   Msg_U3T_Obj_07_50ms.U3T07_object_class.phys = @sysvar::MsgU3T_Obj_07_50ms::SigU3T07_object_class;
   Msg_U3T_Obj_07_50ms.U3T07_FLcorner_long.phys = @sysvar::MsgU3T_Obj_07_50ms::SigU3T07_FLcorner_long;
   Msg_U3T_Obj_07_50ms.U3T07_status.phys = @sysvar::MsgU3T_Obj_07_50ms::SigU3T07_status;
   Msg_U3T_Obj_07_50ms.U3T07_FRcorner_lat.phys = @sysvar::MsgU3T_Obj_07_50ms::SigU3T07_FRcorner_lat;
   Msg_U3T_Obj_07_50ms.U3T07_FRcorner_long.phys = @sysvar::MsgU3T_Obj_07_50ms::SigU3T07_FRcorner_long;
   Msg_U3T_Obj_07_50ms.U3T07_heading_rate.phys = @sysvar::MsgU3T_Obj_07_50ms::SigU3T07_heading_rate;
   Msg_U3T_Obj_07_50ms.U3T07_id.phys = @sysvar::MsgU3T_Obj_07_50ms::SigU3T07_id;
   Msg_U3T_Obj_07_50ms.U3T07_length.phys = @sysvar::MsgU3T_Obj_07_50ms::SigU3T07_length;
   Msg_U3T_Obj_07_50ms.U3T07_RLcorner_lat.phys = @sysvar::MsgU3T_Obj_07_50ms::SigU3T07_RLcorner_lat;
   Msg_U3T_Obj_07_50ms.U3T07_RLcorner_long.phys = @sysvar::MsgU3T_Obj_07_50ms::SigU3T07_RLcorner_long;
   Msg_U3T_Obj_07_50ms.U3T07_RRcorner_lat.phys = @sysvar::MsgU3T_Obj_07_50ms::SigU3T07_RRcorner_lat;
   Msg_U3T_Obj_07_50ms.U3T07_RRcorner_long.phys = @sysvar::MsgU3T_Obj_07_50ms::SigU3T07_RRcorner_long;
   Msg_U3T_Obj_07_50ms.U3T07_speed.phys = @sysvar::MsgU3T_Obj_07_50ms::SigU3T07_speed;
   Msg_U3T_Obj_07_50ms.U3T07_width.phys = @sysvar::MsgU3T_Obj_07_50ms::SigU3T07_width;
   Msg_U3T_Obj_07_50ms.U3T07_fusion_source.phys = @sysvar::MsgU3T_Obj_07_50ms::SigU3T07_fusion_source;
   Msg_U3T_Obj_07_50ms.U3T07_vcs_heading.phys = @sysvar::MsgU3T_Obj_07_50ms::SigU3T07_vcs_heading;
   Msg_U3T_Obj_07_50ms.U3T07_vcs_lat_accel.phys = @sysvar::MsgU3T_Obj_07_50ms::SigU3T07_vcs_lat_accel;
   Msg_U3T_Obj_07_50ms.U3T07_vcs_lat_posn.phys = @sysvar::MsgU3T_Obj_07_50ms::SigU3T07_vcs_lat_posn;
   Msg_U3T_Obj_07_50ms.U3T07_vcs_lat_vel.phys = @sysvar::MsgU3T_Obj_07_50ms::SigU3T07_vcs_lat_vel;
   Msg_U3T_Obj_07_50ms.U3T07_vcs_long_accel.phys = @sysvar::MsgU3T_Obj_07_50ms::SigU3T07_vcs_long_accel;
   Msg_U3T_Obj_07_50ms.U3T07_vcs_long_posn.phys = @sysvar::MsgU3T_Obj_07_50ms::SigU3T07_vcs_long_posn;
   Msg_U3T_Obj_07_50ms.U3T07_vcs_long_vel.phys = @sysvar::MsgU3T_Obj_07_50ms::SigU3T07_vcs_long_vel;
   Msg_U3T_Obj_07_50ms.U3T07_conf_overall.phys = @sysvar::MsgU3T_Obj_07_50ms::SigU3T07_conf_overall;
   Msg_U3T_Obj_07_50ms.U3T07_f_oncoming.phys = @sysvar::MsgU3T_Obj_07_50ms::SigU3T07_f_oncoming;
   Msg_U3T_Obj_07_50ms.U3T07_f_receding.phys = @sysvar::MsgU3T_Obj_07_50ms::SigU3T07_f_receding;
   output(Msg_U3T_Obj_07_50ms);
   Msg_U3T_Obj_06_50ms.U3T06_age.phys = @sysvar::MsgU3T_Obj_06_50ms::SigU3T06_age;
   Msg_U3T_Obj_06_50ms.U3T06_f_moveable.phys = @sysvar::MsgU3T_Obj_06_50ms::SigU3T06_f_moveable;
   Msg_U3T_Obj_06_50ms.U3T06_f_stationary.phys = @sysvar::MsgU3T_Obj_06_50ms::SigU3T06_f_stationary;
   Msg_U3T_Obj_06_50ms.U3T06_FLcorner_lat.phys = @sysvar::MsgU3T_Obj_06_50ms::SigU3T06_FLcorner_lat;
   Msg_U3T_Obj_06_50ms.U3T06_object_class.phys = @sysvar::MsgU3T_Obj_06_50ms::SigU3T06_object_class;
   Msg_U3T_Obj_06_50ms.U3T06_FLcorner_long.phys = @sysvar::MsgU3T_Obj_06_50ms::SigU3T06_FLcorner_long;
   Msg_U3T_Obj_06_50ms.U3T06_status.phys = @sysvar::MsgU3T_Obj_06_50ms::SigU3T06_status;
   Msg_U3T_Obj_06_50ms.U3T06_FRcorner_lat.phys = @sysvar::MsgU3T_Obj_06_50ms::SigU3T06_FRcorner_lat;
   Msg_U3T_Obj_06_50ms.U3T06_FRcorner_long.phys = @sysvar::MsgU3T_Obj_06_50ms::SigU3T06_FRcorner_long;
   Msg_U3T_Obj_06_50ms.U3T06_heading_rate.phys = @sysvar::MsgU3T_Obj_06_50ms::SigU3T06_heading_rate;
   Msg_U3T_Obj_06_50ms.U3T06_id.phys = @sysvar::MsgU3T_Obj_06_50ms::SigU3T06_id;
   Msg_U3T_Obj_06_50ms.U3T06_length.phys = @sysvar::MsgU3T_Obj_06_50ms::SigU3T06_length;
   Msg_U3T_Obj_06_50ms.U3T06_RLcorner_lat.phys = @sysvar::MsgU3T_Obj_06_50ms::SigU3T06_RLcorner_lat;
   Msg_U3T_Obj_06_50ms.U3T06_RLcorner_long.phys = @sysvar::MsgU3T_Obj_06_50ms::SigU3T06_RLcorner_long;
   Msg_U3T_Obj_06_50ms.U3T06_RRcorner_lat.phys = @sysvar::MsgU3T_Obj_06_50ms::SigU3T06_RRcorner_lat;
   Msg_U3T_Obj_06_50ms.U3T06_RRcorner_long.phys = @sysvar::MsgU3T_Obj_06_50ms::SigU3T06_RRcorner_long;
   Msg_U3T_Obj_06_50ms.U3T06_speed.phys = @sysvar::MsgU3T_Obj_06_50ms::SigU3T06_speed;
   Msg_U3T_Obj_06_50ms.U3T06_width.phys = @sysvar::MsgU3T_Obj_06_50ms::SigU3T06_width;
   Msg_U3T_Obj_06_50ms.U3T06_fusion_source.phys = @sysvar::MsgU3T_Obj_06_50ms::SigU3T06_fusion_source;
   Msg_U3T_Obj_06_50ms.U3T06_vcs_heading.phys = @sysvar::MsgU3T_Obj_06_50ms::SigU3T06_vcs_heading;
   Msg_U3T_Obj_06_50ms.U3T06_vcs_lat_accel.phys = @sysvar::MsgU3T_Obj_06_50ms::SigU3T06_vcs_lat_accel;
   Msg_U3T_Obj_06_50ms.U3T06_vcs_lat_posn.phys = @sysvar::MsgU3T_Obj_06_50ms::SigU3T06_vcs_lat_posn;
   Msg_U3T_Obj_06_50ms.U3T06_vcs_lat_vel.phys = @sysvar::MsgU3T_Obj_06_50ms::SigU3T06_vcs_lat_vel;
   Msg_U3T_Obj_06_50ms.U3T06_vcs_long_accel.phys = @sysvar::MsgU3T_Obj_06_50ms::SigU3T06_vcs_long_accel;
   Msg_U3T_Obj_06_50ms.U3T06_vcs_long_posn.phys = @sysvar::MsgU3T_Obj_06_50ms::SigU3T06_vcs_long_posn;
   Msg_U3T_Obj_06_50ms.U3T06_vcs_long_vel.phys = @sysvar::MsgU3T_Obj_06_50ms::SigU3T06_vcs_long_vel;
   Msg_U3T_Obj_06_50ms.U3T06_conf_overall.phys = @sysvar::MsgU3T_Obj_06_50ms::SigU3T06_conf_overall;
   Msg_U3T_Obj_06_50ms.U3T06_f_oncoming.phys = @sysvar::MsgU3T_Obj_06_50ms::SigU3T06_f_oncoming;
   Msg_U3T_Obj_06_50ms.U3T06_f_receding.phys = @sysvar::MsgU3T_Obj_06_50ms::SigU3T06_f_receding;
   output(Msg_U3T_Obj_06_50ms);
   Msg_U3T_Obj_05_50ms.U3T05_age.phys = @sysvar::MsgU3T_Obj_05_50ms::SigU3T05_age;
   Msg_U3T_Obj_05_50ms.U3T05_f_moveable.phys = @sysvar::MsgU3T_Obj_05_50ms::SigU3T05_f_moveable;
   Msg_U3T_Obj_05_50ms.U3T05_f_stationary.phys = @sysvar::MsgU3T_Obj_05_50ms::SigU3T05_f_stationary;
   Msg_U3T_Obj_05_50ms.U3T05_FLcorner_lat.phys = @sysvar::MsgU3T_Obj_05_50ms::SigU3T05_FLcorner_lat;
   Msg_U3T_Obj_05_50ms.U3T05_object_class.phys = @sysvar::MsgU3T_Obj_05_50ms::SigU3T05_object_class;
   Msg_U3T_Obj_05_50ms.U3T05_FLcorner_long.phys = @sysvar::MsgU3T_Obj_05_50ms::SigU3T05_FLcorner_long;
   Msg_U3T_Obj_05_50ms.U3T05_status.phys = @sysvar::MsgU3T_Obj_05_50ms::SigU3T05_status;
   Msg_U3T_Obj_05_50ms.U3T05_FRcorner_lat.phys = @sysvar::MsgU3T_Obj_05_50ms::SigU3T05_FRcorner_lat;
   Msg_U3T_Obj_05_50ms.U3T05_FRcorner_long.phys = @sysvar::MsgU3T_Obj_05_50ms::SigU3T05_FRcorner_long;
   Msg_U3T_Obj_05_50ms.U3T05_heading_rate.phys = @sysvar::MsgU3T_Obj_05_50ms::SigU3T05_heading_rate;
   Msg_U3T_Obj_05_50ms.U3T05_id.phys = @sysvar::MsgU3T_Obj_05_50ms::SigU3T05_id;
   Msg_U3T_Obj_05_50ms.U3T05_length.phys = @sysvar::MsgU3T_Obj_05_50ms::SigU3T05_length;
   Msg_U3T_Obj_05_50ms.U3T05_RLcorner_lat.phys = @sysvar::MsgU3T_Obj_05_50ms::SigU3T05_RLcorner_lat;
   Msg_U3T_Obj_05_50ms.U3T05_RLcorner_long.phys = @sysvar::MsgU3T_Obj_05_50ms::SigU3T05_RLcorner_long;
   Msg_U3T_Obj_05_50ms.U3T05_RRcorner_lat.phys = @sysvar::MsgU3T_Obj_05_50ms::SigU3T05_RRcorner_lat;
   Msg_U3T_Obj_05_50ms.U3T05_RRcorner_long.phys = @sysvar::MsgU3T_Obj_05_50ms::SigU3T05_RRcorner_long;
   Msg_U3T_Obj_05_50ms.U3T05_speed.phys = @sysvar::MsgU3T_Obj_05_50ms::SigU3T05_speed;
   Msg_U3T_Obj_05_50ms.U3T05_width.phys = @sysvar::MsgU3T_Obj_05_50ms::SigU3T05_width;
   Msg_U3T_Obj_05_50ms.U3T05_fusion_source.phys = @sysvar::MsgU3T_Obj_05_50ms::SigU3T05_fusion_source;
   Msg_U3T_Obj_05_50ms.U3T05_vcs_heading.phys = @sysvar::MsgU3T_Obj_05_50ms::SigU3T05_vcs_heading;
   Msg_U3T_Obj_05_50ms.U3T05_vcs_lat_accel.phys = @sysvar::MsgU3T_Obj_05_50ms::SigU3T05_vcs_lat_accel;
   Msg_U3T_Obj_05_50ms.U3T05_vcs_lat_posn.phys = @sysvar::MsgU3T_Obj_05_50ms::SigU3T05_vcs_lat_posn;
   Msg_U3T_Obj_05_50ms.U3T05_vcs_lat_vel.phys = @sysvar::MsgU3T_Obj_05_50ms::SigU3T05_vcs_lat_vel;
   Msg_U3T_Obj_05_50ms.U3T05_vcs_long_accel.phys = @sysvar::MsgU3T_Obj_05_50ms::SigU3T05_vcs_long_accel;
   Msg_U3T_Obj_05_50ms.U3T05_vcs_long_posn.phys = @sysvar::MsgU3T_Obj_05_50ms::SigU3T05_vcs_long_posn;
   Msg_U3T_Obj_05_50ms.U3T05_vcs_long_vel.phys = @sysvar::MsgU3T_Obj_05_50ms::SigU3T05_vcs_long_vel;
   Msg_U3T_Obj_05_50ms.U3T05_conf_overall.phys = @sysvar::MsgU3T_Obj_05_50ms::SigU3T05_conf_overall;
   Msg_U3T_Obj_05_50ms.U3T05_f_oncoming.phys = @sysvar::MsgU3T_Obj_05_50ms::SigU3T05_f_oncoming;
   Msg_U3T_Obj_05_50ms.U3T05_f_receding.phys = @sysvar::MsgU3T_Obj_05_50ms::SigU3T05_f_receding;
   output(Msg_U3T_Obj_05_50ms);
   Msg_U3T_Obj_04_50ms.U3T04_age.phys = @sysvar::MsgU3T_Obj_04_50ms::SigU3T04_age;
   Msg_U3T_Obj_04_50ms.U3T04_f_moveable.phys = @sysvar::MsgU3T_Obj_04_50ms::SigU3T04_f_moveable;
   Msg_U3T_Obj_04_50ms.U3T04_f_stationary.phys = @sysvar::MsgU3T_Obj_04_50ms::SigU3T04_f_stationary;
   Msg_U3T_Obj_04_50ms.U3T04_FLcorner_lat.phys = @sysvar::MsgU3T_Obj_04_50ms::SigU3T04_FLcorner_lat;
   Msg_U3T_Obj_04_50ms.U3T04_object_class.phys = @sysvar::MsgU3T_Obj_04_50ms::SigU3T04_object_class;
   Msg_U3T_Obj_04_50ms.U3T04_FLcorner_long.phys = @sysvar::MsgU3T_Obj_04_50ms::SigU3T04_FLcorner_long;
   Msg_U3T_Obj_04_50ms.U3T04_status.phys = @sysvar::MsgU3T_Obj_04_50ms::SigU3T04_status;
   Msg_U3T_Obj_04_50ms.U3T04_FRcorner_lat.phys = @sysvar::MsgU3T_Obj_04_50ms::SigU3T04_FRcorner_lat;
   Msg_U3T_Obj_04_50ms.U3T04_FRcorner_long.phys = @sysvar::MsgU3T_Obj_04_50ms::SigU3T04_FRcorner_long;
   Msg_U3T_Obj_04_50ms.U3T04_heading_rate.phys = @sysvar::MsgU3T_Obj_04_50ms::SigU3T04_heading_rate;
   Msg_U3T_Obj_04_50ms.U3T04_id.phys = @sysvar::MsgU3T_Obj_04_50ms::SigU3T04_id;
   Msg_U3T_Obj_04_50ms.U3T04_length.phys = @sysvar::MsgU3T_Obj_04_50ms::SigU3T04_length;
   Msg_U3T_Obj_04_50ms.U3T04_RLcorner_lat.phys = @sysvar::MsgU3T_Obj_04_50ms::SigU3T04_RLcorner_lat;
   Msg_U3T_Obj_04_50ms.U3T04_RLcorner_long.phys = @sysvar::MsgU3T_Obj_04_50ms::SigU3T04_RLcorner_long;
   Msg_U3T_Obj_04_50ms.U3T04_RRcorner_lat.phys = @sysvar::MsgU3T_Obj_04_50ms::SigU3T04_RRcorner_lat;
   Msg_U3T_Obj_04_50ms.U3T04_RRcorner_long.phys = @sysvar::MsgU3T_Obj_04_50ms::SigU3T04_RRcorner_long;
   Msg_U3T_Obj_04_50ms.U3T04_speed.phys = @sysvar::MsgU3T_Obj_04_50ms::SigU3T04_speed;
   Msg_U3T_Obj_04_50ms.U3T04_width.phys = @sysvar::MsgU3T_Obj_04_50ms::SigU3T04_width;
   Msg_U3T_Obj_04_50ms.U3T04_fusion_source.phys = @sysvar::MsgU3T_Obj_04_50ms::SigU3T04_fusion_source;
   Msg_U3T_Obj_04_50ms.U3T04_vcs_heading.phys = @sysvar::MsgU3T_Obj_04_50ms::SigU3T04_vcs_heading;
   Msg_U3T_Obj_04_50ms.U3T04_vcs_lat_accel.phys = @sysvar::MsgU3T_Obj_04_50ms::SigU3T04_vcs_lat_accel;
   Msg_U3T_Obj_04_50ms.U3T04_vcs_lat_posn.phys = @sysvar::MsgU3T_Obj_04_50ms::SigU3T04_vcs_lat_posn;
   Msg_U3T_Obj_04_50ms.U3T04_vcs_lat_vel.phys = @sysvar::MsgU3T_Obj_04_50ms::SigU3T04_vcs_lat_vel;
   Msg_U3T_Obj_04_50ms.U3T04_vcs_long_accel.phys = @sysvar::MsgU3T_Obj_04_50ms::SigU3T04_vcs_long_accel;
   Msg_U3T_Obj_04_50ms.U3T04_vcs_long_posn.phys = @sysvar::MsgU3T_Obj_04_50ms::SigU3T04_vcs_long_posn;
   Msg_U3T_Obj_04_50ms.U3T04_vcs_long_vel.phys = @sysvar::MsgU3T_Obj_04_50ms::SigU3T04_vcs_long_vel;
   Msg_U3T_Obj_04_50ms.U3T04_conf_overall.phys = @sysvar::MsgU3T_Obj_04_50ms::SigU3T04_conf_overall;
   Msg_U3T_Obj_04_50ms.U3T04_f_oncoming.phys = @sysvar::MsgU3T_Obj_04_50ms::SigU3T04_f_oncoming;
   Msg_U3T_Obj_04_50ms.U3T04_f_receding.phys = @sysvar::MsgU3T_Obj_04_50ms::SigU3T04_f_receding;
   output(Msg_U3T_Obj_04_50ms);
   Msg_U3T_Obj_01_50ms.U3T01_age.phys = @sysvar::MsgU3T_Obj_01_50ms::SigU3T01_age;
   Msg_U3T_Obj_01_50ms.U3T01_f_moveable.phys = @sysvar::MsgU3T_Obj_01_50ms::SigU3T01_f_moveable;
   Msg_U3T_Obj_01_50ms.U3T01_f_stationary.phys = @sysvar::MsgU3T_Obj_01_50ms::SigU3T01_f_stationary;
   Msg_U3T_Obj_01_50ms.U3T01_FLcorner_lat.phys = @sysvar::MsgU3T_Obj_01_50ms::SigU3T01_FLcorner_lat;
   Msg_U3T_Obj_01_50ms.U3T01_object_class.phys = @sysvar::MsgU3T_Obj_01_50ms::SigU3T01_object_class;
   Msg_U3T_Obj_01_50ms.U3T01_FLcorner_long.phys = @sysvar::MsgU3T_Obj_01_50ms::SigU3T01_FLcorner_long;
   Msg_U3T_Obj_01_50ms.U3T01_status.phys = @sysvar::MsgU3T_Obj_01_50ms::SigU3T01_status;
   Msg_U3T_Obj_01_50ms.U3T01_FRcorner_lat.phys = @sysvar::MsgU3T_Obj_01_50ms::SigU3T01_FRcorner_lat;
   Msg_U3T_Obj_01_50ms.U3T01_FRcorner_long.phys = @sysvar::MsgU3T_Obj_01_50ms::SigU3T01_FRcorner_long;
   Msg_U3T_Obj_01_50ms.U3T01_heading_rate.phys = @sysvar::MsgU3T_Obj_01_50ms::SigU3T01_heading_rate;
   Msg_U3T_Obj_01_50ms.U3T01_id.phys = @sysvar::MsgU3T_Obj_01_50ms::SigU3T01_id;
   Msg_U3T_Obj_01_50ms.U3T01_length.phys = @sysvar::MsgU3T_Obj_01_50ms::SigU3T01_length;
   Msg_U3T_Obj_01_50ms.U3T01_RLcorner_lat.phys = @sysvar::MsgU3T_Obj_01_50ms::SigU3T01_RLcorner_lat;
   Msg_U3T_Obj_01_50ms.U3T01_RLcorner_long.phys = @sysvar::MsgU3T_Obj_01_50ms::SigU3T01_RLcorner_long;
   Msg_U3T_Obj_01_50ms.U3T01_RRcorner_lat.phys = @sysvar::MsgU3T_Obj_01_50ms::SigU3T01_RRcorner_lat;
   Msg_U3T_Obj_01_50ms.U3T01_RRcorner_long.phys = @sysvar::MsgU3T_Obj_01_50ms::SigU3T01_RRcorner_long;
   Msg_U3T_Obj_01_50ms.U3T01_speed.phys = @sysvar::MsgU3T_Obj_01_50ms::SigU3T01_speed;
   Msg_U3T_Obj_01_50ms.U3T01_width.phys = @sysvar::MsgU3T_Obj_01_50ms::SigU3T01_width;
   Msg_U3T_Obj_01_50ms.U3T01_fusion_source.phys = @sysvar::MsgU3T_Obj_01_50ms::SigU3T01_fusion_source;
   Msg_U3T_Obj_01_50ms.U3T01_vcs_heading.phys = @sysvar::MsgU3T_Obj_01_50ms::SigU3T01_vcs_heading;
   Msg_U3T_Obj_01_50ms.U3T01_vcs_lat_accel.phys = @sysvar::MsgU3T_Obj_01_50ms::SigU3T01_vcs_lat_accel;
   Msg_U3T_Obj_01_50ms.U3T01_vcs_lat_posn.phys = @sysvar::MsgU3T_Obj_01_50ms::SigU3T01_vcs_lat_posn;
   Msg_U3T_Obj_01_50ms.U3T01_vcs_lat_vel.phys = @sysvar::MsgU3T_Obj_01_50ms::SigU3T01_vcs_lat_vel;
   Msg_U3T_Obj_01_50ms.U3T01_vcs_long_accel.phys = @sysvar::MsgU3T_Obj_01_50ms::SigU3T01_vcs_long_accel;
   Msg_U3T_Obj_01_50ms.U3T01_vcs_long_posn.phys = @sysvar::MsgU3T_Obj_01_50ms::SigU3T01_vcs_long_posn;
   Msg_U3T_Obj_01_50ms.U3T01_vcs_long_vel.phys = @sysvar::MsgU3T_Obj_01_50ms::SigU3T01_vcs_long_vel;
   Msg_U3T_Obj_01_50ms.U3T01_conf_overall.phys = @sysvar::MsgU3T_Obj_01_50ms::SigU3T01_conf_overall;
   Msg_U3T_Obj_01_50ms.U3T01_f_oncoming.phys = @sysvar::MsgU3T_Obj_01_50ms::SigU3T01_f_oncoming;
   Msg_U3T_Obj_01_50ms.U3T01_f_receding.phys = @sysvar::MsgU3T_Obj_01_50ms::SigU3T01_f_receding;
   output(Msg_U3T_Obj_01_50ms);
   Msg_U3T_Obj_02_50ms.U3T02_age.phys = @sysvar::MsgU3T_Obj_02_50ms::SigU3T02_age;
   Msg_U3T_Obj_02_50ms.U3T02_f_moveable.phys = @sysvar::MsgU3T_Obj_02_50ms::SigU3T02_f_moveable;
   Msg_U3T_Obj_02_50ms.U3T02_f_stationary.phys = @sysvar::MsgU3T_Obj_02_50ms::SigU3T02_f_stationary;
   Msg_U3T_Obj_02_50ms.U3T02_FLcorner_lat.phys = @sysvar::MsgU3T_Obj_02_50ms::SigU3T02_FLcorner_lat;
   Msg_U3T_Obj_02_50ms.U3T02_object_class.phys = @sysvar::MsgU3T_Obj_02_50ms::SigU3T02_object_class;
   Msg_U3T_Obj_02_50ms.U3T02_FLcorner_long.phys = @sysvar::MsgU3T_Obj_02_50ms::SigU3T02_FLcorner_long;
   Msg_U3T_Obj_02_50ms.U3T02_status.phys = @sysvar::MsgU3T_Obj_02_50ms::SigU3T02_status;
   Msg_U3T_Obj_02_50ms.U3T02_FRcorner_lat.phys = @sysvar::MsgU3T_Obj_02_50ms::SigU3T02_FRcorner_lat;
   Msg_U3T_Obj_02_50ms.U3T02_FRcorner_long.phys = @sysvar::MsgU3T_Obj_02_50ms::SigU3T02_FRcorner_long;
   Msg_U3T_Obj_02_50ms.U3T02_heading_rate.phys = @sysvar::MsgU3T_Obj_02_50ms::SigU3T02_heading_rate;
   Msg_U3T_Obj_02_50ms.U3T02_id.phys = @sysvar::MsgU3T_Obj_02_50ms::SigU3T02_id;
   Msg_U3T_Obj_02_50ms.U3T02_length.phys = @sysvar::MsgU3T_Obj_02_50ms::SigU3T02_length;
   Msg_U3T_Obj_02_50ms.U3T02_RLcorner_lat.phys = @sysvar::MsgU3T_Obj_02_50ms::SigU3T02_RLcorner_lat;
   Msg_U3T_Obj_02_50ms.U3T02_RLcorner_long.phys = @sysvar::MsgU3T_Obj_02_50ms::SigU3T02_RLcorner_long;
   Msg_U3T_Obj_02_50ms.U3T02_RRcorner_lat.phys = @sysvar::MsgU3T_Obj_02_50ms::SigU3T02_RRcorner_lat;
   Msg_U3T_Obj_02_50ms.U3T02_RRcorner_long.phys = @sysvar::MsgU3T_Obj_02_50ms::SigU3T02_RRcorner_long;
   Msg_U3T_Obj_02_50ms.U3T02_speed.phys = @sysvar::MsgU3T_Obj_02_50ms::SigU3T02_speed;
   Msg_U3T_Obj_02_50ms.U3T02_width.phys = @sysvar::MsgU3T_Obj_02_50ms::SigU3T02_width;
   Msg_U3T_Obj_02_50ms.U3T02_fusion_source.phys = @sysvar::MsgU3T_Obj_02_50ms::SigU3T02_fusion_source;
   Msg_U3T_Obj_02_50ms.U3T02_vcs_heading.phys = @sysvar::MsgU3T_Obj_02_50ms::SigU3T02_vcs_heading;
   Msg_U3T_Obj_02_50ms.U3T02_vcs_lat_accel.phys = @sysvar::MsgU3T_Obj_02_50ms::SigU3T02_vcs_lat_accel;
   Msg_U3T_Obj_02_50ms.U3T02_vcs_lat_posn.phys = @sysvar::MsgU3T_Obj_02_50ms::SigU3T02_vcs_lat_posn;
   Msg_U3T_Obj_02_50ms.U3T02_vcs_lat_vel.phys = @sysvar::MsgU3T_Obj_02_50ms::SigU3T02_vcs_lat_vel;
   Msg_U3T_Obj_02_50ms.U3T02_vcs_long_accel.phys = @sysvar::MsgU3T_Obj_02_50ms::SigU3T02_vcs_long_accel;
   Msg_U3T_Obj_02_50ms.U3T02_vcs_long_posn.phys = @sysvar::MsgU3T_Obj_02_50ms::SigU3T02_vcs_long_posn;
   Msg_U3T_Obj_02_50ms.U3T02_vcs_long_vel.phys = @sysvar::MsgU3T_Obj_02_50ms::SigU3T02_vcs_long_vel;
   Msg_U3T_Obj_02_50ms.U3T02_conf_overall.phys = @sysvar::MsgU3T_Obj_02_50ms::SigU3T02_conf_overall;
   Msg_U3T_Obj_02_50ms.U3T02_f_oncoming.phys = @sysvar::MsgU3T_Obj_02_50ms::SigU3T02_f_oncoming;
   Msg_U3T_Obj_02_50ms.U3T02_f_receding.phys = @sysvar::MsgU3T_Obj_02_50ms::SigU3T02_f_receding;
   output(Msg_U3T_Obj_02_50ms);
   Msg_U3T_Obj_03_50ms.U3T03_age.phys = @sysvar::MsgU3T_Obj_03_50ms::SigU3T03_age;
   Msg_U3T_Obj_03_50ms.U3T03_f_moveable.phys = @sysvar::MsgU3T_Obj_03_50ms::SigU3T03_f_moveable;
   Msg_U3T_Obj_03_50ms.U3T03_f_stationary.phys = @sysvar::MsgU3T_Obj_03_50ms::SigU3T03_f_stationary;
   Msg_U3T_Obj_03_50ms.U3T03_FLcorner_lat.phys = @sysvar::MsgU3T_Obj_03_50ms::SigU3T03_FLcorner_lat;
   Msg_U3T_Obj_03_50ms.U3T03_object_class.phys = @sysvar::MsgU3T_Obj_03_50ms::SigU3T03_object_class;
   Msg_U3T_Obj_03_50ms.U3T03_FLcorner_long.phys = @sysvar::MsgU3T_Obj_03_50ms::SigU3T03_FLcorner_long;
   Msg_U3T_Obj_03_50ms.U3T03_status.phys = @sysvar::MsgU3T_Obj_03_50ms::SigU3T03_status;
   Msg_U3T_Obj_03_50ms.U3T03_FRcorner_lat.phys = @sysvar::MsgU3T_Obj_03_50ms::SigU3T03_FRcorner_lat;
   Msg_U3T_Obj_03_50ms.U3T03_FRcorner_long.phys = @sysvar::MsgU3T_Obj_03_50ms::SigU3T03_FRcorner_long;
   Msg_U3T_Obj_03_50ms.U3T03_heading_rate.phys = @sysvar::MsgU3T_Obj_03_50ms::SigU3T03_heading_rate;
   Msg_U3T_Obj_03_50ms.U3T03_id.phys = @sysvar::MsgU3T_Obj_03_50ms::SigU3T03_id;
   Msg_U3T_Obj_03_50ms.U3T03_length.phys = @sysvar::MsgU3T_Obj_03_50ms::SigU3T03_length;
   Msg_U3T_Obj_03_50ms.U3T03_RLcorner_lat.phys = @sysvar::MsgU3T_Obj_03_50ms::SigU3T03_RLcorner_lat;
   Msg_U3T_Obj_03_50ms.U3T03_RLcorner_long.phys = @sysvar::MsgU3T_Obj_03_50ms::SigU3T03_RLcorner_long;
   Msg_U3T_Obj_03_50ms.U3T03_RRcorner_lat.phys = @sysvar::MsgU3T_Obj_03_50ms::SigU3T03_RRcorner_lat;
   Msg_U3T_Obj_03_50ms.U3T03_RRcorner_long.phys = @sysvar::MsgU3T_Obj_03_50ms::SigU3T03_RRcorner_long;
   Msg_U3T_Obj_03_50ms.U3T03_speed.phys = @sysvar::MsgU3T_Obj_03_50ms::SigU3T03_speed;
   Msg_U3T_Obj_03_50ms.U3T03_width.phys = @sysvar::MsgU3T_Obj_03_50ms::SigU3T03_width;
   Msg_U3T_Obj_03_50ms.U3T03_fusion_source.phys = @sysvar::MsgU3T_Obj_03_50ms::SigU3T03_fusion_source;
   Msg_U3T_Obj_03_50ms.U3T03_vcs_heading.phys = @sysvar::MsgU3T_Obj_03_50ms::SigU3T03_vcs_heading;
   Msg_U3T_Obj_03_50ms.U3T03_vcs_lat_accel.phys = @sysvar::MsgU3T_Obj_03_50ms::SigU3T03_vcs_lat_accel;
   Msg_U3T_Obj_03_50ms.U3T03_vcs_lat_posn.phys = @sysvar::MsgU3T_Obj_03_50ms::SigU3T03_vcs_lat_posn;
   Msg_U3T_Obj_03_50ms.U3T03_vcs_lat_vel.phys = @sysvar::MsgU3T_Obj_03_50ms::SigU3T03_vcs_lat_vel;
   Msg_U3T_Obj_03_50ms.U3T03_vcs_long_accel.phys = @sysvar::MsgU3T_Obj_03_50ms::SigU3T03_vcs_long_accel;
   Msg_U3T_Obj_03_50ms.U3T03_vcs_long_posn.phys = @sysvar::MsgU3T_Obj_03_50ms::SigU3T03_vcs_long_posn;
   Msg_U3T_Obj_03_50ms.U3T03_vcs_long_vel.phys = @sysvar::MsgU3T_Obj_03_50ms::SigU3T03_vcs_long_vel;
   Msg_U3T_Obj_03_50ms.U3T03_conf_overall.phys = @sysvar::MsgU3T_Obj_03_50ms::SigU3T03_conf_overall;
   Msg_U3T_Obj_03_50ms.U3T03_f_oncoming.phys = @sysvar::MsgU3T_Obj_03_50ms::SigU3T03_f_oncoming;
   Msg_U3T_Obj_03_50ms.U3T03_f_receding.phys = @sysvar::MsgU3T_Obj_03_50ms::SigU3T03_f_receding;
   output(Msg_U3T_Obj_03_50ms);
}
